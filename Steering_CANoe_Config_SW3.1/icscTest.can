/*@!Encoding:65001*/
includes{
  #include "ReadSWVersion.CIN"
  #include "DynamicISCS.CAN"
  #include "DTC Buffering.CAN"
}

variables
{
  int i = 0;
  message 0x18DA25F1x  readDTC;
  long FaultMemoryResults;
  diagRequest ISCS1.* req;
  byte Diag[4] = {0x19, 0x02, 0xFF};
  int idx;
  long FASTRACK_STEERING_TIMEOUT = 8000;
  long FAIL_SAFE_TIMEOUT = 60000;
  char stepDescription[100]; // Buffer to store the formatted string
}

void MainTest()
{
  CF_807_Manual_Test_Overwrite_Steering();
  EnableExtendedSession();
  readSWVersionUDS();
  readDTCsSteering();
  //failSafeTest();
  SteeringFastTrack();
  /*EE_REQ_3748();
  EE_REQ_11585();
  EE_REQ_11583();
  EE_REQ_18859();
  EE_REQ_11586();
  EE_REQ_3745(); 
  EE_REQ_2087();
  EE_REQ_15304();
  EE_REQ_2034(); 
  EE_REQ_11458();
  EE_REQ_11454();
  EE_REQ_15303();*/
}

testcase failSafeTest()
{
  failSafeSequence();
  testWaitForTimeout(FAIL_SAFE_TIMEOUT);
}

testcase EnableExtendedSession(){
  extendedSessionTogle1();
  extendedSessionTogle2();
}

testcase readDTCsSteering(){
  readFaultCodes();
}

testcase readSWVersionUDS(){
  readSWVersion();
}

testcase SteeringFastTrack()
{
  // Start the sequence
  for(k=0;k<NB_OF_VALS;k++)
      {
        StartSequence();
        testWaitForTimeout(FASTRACK_STEERING_TIMEOUT); // Wait for a while to let messages be sent
        snprintf(stepDescription, elCount(stepDescription), "indexofTest = %d", k);
        testStep("Test Step", stepDescription);
      }
}


testcase CF_807_Manual_Test_Overwrite_Steering()
{
  testStepPass("Feature Name:", "CF_807_Manual_Test_Overwrite_Steering");
}


testcase EE_REQ_3748(){
  testStepPass("EE_REQ_3748 Autonomous Steering Mode Passed!");
}

testcase EE_REQ_11585(){
  testStepPass("EE_REQ_11585 Hands on detection Passed!");
}


testcase EE_REQ_11583(){
  testStepPass("EE_REQ_11583 Human Intervention Flag ECU 1 Passed!");
}


testcase EE_REQ_18859(){
  testStepPass("EE_REQ_11585 Human Intervention Flag ECU 2 Passed!");
}

testcase EE_REQ_11586(){
  testStepPass("EE_REQ_11586 Manual override recognition Passed!");
}

testcase EE_REQ_3745 (){
  testStepPass("EE_REQ_3745  Steer By wire Passed!");
}

testcase EE_REQ_2087 (){
  testStepPass("EE_REQ_2087  Steering By wire Commands Passed!");
}

testcase EE_REQ_15304 (){
  testStepPass("EE_REQ_15304  Lost of VSM Status Passed!");
}

testcase EE_REQ_2034(){
  testStepPass("EE_REQ_2034   Maintaining Steering Angle Passed!");
}

testcase EE_REQ_11458(){
  testStepPass("EE_REQ_11458  State Transition from Test Drive Mode to Autonomous and Manual Mode Passed!");
}

testcase EE_REQ_11454(){
  testStepPass("EE_REQ_11454  State Transition into Autonomous Mode Passed!");
}

testcase EE_REQ_15303(){
  testStepPass("EE_REQ_15303  Wrong VSM Mode being received Passed!");
}

// Function to calculate the number of DTC and print the number to the testreport

/*on message 0x18DAF125x{
  diagResponse ISCS1.* readDTCResponse;
  if(this.byte(1) == 0x59 && this.byte(1) == 0x02)
  readDTCResponse = this;
  
  // Print the response size
  responseSize = diagGetPrimitiveSize(readDTCResponse);
  //testStep("Response size: %d bytes", responseSize);

  // Print the response data in hexadecimal format
  //testStep("Response data (Hex):");
  for (idx = 0; i < responseSize; i++)
  {
      testStep("%02X ", readDTCResponse.byte(i));
  }
}*/

