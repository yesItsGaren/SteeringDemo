/*@!Encoding:1252*/
includes
{
  // Import required CAPL include files
  //--- begin generated part --- Block start #GlobalBody_Includes#; do not delete this line and do not add application code in this code block!
  /* #ChannelGlobalStart# |CAN1| #BusGlobalStart# |CHASSIS1CAN| */
  /* #ChannelGlobalEnd# |CAN1| #BusGlobalEnd# |CHASSIS1CAN| */
  //--- end generated part --- Block end #GlobalBody_Includes#; do not delete this line! Add application code below this line.
  //--- begin generated part --- Block start #Body_Includes#; do not delete this line and do not add application code in this code block!
  /* #ChannelStart# |CAN1| #BusStart# |CHASSIS1CAN| */
  #include "..\CAPL\Vector-NM-Panel-Helper_CAN1.cin"
  #include "..\CAPL\Vector-IL-KL15-Helper_CAN1.cin"
  /* #ChannelEnd# |CAN1| #BusEnd# |CHASSIS1CAN| */
  //--- end generated part --- Block end #Body_Includes#; do not delete this line! Add application code below this line.
}

variables
{
  // Define global variables for this CAPL file

  /*--- #GenHeader Begin# --- begin generated comment ---
  | Generated on Friday, February 14, 2025, 17:15:18
  | By ModelGenerator for Vector 1.6.4.13, ModelGeneratorVectorDLL 1.6.4.69
  | Package Vector 4.0.59
  | Target Bus: CHASSIS1CAN; Channel: CAN1; DB Cluster: DBC_SW030201_Chassis1_CAN;
  | From Database: DBC_SW03.02.01_Chassis1_CAN.dbc
  | CANoe Version 17.3.91.0
    --- #GenHeader End  # --- end generated comment --- */

  char gECU[256] = "CGW2";
  //--- begin generated part --- Block start #Hdr_GlobalVariables#; do not delete this line and do not add application code in this code block!
  /* #ChannelStart# |CAN1| #BusStart# |CHASSIS1CAN| */
  /* #ChannelEnd# |CAN1| #BusEnd# |CHASSIS1CAN| */
  //--- end generated part --- Block end #Hdr_GlobalVariables#; do not delete this line! Add application code below this line.
  //--- begin generated part --- Block start #GlobalBody_GlobalVariables#; do not delete this line and do not add application code in this code block!
  /* #ChannelGlobalStart# |CAN1| #BusGlobalStart# |CHASSIS1CAN| */
  /* #ChannelGlobalEnd# |CAN1| #BusGlobalEnd# |CHASSIS1CAN| */
  //--- end generated part --- Block end #GlobalBody_GlobalVariables#; do not delete this line! Add application code below this line.
  //--- begin generated part --- Block start #Body_GlobalVariables#; do not delete this line and do not add application code in this code block!
  /* #ChannelStart# |CAN1| #BusStart# |CHASSIS1CAN| */
  char gCAN1BusName[256] = "CHASSIS1CAN";
  int gCAN1Channel = 1; // The channel the bus is attached to

  long gCAN1DisturbanceMode;
  long gCAN1DisturbanceCount;
  long gCAN1DisturbanceValue;
  long gCAN1DisturbanceContinueMode;
  double gCAN1DisturbancePeriod;
  /* #ChannelEnd# |CAN1| #BusEnd# |CHASSIS1CAN| */
  //--- end generated part --- Block end #Body_GlobalVariables#; do not delete this line! Add application code below this line.
}

on preStart
{
  // Initialize CAPL includes and node's modules/DLLs
  //--- begin generated part --- Block start #Hdr_OnInit#; do not delete this line and do not add application code in this code block!
  /* #ChannelStart# |CAN1| #BusStart# |CHASSIS1CAN| */
  /* #ChannelEnd# |CAN1| #BusEnd# |CHASSIS1CAN| */
  //--- end generated part --- Block end #Hdr_OnInit#; do not delete this line! Add application code below this line.
  //--- begin generated part --- Block start #GlobalBody_OnInit#; do not delete this line and do not add application code in this code block!
  /* #ChannelGlobalStart# |CAN1| #BusGlobalStart# |CHASSIS1CAN| */
  /* #ChannelGlobalEnd# |CAN1| #BusGlobalEnd# |CHASSIS1CAN| */
  //--- end generated part --- Block end #GlobalBody_OnInit#; do not delete this line! Add application code below this line.
  //--- begin generated part --- Block start #Body_OnInit#; do not delete this line and do not add application code in this code block!
  /* #ChannelStart# |CAN1| #BusStart# |CHASSIS1CAN| */
  ILCAN1_OnInit();
  /* #ChannelEnd# |CAN1| #BusEnd# |CHASSIS1CAN| */
  //--- end generated part --- Block end #Body_OnInit#; do not delete this line! Add application code below this line.
}

on start
{
  // Start CAPL includes and node's modules/DLLs
  //--- begin generated part --- Block start #Hdr_OnStart#; do not delete this line and do not add application code in this code block!
  /* #ChannelStart# |CAN1| #BusStart# |CHASSIS1CAN| */
  /* #ChannelEnd# |CAN1| #BusEnd# |CHASSIS1CAN| */
  //--- end generated part --- Block end #Hdr_OnStart#; do not delete this line! Add application code below this line.
  //--- begin generated part --- Block start #GlobalBody_OnStart#; do not delete this line and do not add application code in this code block!
  /* #ChannelGlobalStart# |CAN1| #BusGlobalStart# |CHASSIS1CAN| */
  /* #ChannelGlobalEnd# |CAN1| #BusGlobalEnd# |CHASSIS1CAN| */
  //--- end generated part --- Block end #GlobalBody_OnStart#; do not delete this line! Add application code below this line.
  //--- begin generated part --- Block start #Body_OnStart#; do not delete this line and do not add application code in this code block!
  /* #ChannelStart# |CAN1| #BusStart# |CHASSIS1CAN| */
  ILCAN1_OnStart();
  /* #ChannelEnd# |CAN1| #BusEnd# |CHASSIS1CAN| */
  //--- end generated part --- Block end #Body_OnStart#; do not delete this line! Add application code below this line.
}

on preStop
{
  // Prepare stopping
  //--- begin generated part --- Block start #Hdr_OnStopping#; do not delete this line and do not add application code in this code block!
  /* #ChannelStart# |CAN1| #BusStart# |CHASSIS1CAN| */
  /* #ChannelEnd# |CAN1| #BusEnd# |CHASSIS1CAN| */
  //--- end generated part --- Block end #Hdr_OnStopping#; do not delete this line! Add application code below this line.
  //--- begin generated part --- Block start #GlobalBody_OnStopping#; do not delete this line and do not add application code in this code block!
  /* #ChannelGlobalStart# |CAN1| #BusGlobalStart# |CHASSIS1CAN| */
  /* #ChannelGlobalEnd# |CAN1| #BusGlobalEnd# |CHASSIS1CAN| */
  //--- end generated part --- Block end #GlobalBody_OnStopping#; do not delete this line! Add application code below this line.
  //--- begin generated part --- Block start #Body_OnStopping#; do not delete this line and do not add application code in this code block!
  /* #ChannelStart# |CAN1| #BusStart# |CHASSIS1CAN| */
  /* #ChannelEnd# |CAN1| #BusEnd# |CHASSIS1CAN| */
  //--- end generated part --- Block end #Body_OnStopping#; do not delete this line! Add application code below this line.
}

on stopMeasurement
{
  // Stop actions
  //--- begin generated part --- Block start #Hdr_OnStop#; do not delete this line and do not add application code in this code block!
  /* #ChannelStart# |CAN1| #BusStart# |CHASSIS1CAN| */
  /* #ChannelEnd# |CAN1| #BusEnd# |CHASSIS1CAN| */
  //--- end generated part --- Block end #Hdr_OnStop#; do not delete this line! Add application code below this line.
  //--- begin generated part --- Block start #GlobalBody_OnStop#; do not delete this line and do not add application code in this code block!
  /* #ChannelGlobalStart# |CAN1| #BusGlobalStart# |CHASSIS1CAN| */
  /* #ChannelGlobalEnd# |CAN1| #BusGlobalEnd# |CHASSIS1CAN| */
  //--- end generated part --- Block end #GlobalBody_OnStop#; do not delete this line! Add application code below this line.
  //--- begin generated part --- Block start #Body_OnStop#; do not delete this line and do not add application code in this code block!
  /* #ChannelStart# |CAN1| #BusStart# |CHASSIS1CAN| */
  /* #ChannelEnd# |CAN1| #BusEnd# |CHASSIS1CAN| */
  //--- end generated part --- Block end #Body_OnStop#; do not delete this line! Add application code below this line.
}

void StartSim(dword busContext, int busActive, int mode)
{
  // Called when ... due to ...
  //   mode == 1: ILControlResume
  //   mode == 2: ILControlStart
  //   mode == 3: ILControlSimulationOn
  //--- begin generated part --- Block start #Hdr_StartSim#; do not delete this line and do not add application code in this code block!
  /* #ChannelStart# |CAN1| #BusStart# |CHASSIS1CAN| */
  /* #ChannelEnd# |CAN1| #BusEnd# |CHASSIS1CAN| */
  //--- end generated part --- Block end #Hdr_StartSim#; do not delete this line! Add application code below this line.
  //write("[%.6f %NODE_NAME%] StartSim(0x%X, %d, %d)", TimeNowNS()/1e9, busContext, busActive, mode);
  //--- begin generated part --- Block start #Body_StartSim#; do not delete this line and do not add application code in this code block!
  /* #ChannelStart# |CAN1| #BusStart# |CHASSIS1CAN| */
  /* #ChannelEnd# |CAN1| #BusEnd# |CHASSIS1CAN| */
  //--- end generated part --- Block end #Body_StartSim#; do not delete this line! Add application code below this line.
}

void StopSim(dword busContext, int busActive, int mode)
{
  // Called when ... due to ...
  //   mode == 1: ILControlWait
  //   mode == 2: ILControlStop
  //   mode == 3: ILControlSimulationOff
  //--- begin generated part --- Block start #Hdr_StopSim#; do not delete this line and do not add application code in this code block!
  /* #ChannelStart# |CAN1| #BusStart# |CHASSIS1CAN| */
  /* #ChannelEnd# |CAN1| #BusEnd# |CHASSIS1CAN| */
  //--- end generated part --- Block end #Hdr_StopSim#; do not delete this line! Add application code below this line.
  //write("[%.6f %NODE_NAME%] StopSim(0x%X, %d, %d)", TimeNowNS()/1e9, busContext, busActive, mode);
  //--- begin generated part --- Block start #Body_StopSim#; do not delete this line and do not add application code in this code block!
  /* #ChannelStart# |CAN1| #BusStart# |CHASSIS1CAN| */
  /* #ChannelEnd# |CAN1| #BusEnd# |CHASSIS1CAN| */
  //--- end generated part --- Block end #Body_StopSim#; do not delete this line! Add application code below this line.
}

on sysvar_update sysvar::IL::Klemme15
{
  // Handle system state variable
  //--- begin generated part --- Block start #Hdr_KL15_Klemme15#; do not delete this line and do not add application code in this code block!
  /* #ChannelStart# |CAN1| #BusStart# |CHASSIS1CAN| */
  /* #ChannelEnd# |CAN1| #BusEnd# |CHASSIS1CAN| */
  //--- end generated part --- Block end #Hdr_KL15_Klemme15#; do not delete this line! Add application code below this line.
  //--- begin generated part --- Block start #Body_KL15_Klemme15#; do not delete this line and do not add application code in this code block!
  /* #ChannelStart# |CAN1| #BusStart# |CHASSIS1CAN| */
  ILCAN1_OnEnvKlemme15(@this);
  /* #ChannelEnd# |CAN1| #BusEnd# |CHASSIS1CAN| */
  //--- end generated part --- Block end #Body_KL15_Klemme15#; do not delete this line! Add application code below this line.
}

on sysvar_update sysvar::IL::Klemme30
{
  // Handle system state variable
  //--- begin generated part --- Block start #Hdr_KL30_Klemme30#; do not delete this line and do not add application code in this code block!
  /* #ChannelStart# |CAN1| #BusStart# |CHASSIS1CAN| */
  /* #ChannelEnd# |CAN1| #BusEnd# |CHASSIS1CAN| */
  //--- end generated part --- Block end #Hdr_KL30_Klemme30#; do not delete this line! Add application code below this line.
  //--- begin generated part --- Block start #Body_KL30_Klemme30#; do not delete this line and do not add application code in this code block!
  /* #ChannelStart# |CAN1| #BusStart# |CHASSIS1CAN| */
  ILCAN1_OnEnvKlemme30(@this);
  /* #ChannelEnd# |CAN1| #BusEnd# |CHASSIS1CAN| */
  //--- end generated part --- Block end #Body_KL30_Klemme30#; do not delete this line! Add application code below this line.
}

dword applILTxPending(long aId, dword aDlc, byte data[])
{
  dword ret = 1;
  //--- begin generated part --- Block start #Hdr_applILTxPending#; do not delete this line and do not add application code in this code block!
  /* #ChannelStart# |CAN1| #BusStart# |CHASSIS1CAN| */
  /* #ChannelEnd# |CAN1| #BusEnd# |CHASSIS1CAN| */
  //--- end generated part --- Block end #Hdr_applILTxPending#; do not delete this line! Add application code below this line.
  //--- begin generated part --- Block start #Body_applILTxPending#; do not delete this line and do not add application code in this code block!
  /* #ChannelStart# |CAN1| #BusStart# |CHASSIS1CAN| */
  /* #ChannelEnd# |CAN1| #BusEnd# |CHASSIS1CAN| */
  //--- end generated part --- Block end #Body_applILTxPending#; do not delete this line! Add application code below this line.
  return ret;
}

//--- begin generated part --- Block start <#Helper_Functions#> do not delete this line and do not add application code in this code block!
/* #ChannelStart# |CAN1| #BusStart# |CHASSIS1CAN| */
/* #ChannelEnd# |CAN1| #BusEnd# |CHASSIS1CAN| */
//--- end generated part --- Block end <#Helper_Functions#> do not delete this line! Add application code below this line.

//--- begin generated part --- Block start <#SysVar_Handler#> do not delete this line and do not add application code in this code block!
/* #ChannelStart# |CAN1| #BusStart# |CHASSIS1CAN| */
on sysvar_update sysvar::IL_CAN1::NODES::N_CGW2::EnableNode
{
  ILCAN1_Enable(@this && @sysvar::IL_CAN1::enable_AllNodes && @sysvar::IL::Klemme30);
}

on sysvar_update sysvar::IL_CAN1::enable_AllNodes
{
  ILCAN1_Enable(@this && @sysvar::IL_CAN1::NODES::N_CGW2::EnableNode && @sysvar::IL::Klemme30);
}

on sysvar_update sysvar::IL_CAN1::NODES::N_CGW2::MESSAGES::BatSox::TIMINGS::EnableCyclic
{
  if (@this == 1)
  {
    SetBusContext(gILCAN1_BusContext);
    ILFaultInjectionEnableMsg  (CHASSIS1CAN::CGW2::BatSox);
  }
  else
  {
    SetBusContext(gILCAN1_BusContext);
    ILFaultInjectionDisableMsg (CHASSIS1CAN::CGW2::BatSox);
  }
}

on sysvar_update sysvar::IL_CAN1::NODES::N_CGW2::MESSAGES::BatSox::TIMINGS::SetNormalCycle
{
  if (@this == 1 && @sysvar::IL_CAN1::NODES::N_CGW2::MESSAGES::BatSox::TIMINGS::EnableCyclic)
  {
    @sysvar::IL_CAN1::NODES::N_CGW2::MESSAGES::BatSox::TIMINGS::SelectedPeriod = 0;
  }
}

on sysvar_update sysvar::IL_CAN1::NODES::N_CGW2::MESSAGES::BatSox::TIMINGS::SetNewCycleContinously
{
  if (@this == 1 && @sysvar::IL_CAN1::NODES::N_CGW2::MESSAGES::BatSox::TIMINGS::EnableCyclic)
  {
    @sysvar::IL_CAN1::NODES::N_CGW2::MESSAGES::BatSox::TIMINGS::SelectedPeriod = -1;
  }
}

on sysvar_update sysvar::IL_CAN1::NODES::N_CGW2::MESSAGES::BatSox::TIMINGS::SelectedPeriod
{
  if (@this == 0 && @sysvar::IL_CAN1::NODES::N_CGW2::MESSAGES::BatSox::TIMINGS::EnableCyclic)
  {
    SetBusContext(gILCAN1_BusContext);
    gCAN1DisturbancePeriod = @sysvar::IL_CAN1::NODES::N_CGW2::MESSAGES::BatSox::TIMINGS::NormalCyclePeriod;
    ILFaultInjectionResetMsgCycleTime(CHASSIS1CAN::CGW2::BatSox);
  }
  else if (@this == 1 && @sysvar::IL_CAN1::NODES::N_CGW2::MESSAGES::BatSox::TIMINGS::EnableCyclic)
  {
    SetBusContext(gILCAN1_BusContext);
    gCAN1DisturbancePeriod = @sysvar::IL_CAN1::NODES::N_CGW2::MESSAGES::BatSox::TIMINGS::ActiveCyclePeriod;
    ILFaultInjectionSetMsgCycleTime(CHASSIS1CAN::CGW2::BatSox, gCAN1DisturbancePeriod);
  }
  else if (@this == -1 && @sysvar::IL_CAN1::NODES::N_CGW2::MESSAGES::BatSox::TIMINGS::EnableCyclic)
  {
    SetBusContext(gILCAN1_BusContext);
    gCAN1DisturbancePeriod = @sysvar::IL_CAN1::NODES::N_CGW2::MESSAGES::BatSox::TIMINGS::CyclePeriod;
    ILFaultInjectionSetMsgCycleTime(CHASSIS1CAN::CGW2::BatSox, gCAN1DisturbancePeriod);
  }
}

on sysvar_update sysvar::IL_CAN1::NODES::N_CGW2::MESSAGES::BatSox::TIMINGS::SendOnce
{
  if (@this == 1)
  {
    SetBusContext(gILCAN1_BusContext);
    ILSetMsgEvent(CHASSIS1CAN::CGW2::BatSox);
  }
}

on sysvar_update sysvar::IL_CAN1::NODES::N_CGW2::MESSAGES::BatUMps::TIMINGS::EnableCyclic
{
  if (@this == 1)
  {
    SetBusContext(gILCAN1_BusContext);
    //ILFaultInjectionEnableMsg  (CHASSIS1CAN::CGW2::BatUMps);
  }
  else
  {
    SetBusContext(gILCAN1_BusContext);
    //ILFaultInjectionDisableMsg (CHASSIS1CAN::CGW2::BatUMps);
  }
}

on sysvar_update sysvar::IL_CAN1::NODES::N_CGW2::MESSAGES::BatUMps::TIMINGS::SetNormalCycle
{
  if (@this == 1 && @sysvar::IL_CAN1::NODES::N_CGW2::MESSAGES::BatUMps::TIMINGS::EnableCyclic)
  {
    @sysvar::IL_CAN1::NODES::N_CGW2::MESSAGES::BatUMps::TIMINGS::SelectedPeriod = 0;
  }
}

on sysvar_update sysvar::IL_CAN1::NODES::N_CGW2::MESSAGES::BatUMps::TIMINGS::SetNewCycleContinously
{
  if (@this == 1 && @sysvar::IL_CAN1::NODES::N_CGW2::MESSAGES::BatUMps::TIMINGS::EnableCyclic)
  {
    @sysvar::IL_CAN1::NODES::N_CGW2::MESSAGES::BatUMps::TIMINGS::SelectedPeriod = -1;
  }
}

on sysvar_update sysvar::IL_CAN1::NODES::N_CGW2::MESSAGES::BatUMps::TIMINGS::SelectedPeriod
{
  if (@this == 0 && @sysvar::IL_CAN1::NODES::N_CGW2::MESSAGES::BatUMps::TIMINGS::EnableCyclic)
  {
    SetBusContext(gILCAN1_BusContext);
    gCAN1DisturbancePeriod = @sysvar::IL_CAN1::NODES::N_CGW2::MESSAGES::BatUMps::TIMINGS::NormalCyclePeriod;
    //ILFaultInjectionResetMsgCycleTime(CHASSIS1CAN::CGW2::BatUMps);
  }
  else if (@this == 1 && @sysvar::IL_CAN1::NODES::N_CGW2::MESSAGES::BatUMps::TIMINGS::EnableCyclic)
  {
    SetBusContext(gILCAN1_BusContext);
    gCAN1DisturbancePeriod = @sysvar::IL_CAN1::NODES::N_CGW2::MESSAGES::BatUMps::TIMINGS::ActiveCyclePeriod;
   // ILFaultInjectionSetMsgCycleTime(CHASSIS1CAN::CGW2::BatUMps, gCAN1DisturbancePeriod);
  }
  else if (@this == -1 && @sysvar::IL_CAN1::NODES::N_CGW2::MESSAGES::BatUMps::TIMINGS::EnableCyclic)
  {
    SetBusContext(gILCAN1_BusContext);
    gCAN1DisturbancePeriod = @sysvar::IL_CAN1::NODES::N_CGW2::MESSAGES::BatUMps::TIMINGS::CyclePeriod;
    //ILFaultInjectionSetMsgCycleTime(CHASSIS1CAN::CGW2::BatUMps, gCAN1DisturbancePeriod);
  }
}

on sysvar_update sysvar::IL_CAN1::NODES::N_CGW2::MESSAGES::BatUMps::TIMINGS::SendOnce
{
  if (@this == 1)
  {
    SetBusContext(gILCAN1_BusContext);
   // ILSetMsgEvent(CHASSIS1CAN::CGW2::BatUMps);
  }
}

on sysvar_update sysvar::IL_CAN1::NODES::N_CGW2::MESSAGES::BCM_SM_Request::TIMINGS::EnableCyclic
{
  if (@this == 1)
  {
    SetBusContext(gILCAN1_BusContext);
    ILFaultInjectionEnableMsg  (CHASSIS1CAN::CGW2::BCM_SM_Request);
  }
  else
  {
    SetBusContext(gILCAN1_BusContext);
    ILFaultInjectionDisableMsg (CHASSIS1CAN::CGW2::BCM_SM_Request);
  }
}

on sysvar_update sysvar::IL_CAN1::NODES::N_CGW2::MESSAGES::BCM_SM_Request::TIMINGS::SetNormalCycle
{
  if (@this == 1 && @sysvar::IL_CAN1::NODES::N_CGW2::MESSAGES::BCM_SM_Request::TIMINGS::EnableCyclic)
  {
    @sysvar::IL_CAN1::NODES::N_CGW2::MESSAGES::BCM_SM_Request::TIMINGS::SelectedPeriod = 0;
  }
}

on sysvar_update sysvar::IL_CAN1::NODES::N_CGW2::MESSAGES::BCM_SM_Request::TIMINGS::SetNewCycleContinously
{
  if (@this == 1 && @sysvar::IL_CAN1::NODES::N_CGW2::MESSAGES::BCM_SM_Request::TIMINGS::EnableCyclic)
  {
    @sysvar::IL_CAN1::NODES::N_CGW2::MESSAGES::BCM_SM_Request::TIMINGS::SelectedPeriod = -1;
  }
}

on sysvar_update sysvar::IL_CAN1::NODES::N_CGW2::MESSAGES::BCM_SM_Request::TIMINGS::SelectedPeriod
{
  if (@this == 0 && @sysvar::IL_CAN1::NODES::N_CGW2::MESSAGES::BCM_SM_Request::TIMINGS::EnableCyclic)
  {
    SetBusContext(gILCAN1_BusContext);
    gCAN1DisturbancePeriod = @sysvar::IL_CAN1::NODES::N_CGW2::MESSAGES::BCM_SM_Request::TIMINGS::NormalCyclePeriod;
    ILFaultInjectionResetMsgCycleTime(CHASSIS1CAN::CGW2::BCM_SM_Request);
  }
  else if (@this == 1 && @sysvar::IL_CAN1::NODES::N_CGW2::MESSAGES::BCM_SM_Request::TIMINGS::EnableCyclic)
  {
    SetBusContext(gILCAN1_BusContext);
    gCAN1DisturbancePeriod = @sysvar::IL_CAN1::NODES::N_CGW2::MESSAGES::BCM_SM_Request::TIMINGS::ActiveCyclePeriod;
    ILFaultInjectionSetMsgCycleTime(CHASSIS1CAN::CGW2::BCM_SM_Request, gCAN1DisturbancePeriod);
  }
  else if (@this == -1 && @sysvar::IL_CAN1::NODES::N_CGW2::MESSAGES::BCM_SM_Request::TIMINGS::EnableCyclic)
  {
    SetBusContext(gILCAN1_BusContext);
    gCAN1DisturbancePeriod = @sysvar::IL_CAN1::NODES::N_CGW2::MESSAGES::BCM_SM_Request::TIMINGS::CyclePeriod;
    ILFaultInjectionSetMsgCycleTime(CHASSIS1CAN::CGW2::BCM_SM_Request, gCAN1DisturbancePeriod);
  }
}

on sysvar_update sysvar::IL_CAN1::NODES::N_CGW2::MESSAGES::BCM_SM_Request::TIMINGS::SendOnce
{
  if (@this == 1)
  {
    SetBusContext(gILCAN1_BusContext);
    ILSetMsgEvent(CHASSIS1CAN::CGW2::BCM_SM_Request);
  }
}

on sysvar_update sysvar::IL_CAN1::NODES::N_CGW2::MESSAGES::CGW_FVM_Authentication::TIMINGS::EnableCyclic
{
  if (@this == 1)
  {
    SetBusContext(gILCAN1_BusContext);
    ILFaultInjectionEnableMsg  (CHASSIS1CAN::CGW2::CGW_FVM_Authentication);
  }
  else
  {
    SetBusContext(gILCAN1_BusContext);
    ILFaultInjectionDisableMsg (CHASSIS1CAN::CGW2::CGW_FVM_Authentication);
  }
}

on sysvar_update sysvar::IL_CAN1::NODES::N_CGW2::MESSAGES::CGW_FVM_Authentication::TIMINGS::SetNormalCycle
{
  if (@this == 1 && @sysvar::IL_CAN1::NODES::N_CGW2::MESSAGES::CGW_FVM_Authentication::TIMINGS::EnableCyclic)
  {
    @sysvar::IL_CAN1::NODES::N_CGW2::MESSAGES::CGW_FVM_Authentication::TIMINGS::SelectedPeriod = 0;
  }
}

on sysvar_update sysvar::IL_CAN1::NODES::N_CGW2::MESSAGES::CGW_FVM_Authentication::TIMINGS::SetNewCycleContinously
{
  if (@this == 1 && @sysvar::IL_CAN1::NODES::N_CGW2::MESSAGES::CGW_FVM_Authentication::TIMINGS::EnableCyclic)
  {
    @sysvar::IL_CAN1::NODES::N_CGW2::MESSAGES::CGW_FVM_Authentication::TIMINGS::SelectedPeriod = -1;
  }
}

on sysvar_update sysvar::IL_CAN1::NODES::N_CGW2::MESSAGES::CGW_FVM_Authentication::TIMINGS::SelectedPeriod
{
  if (@this == 0 && @sysvar::IL_CAN1::NODES::N_CGW2::MESSAGES::CGW_FVM_Authentication::TIMINGS::EnableCyclic)
  {
    SetBusContext(gILCAN1_BusContext);
    gCAN1DisturbancePeriod = @sysvar::IL_CAN1::NODES::N_CGW2::MESSAGES::CGW_FVM_Authentication::TIMINGS::NormalCyclePeriod;
    ILFaultInjectionResetMsgCycleTime(CHASSIS1CAN::CGW2::CGW_FVM_Authentication);
  }
  else if (@this == 1 && @sysvar::IL_CAN1::NODES::N_CGW2::MESSAGES::CGW_FVM_Authentication::TIMINGS::EnableCyclic)
  {
    SetBusContext(gILCAN1_BusContext);
    gCAN1DisturbancePeriod = @sysvar::IL_CAN1::NODES::N_CGW2::MESSAGES::CGW_FVM_Authentication::TIMINGS::ActiveCyclePeriod;
    ILFaultInjectionSetMsgCycleTime(CHASSIS1CAN::CGW2::CGW_FVM_Authentication, gCAN1DisturbancePeriod);
  }
  else if (@this == -1 && @sysvar::IL_CAN1::NODES::N_CGW2::MESSAGES::CGW_FVM_Authentication::TIMINGS::EnableCyclic)
  {
    SetBusContext(gILCAN1_BusContext);
    gCAN1DisturbancePeriod = @sysvar::IL_CAN1::NODES::N_CGW2::MESSAGES::CGW_FVM_Authentication::TIMINGS::CyclePeriod;
    ILFaultInjectionSetMsgCycleTime(CHASSIS1CAN::CGW2::CGW_FVM_Authentication, gCAN1DisturbancePeriod);
  }
}

on sysvar_update sysvar::IL_CAN1::NODES::N_CGW2::MESSAGES::CGW_FVM_Authentication::TIMINGS::SendOnce
{
  if (@this == 1)
  {
    SetBusContext(gILCAN1_BusContext);
    ILSetMsgEvent(CHASSIS1CAN::CGW2::CGW_FVM_Authentication);
  }
}

on sysvar_update sysvar::IL_CAN1::NODES::N_CGW2::MESSAGES::CGW_FVM_Counter::TIMINGS::EnableCyclic
{
  if (@this == 1)
  {
    SetBusContext(gILCAN1_BusContext);
    ILFaultInjectionEnableMsg  (CHASSIS1CAN::CGW2::CGW_FVM_Counter);
  }
  else
  {
    SetBusContext(gILCAN1_BusContext);
    ILFaultInjectionDisableMsg (CHASSIS1CAN::CGW2::CGW_FVM_Counter);
  }
}

on sysvar_update sysvar::IL_CAN1::NODES::N_CGW2::MESSAGES::CGW_FVM_Counter::TIMINGS::SetNormalCycle
{
  if (@this == 1 && @sysvar::IL_CAN1::NODES::N_CGW2::MESSAGES::CGW_FVM_Counter::TIMINGS::EnableCyclic)
  {
    @sysvar::IL_CAN1::NODES::N_CGW2::MESSAGES::CGW_FVM_Counter::TIMINGS::SelectedPeriod = 0;
  }
}

on sysvar_update sysvar::IL_CAN1::NODES::N_CGW2::MESSAGES::CGW_FVM_Counter::TIMINGS::SetNewCycleContinously
{
  if (@this == 1 && @sysvar::IL_CAN1::NODES::N_CGW2::MESSAGES::CGW_FVM_Counter::TIMINGS::EnableCyclic)
  {
    @sysvar::IL_CAN1::NODES::N_CGW2::MESSAGES::CGW_FVM_Counter::TIMINGS::SelectedPeriod = -1;
  }
}

on sysvar_update sysvar::IL_CAN1::NODES::N_CGW2::MESSAGES::CGW_FVM_Counter::TIMINGS::SelectedPeriod
{
  if (@this == 0 && @sysvar::IL_CAN1::NODES::N_CGW2::MESSAGES::CGW_FVM_Counter::TIMINGS::EnableCyclic)
  {
    SetBusContext(gILCAN1_BusContext);
    gCAN1DisturbancePeriod = @sysvar::IL_CAN1::NODES::N_CGW2::MESSAGES::CGW_FVM_Counter::TIMINGS::NormalCyclePeriod;
    ILFaultInjectionResetMsgCycleTime(CHASSIS1CAN::CGW2::CGW_FVM_Counter);
  }
  else if (@this == 1 && @sysvar::IL_CAN1::NODES::N_CGW2::MESSAGES::CGW_FVM_Counter::TIMINGS::EnableCyclic)
  {
    SetBusContext(gILCAN1_BusContext);
    gCAN1DisturbancePeriod = @sysvar::IL_CAN1::NODES::N_CGW2::MESSAGES::CGW_FVM_Counter::TIMINGS::ActiveCyclePeriod;
    ILFaultInjectionSetMsgCycleTime(CHASSIS1CAN::CGW2::CGW_FVM_Counter, gCAN1DisturbancePeriod);
  }
  else if (@this == -1 && @sysvar::IL_CAN1::NODES::N_CGW2::MESSAGES::CGW_FVM_Counter::TIMINGS::EnableCyclic)
  {
    SetBusContext(gILCAN1_BusContext);
    gCAN1DisturbancePeriod = @sysvar::IL_CAN1::NODES::N_CGW2::MESSAGES::CGW_FVM_Counter::TIMINGS::CyclePeriod;
    ILFaultInjectionSetMsgCycleTime(CHASSIS1CAN::CGW2::CGW_FVM_Counter, gCAN1DisturbancePeriod);
  }
}

on sysvar_update sysvar::IL_CAN1::NODES::N_CGW2::MESSAGES::CGW_FVM_Counter::TIMINGS::SendOnce
{
  if (@this == 1)
  {
    SetBusContext(gILCAN1_BusContext);
    ILSetMsgEvent(CHASSIS1CAN::CGW2::CGW_FVM_Counter);
  }
}

on sysvar_update sysvar::IL_CAN1::NODES::N_CGW2::MESSAGES::CGW_Manual_Steering_Info::TIMINGS::EnableCyclic
{
  if (@this == 1)
  {
    SetBusContext(gILCAN1_BusContext);
    ILFaultInjectionEnableMsg  (CHASSIS1CAN::CGW2::CGW_Manual_Steering_Info);
  }
  else
  {
    SetBusContext(gILCAN1_BusContext);
    ILFaultInjectionDisableMsg (CHASSIS1CAN::CGW2::CGW_Manual_Steering_Info);
  }
}

on sysvar_update sysvar::IL_CAN1::NODES::N_CGW2::MESSAGES::CGW_Manual_Steering_Info::TIMINGS::SetNormalCycle
{
  if (@this == 1 && @sysvar::IL_CAN1::NODES::N_CGW2::MESSAGES::CGW_Manual_Steering_Info::TIMINGS::EnableCyclic)
  {
    @sysvar::IL_CAN1::NODES::N_CGW2::MESSAGES::CGW_Manual_Steering_Info::TIMINGS::SelectedPeriod = 0;
  }
}

on sysvar_update sysvar::IL_CAN1::NODES::N_CGW2::MESSAGES::CGW_Manual_Steering_Info::TIMINGS::SetNewCycleContinously
{
  if (@this == 1 && @sysvar::IL_CAN1::NODES::N_CGW2::MESSAGES::CGW_Manual_Steering_Info::TIMINGS::EnableCyclic)
  {
    @sysvar::IL_CAN1::NODES::N_CGW2::MESSAGES::CGW_Manual_Steering_Info::TIMINGS::SelectedPeriod = -1;
  }
}

on sysvar_update sysvar::IL_CAN1::NODES::N_CGW2::MESSAGES::CGW_Manual_Steering_Info::TIMINGS::SelectedPeriod
{
  if (@this == 0 && @sysvar::IL_CAN1::NODES::N_CGW2::MESSAGES::CGW_Manual_Steering_Info::TIMINGS::EnableCyclic)
  {
    SetBusContext(gILCAN1_BusContext);
    gCAN1DisturbancePeriod = @sysvar::IL_CAN1::NODES::N_CGW2::MESSAGES::CGW_Manual_Steering_Info::TIMINGS::NormalCyclePeriod;
    ILFaultInjectionResetMsgCycleTime(CHASSIS1CAN::CGW2::CGW_Manual_Steering_Info);
  }
  else if (@this == 1 && @sysvar::IL_CAN1::NODES::N_CGW2::MESSAGES::CGW_Manual_Steering_Info::TIMINGS::EnableCyclic)
  {
    SetBusContext(gILCAN1_BusContext);
    gCAN1DisturbancePeriod = @sysvar::IL_CAN1::NODES::N_CGW2::MESSAGES::CGW_Manual_Steering_Info::TIMINGS::ActiveCyclePeriod;
    ILFaultInjectionSetMsgCycleTime(CHASSIS1CAN::CGW2::CGW_Manual_Steering_Info, gCAN1DisturbancePeriod);
  }
  else if (@this == -1 && @sysvar::IL_CAN1::NODES::N_CGW2::MESSAGES::CGW_Manual_Steering_Info::TIMINGS::EnableCyclic)
  {
    SetBusContext(gILCAN1_BusContext);
    gCAN1DisturbancePeriod = @sysvar::IL_CAN1::NODES::N_CGW2::MESSAGES::CGW_Manual_Steering_Info::TIMINGS::CyclePeriod;
    ILFaultInjectionSetMsgCycleTime(CHASSIS1CAN::CGW2::CGW_Manual_Steering_Info, gCAN1DisturbancePeriod);
  }
}

on sysvar_update sysvar::IL_CAN1::NODES::N_CGW2::MESSAGES::CGW_Manual_Steering_Info::TIMINGS::SendOnce
{
  if (@this == 1)
  {
    SetBusContext(gILCAN1_BusContext);
    ILSetMsgEvent(CHASSIS1CAN::CGW2::CGW_Manual_Steering_Info);
  }
}

on sysvar_update sysvar::IL_CAN1::NODES::N_CGW2::MESSAGES::IPC_Req::TIMINGS::EnableCyclic
{
  if (@this == 1)
  {
    SetBusContext(gILCAN1_BusContext);
    ILFaultInjectionEnableMsg  (CHASSIS1CAN::CGW2::IPC_Req);
  }
  else
  {
    SetBusContext(gILCAN1_BusContext);
    ILFaultInjectionDisableMsg (CHASSIS1CAN::CGW2::IPC_Req);
  }
}

on sysvar_update sysvar::IL_CAN1::NODES::N_CGW2::MESSAGES::IPC_Req::TIMINGS::SetNormalCycle
{
  if (@this == 1 && @sysvar::IL_CAN1::NODES::N_CGW2::MESSAGES::IPC_Req::TIMINGS::EnableCyclic)
  {
    @sysvar::IL_CAN1::NODES::N_CGW2::MESSAGES::IPC_Req::TIMINGS::SelectedPeriod = 0;
  }
}

on sysvar_update sysvar::IL_CAN1::NODES::N_CGW2::MESSAGES::IPC_Req::TIMINGS::SetNewCycleContinously
{
  if (@this == 1 && @sysvar::IL_CAN1::NODES::N_CGW2::MESSAGES::IPC_Req::TIMINGS::EnableCyclic)
  {
    @sysvar::IL_CAN1::NODES::N_CGW2::MESSAGES::IPC_Req::TIMINGS::SelectedPeriod = -1;
  }
}

on sysvar_update sysvar::IL_CAN1::NODES::N_CGW2::MESSAGES::IPC_Req::TIMINGS::SelectedPeriod
{
  if (@this == 0 && @sysvar::IL_CAN1::NODES::N_CGW2::MESSAGES::IPC_Req::TIMINGS::EnableCyclic)
  {
    SetBusContext(gILCAN1_BusContext);
    gCAN1DisturbancePeriod = @sysvar::IL_CAN1::NODES::N_CGW2::MESSAGES::IPC_Req::TIMINGS::NormalCyclePeriod;
    ILFaultInjectionResetMsgCycleTime(CHASSIS1CAN::CGW2::IPC_Req);
  }
  else if (@this == 1 && @sysvar::IL_CAN1::NODES::N_CGW2::MESSAGES::IPC_Req::TIMINGS::EnableCyclic)
  {
    SetBusContext(gILCAN1_BusContext);
    gCAN1DisturbancePeriod = @sysvar::IL_CAN1::NODES::N_CGW2::MESSAGES::IPC_Req::TIMINGS::ActiveCyclePeriod;
    ILFaultInjectionSetMsgCycleTime(CHASSIS1CAN::CGW2::IPC_Req, gCAN1DisturbancePeriod);
  }
  else if (@this == -1 && @sysvar::IL_CAN1::NODES::N_CGW2::MESSAGES::IPC_Req::TIMINGS::EnableCyclic)
  {
    SetBusContext(gILCAN1_BusContext);
    gCAN1DisturbancePeriod = @sysvar::IL_CAN1::NODES::N_CGW2::MESSAGES::IPC_Req::TIMINGS::CyclePeriod;
    ILFaultInjectionSetMsgCycleTime(CHASSIS1CAN::CGW2::IPC_Req, gCAN1DisturbancePeriod);
  }
}

on sysvar_update sysvar::IL_CAN1::NODES::N_CGW2::MESSAGES::IPC_Req::TIMINGS::SendOnce
{
  if (@this == 1)
  {
    SetBusContext(gILCAN1_BusContext);
    ILSetMsgEvent(CHASSIS1CAN::CGW2::IPC_Req);
  }
}

on sysvar_update sysvar::IL_CAN1::NODES::N_CGW2::MESSAGES::ISCS_CurrPinionStat::TIMINGS::EnableCyclic
{
  if (@this == 1)
  {
    SetBusContext(gILCAN1_BusContext);
    ILFaultInjectionEnableMsg  (CHASSIS1CAN::CGW2::ISCS_CurrPinionStat);
  }
  else
  {
    SetBusContext(gILCAN1_BusContext);
    ILFaultInjectionDisableMsg (CHASSIS1CAN::CGW2::ISCS_CurrPinionStat);
  }
}

on sysvar_update sysvar::IL_CAN1::NODES::N_CGW2::MESSAGES::ISCS_CurrPinionStat::TIMINGS::SetNormalCycle
{
  if (@this == 1 && @sysvar::IL_CAN1::NODES::N_CGW2::MESSAGES::ISCS_CurrPinionStat::TIMINGS::EnableCyclic)
  {
    @sysvar::IL_CAN1::NODES::N_CGW2::MESSAGES::ISCS_CurrPinionStat::TIMINGS::SelectedPeriod = 0;
  }
}

on sysvar_update sysvar::IL_CAN1::NODES::N_CGW2::MESSAGES::ISCS_CurrPinionStat::TIMINGS::SetNewCycleContinously
{
  if (@this == 1 && @sysvar::IL_CAN1::NODES::N_CGW2::MESSAGES::ISCS_CurrPinionStat::TIMINGS::EnableCyclic)
  {
    @sysvar::IL_CAN1::NODES::N_CGW2::MESSAGES::ISCS_CurrPinionStat::TIMINGS::SelectedPeriod = -1;
  }
}

on sysvar_update sysvar::IL_CAN1::NODES::N_CGW2::MESSAGES::ISCS_CurrPinionStat::TIMINGS::SelectedPeriod
{
  if (@this == 0 && @sysvar::IL_CAN1::NODES::N_CGW2::MESSAGES::ISCS_CurrPinionStat::TIMINGS::EnableCyclic)
  {
    SetBusContext(gILCAN1_BusContext);
    gCAN1DisturbancePeriod = @sysvar::IL_CAN1::NODES::N_CGW2::MESSAGES::ISCS_CurrPinionStat::TIMINGS::NormalCyclePeriod;
    ILFaultInjectionResetMsgCycleTime(CHASSIS1CAN::CGW2::ISCS_CurrPinionStat);
  }
  else if (@this == 1 && @sysvar::IL_CAN1::NODES::N_CGW2::MESSAGES::ISCS_CurrPinionStat::TIMINGS::EnableCyclic)
  {
    SetBusContext(gILCAN1_BusContext);
    gCAN1DisturbancePeriod = @sysvar::IL_CAN1::NODES::N_CGW2::MESSAGES::ISCS_CurrPinionStat::TIMINGS::ActiveCyclePeriod;
    ILFaultInjectionSetMsgCycleTime(CHASSIS1CAN::CGW2::ISCS_CurrPinionStat, gCAN1DisturbancePeriod);
  }
  else if (@this == -1 && @sysvar::IL_CAN1::NODES::N_CGW2::MESSAGES::ISCS_CurrPinionStat::TIMINGS::EnableCyclic)
  {
    SetBusContext(gILCAN1_BusContext);
    gCAN1DisturbancePeriod = @sysvar::IL_CAN1::NODES::N_CGW2::MESSAGES::ISCS_CurrPinionStat::TIMINGS::CyclePeriod;
    ILFaultInjectionSetMsgCycleTime(CHASSIS1CAN::CGW2::ISCS_CurrPinionStat, gCAN1DisturbancePeriod);
  }
}

on sysvar_update sysvar::IL_CAN1::NODES::N_CGW2::MESSAGES::ISCS_CurrPinionStat::TIMINGS::SendOnce
{
  if (@this == 1)
  {
    SetBusContext(gILCAN1_BusContext);
    ILSetMsgEvent(CHASSIS1CAN::CGW2::ISCS_CurrPinionStat);
  }
}

on sysvar_update sysvar::IL_CAN1::NODES::N_CGW2::MESSAGES::ISCS_Info::TIMINGS::EnableCyclic
{
  if (@this == 1)
  {
    SetBusContext(gILCAN1_BusContext);
    ILFaultInjectionEnableMsg  (CHASSIS1CAN::CGW2::ISCS_Info);
  }
  else
  {
    SetBusContext(gILCAN1_BusContext);
    ILFaultInjectionDisableMsg (CHASSIS1CAN::CGW2::ISCS_Info);
  }
}

on sysvar_update sysvar::IL_CAN1::NODES::N_CGW2::MESSAGES::ISCS_Info::TIMINGS::SetNormalCycle
{
  if (@this == 1 && @sysvar::IL_CAN1::NODES::N_CGW2::MESSAGES::ISCS_Info::TIMINGS::EnableCyclic)
  {
    @sysvar::IL_CAN1::NODES::N_CGW2::MESSAGES::ISCS_Info::TIMINGS::SelectedPeriod = 0;
  }
}

on sysvar_update sysvar::IL_CAN1::NODES::N_CGW2::MESSAGES::ISCS_Info::TIMINGS::SetNewCycleContinously
{
  if (@this == 1 && @sysvar::IL_CAN1::NODES::N_CGW2::MESSAGES::ISCS_Info::TIMINGS::EnableCyclic)
  {
    @sysvar::IL_CAN1::NODES::N_CGW2::MESSAGES::ISCS_Info::TIMINGS::SelectedPeriod = -1;
  }
}

on sysvar_update sysvar::IL_CAN1::NODES::N_CGW2::MESSAGES::ISCS_Info::TIMINGS::SelectedPeriod
{
  if (@this == 0 && @sysvar::IL_CAN1::NODES::N_CGW2::MESSAGES::ISCS_Info::TIMINGS::EnableCyclic)
  {
    SetBusContext(gILCAN1_BusContext);
    gCAN1DisturbancePeriod = @sysvar::IL_CAN1::NODES::N_CGW2::MESSAGES::ISCS_Info::TIMINGS::NormalCyclePeriod;
    ILFaultInjectionResetMsgCycleTime(CHASSIS1CAN::CGW2::ISCS_Info);
  }
  else if (@this == 1 && @sysvar::IL_CAN1::NODES::N_CGW2::MESSAGES::ISCS_Info::TIMINGS::EnableCyclic)
  {
    SetBusContext(gILCAN1_BusContext);
    gCAN1DisturbancePeriod = @sysvar::IL_CAN1::NODES::N_CGW2::MESSAGES::ISCS_Info::TIMINGS::ActiveCyclePeriod;
    ILFaultInjectionSetMsgCycleTime(CHASSIS1CAN::CGW2::ISCS_Info, gCAN1DisturbancePeriod);
  }
  else if (@this == -1 && @sysvar::IL_CAN1::NODES::N_CGW2::MESSAGES::ISCS_Info::TIMINGS::EnableCyclic)
  {
    SetBusContext(gILCAN1_BusContext);
    gCAN1DisturbancePeriod = @sysvar::IL_CAN1::NODES::N_CGW2::MESSAGES::ISCS_Info::TIMINGS::CyclePeriod;
    ILFaultInjectionSetMsgCycleTime(CHASSIS1CAN::CGW2::ISCS_Info, gCAN1DisturbancePeriod);
  }
}

on sysvar_update sysvar::IL_CAN1::NODES::N_CGW2::MESSAGES::ISCS_Info::TIMINGS::SendOnce
{
  if (@this == 1)
  {
    SetBusContext(gILCAN1_BusContext);
    ILSetMsgEvent(CHASSIS1CAN::CGW2::ISCS_Info);
  }
}

on sysvar_update sysvar::IL_CAN1::NODES::N_CGW2::MESSAGES::ISCS_SteeringError_Stat::TIMINGS::EnableCyclic
{
  if (@this == 1)
  {
    SetBusContext(gILCAN1_BusContext);
    ILFaultInjectionEnableMsg  (CHASSIS1CAN::CGW2::ISCS_SteeringError_Stat);
  }
  else
  {
    SetBusContext(gILCAN1_BusContext);
    ILFaultInjectionDisableMsg (CHASSIS1CAN::CGW2::ISCS_SteeringError_Stat);
  }
}

on sysvar_update sysvar::IL_CAN1::NODES::N_CGW2::MESSAGES::ISCS_SteeringError_Stat::TIMINGS::SetNormalCycle
{
  if (@this == 1 && @sysvar::IL_CAN1::NODES::N_CGW2::MESSAGES::ISCS_SteeringError_Stat::TIMINGS::EnableCyclic)
  {
    @sysvar::IL_CAN1::NODES::N_CGW2::MESSAGES::ISCS_SteeringError_Stat::TIMINGS::SelectedPeriod = 0;
  }
}

on sysvar_update sysvar::IL_CAN1::NODES::N_CGW2::MESSAGES::ISCS_SteeringError_Stat::TIMINGS::SetNewCycleContinously
{
  if (@this == 1 && @sysvar::IL_CAN1::NODES::N_CGW2::MESSAGES::ISCS_SteeringError_Stat::TIMINGS::EnableCyclic)
  {
    @sysvar::IL_CAN1::NODES::N_CGW2::MESSAGES::ISCS_SteeringError_Stat::TIMINGS::SelectedPeriod = -1;
  }
}

on sysvar_update sysvar::IL_CAN1::NODES::N_CGW2::MESSAGES::ISCS_SteeringError_Stat::TIMINGS::SelectedPeriod
{
  if (@this == 0 && @sysvar::IL_CAN1::NODES::N_CGW2::MESSAGES::ISCS_SteeringError_Stat::TIMINGS::EnableCyclic)
  {
    SetBusContext(gILCAN1_BusContext);
    gCAN1DisturbancePeriod = @sysvar::IL_CAN1::NODES::N_CGW2::MESSAGES::ISCS_SteeringError_Stat::TIMINGS::NormalCyclePeriod;
    ILFaultInjectionResetMsgCycleTime(CHASSIS1CAN::CGW2::ISCS_SteeringError_Stat);
  }
  else if (@this == 1 && @sysvar::IL_CAN1::NODES::N_CGW2::MESSAGES::ISCS_SteeringError_Stat::TIMINGS::EnableCyclic)
  {
    SetBusContext(gILCAN1_BusContext);
    gCAN1DisturbancePeriod = @sysvar::IL_CAN1::NODES::N_CGW2::MESSAGES::ISCS_SteeringError_Stat::TIMINGS::ActiveCyclePeriod;
    ILFaultInjectionSetMsgCycleTime(CHASSIS1CAN::CGW2::ISCS_SteeringError_Stat, gCAN1DisturbancePeriod);
  }
  else if (@this == -1 && @sysvar::IL_CAN1::NODES::N_CGW2::MESSAGES::ISCS_SteeringError_Stat::TIMINGS::EnableCyclic)
  {
    SetBusContext(gILCAN1_BusContext);
    gCAN1DisturbancePeriod = @sysvar::IL_CAN1::NODES::N_CGW2::MESSAGES::ISCS_SteeringError_Stat::TIMINGS::CyclePeriod;
    ILFaultInjectionSetMsgCycleTime(CHASSIS1CAN::CGW2::ISCS_SteeringError_Stat, gCAN1DisturbancePeriod);
  }
}

on sysvar_update sysvar::IL_CAN1::NODES::N_CGW2::MESSAGES::ISCS_SteeringError_Stat::TIMINGS::SendOnce
{
  if (@this == 1)
  {
    SetBusContext(gILCAN1_BusContext);
    ILSetMsgEvent(CHASSIS1CAN::CGW2::ISCS_SteeringError_Stat);
  }
}

on sysvar_update sysvar::IL_CAN1::NODES::N_CGW2::MESSAGES::ISCS_SteerWhl_Info::TIMINGS::EnableCyclic
{
  if (@this == 1)
  {
    SetBusContext(gILCAN1_BusContext);
    ILFaultInjectionEnableMsg  (CHASSIS1CAN::CGW2::ISCS_SteerWhl_Info);
  }
  else
  {
    SetBusContext(gILCAN1_BusContext);
    ILFaultInjectionDisableMsg (CHASSIS1CAN::CGW2::ISCS_SteerWhl_Info);
  }
}

on sysvar_update sysvar::IL_CAN1::NODES::N_CGW2::MESSAGES::ISCS_SteerWhl_Info::TIMINGS::SetNormalCycle
{
  if (@this == 1 && @sysvar::IL_CAN1::NODES::N_CGW2::MESSAGES::ISCS_SteerWhl_Info::TIMINGS::EnableCyclic)
  {
    @sysvar::IL_CAN1::NODES::N_CGW2::MESSAGES::ISCS_SteerWhl_Info::TIMINGS::SelectedPeriod = 0;
  }
}

on sysvar_update sysvar::IL_CAN1::NODES::N_CGW2::MESSAGES::ISCS_SteerWhl_Info::TIMINGS::SetNewCycleContinously
{
  if (@this == 1 && @sysvar::IL_CAN1::NODES::N_CGW2::MESSAGES::ISCS_SteerWhl_Info::TIMINGS::EnableCyclic)
  {
    @sysvar::IL_CAN1::NODES::N_CGW2::MESSAGES::ISCS_SteerWhl_Info::TIMINGS::SelectedPeriod = -1;
  }
}

on sysvar_update sysvar::IL_CAN1::NODES::N_CGW2::MESSAGES::ISCS_SteerWhl_Info::TIMINGS::SelectedPeriod
{
  if (@this == 0 && @sysvar::IL_CAN1::NODES::N_CGW2::MESSAGES::ISCS_SteerWhl_Info::TIMINGS::EnableCyclic)
  {
    SetBusContext(gILCAN1_BusContext);
    gCAN1DisturbancePeriod = @sysvar::IL_CAN1::NODES::N_CGW2::MESSAGES::ISCS_SteerWhl_Info::TIMINGS::NormalCyclePeriod;
    ILFaultInjectionResetMsgCycleTime(CHASSIS1CAN::CGW2::ISCS_SteerWhl_Info);
  }
  else if (@this == 1 && @sysvar::IL_CAN1::NODES::N_CGW2::MESSAGES::ISCS_SteerWhl_Info::TIMINGS::EnableCyclic)
  {
    SetBusContext(gILCAN1_BusContext);
    gCAN1DisturbancePeriod = @sysvar::IL_CAN1::NODES::N_CGW2::MESSAGES::ISCS_SteerWhl_Info::TIMINGS::ActiveCyclePeriod;
    ILFaultInjectionSetMsgCycleTime(CHASSIS1CAN::CGW2::ISCS_SteerWhl_Info, gCAN1DisturbancePeriod);
  }
  else if (@this == -1 && @sysvar::IL_CAN1::NODES::N_CGW2::MESSAGES::ISCS_SteerWhl_Info::TIMINGS::EnableCyclic)
  {
    SetBusContext(gILCAN1_BusContext);
    gCAN1DisturbancePeriod = @sysvar::IL_CAN1::NODES::N_CGW2::MESSAGES::ISCS_SteerWhl_Info::TIMINGS::CyclePeriod;
    ILFaultInjectionSetMsgCycleTime(CHASSIS1CAN::CGW2::ISCS_SteerWhl_Info, gCAN1DisturbancePeriod);
  }
}

on sysvar_update sysvar::IL_CAN1::NODES::N_CGW2::MESSAGES::ISCS_SteerWhl_Info::TIMINGS::SendOnce
{
  if (@this == 1)
  {
    SetBusContext(gILCAN1_BusContext);
    ILSetMsgEvent(CHASSIS1CAN::CGW2::ISCS_SteerWhl_Info);
  }
}

on sysvar_update sysvar::IL_CAN1::NODES::N_CGW2::MESSAGES::MCUFastCommandResponse::TIMINGS::EnableCyclic
{
  if (@this == 1)
  {
    SetBusContext(gILCAN1_BusContext);
    ILFaultInjectionEnableMsg  (CHASSIS1CAN::CGW2::MCUFastCommandResponse);
  }
  else
  {
    SetBusContext(gILCAN1_BusContext);
    ILFaultInjectionDisableMsg (CHASSIS1CAN::CGW2::MCUFastCommandResponse);
  }
}

on sysvar_update sysvar::IL_CAN1::NODES::N_CGW2::MESSAGES::MCUFastCommandResponse::TIMINGS::SetNormalCycle
{
  if (@this == 1 && @sysvar::IL_CAN1::NODES::N_CGW2::MESSAGES::MCUFastCommandResponse::TIMINGS::EnableCyclic)
  {
    @sysvar::IL_CAN1::NODES::N_CGW2::MESSAGES::MCUFastCommandResponse::TIMINGS::SelectedPeriod = 0;
  }
}

on sysvar_update sysvar::IL_CAN1::NODES::N_CGW2::MESSAGES::MCUFastCommandResponse::TIMINGS::SetNewCycleContinously
{
  if (@this == 1 && @sysvar::IL_CAN1::NODES::N_CGW2::MESSAGES::MCUFastCommandResponse::TIMINGS::EnableCyclic)
  {
    @sysvar::IL_CAN1::NODES::N_CGW2::MESSAGES::MCUFastCommandResponse::TIMINGS::SelectedPeriod = -1;
  }
}

on sysvar_update sysvar::IL_CAN1::NODES::N_CGW2::MESSAGES::MCUFastCommandResponse::TIMINGS::SelectedPeriod
{
  if (@this == 0 && @sysvar::IL_CAN1::NODES::N_CGW2::MESSAGES::MCUFastCommandResponse::TIMINGS::EnableCyclic)
  {
    SetBusContext(gILCAN1_BusContext);
    gCAN1DisturbancePeriod = @sysvar::IL_CAN1::NODES::N_CGW2::MESSAGES::MCUFastCommandResponse::TIMINGS::NormalCyclePeriod;
    ILFaultInjectionResetMsgCycleTime(CHASSIS1CAN::CGW2::MCUFastCommandResponse);
  }
  else if (@this == 1 && @sysvar::IL_CAN1::NODES::N_CGW2::MESSAGES::MCUFastCommandResponse::TIMINGS::EnableCyclic)
  {
    SetBusContext(gILCAN1_BusContext);
    gCAN1DisturbancePeriod = @sysvar::IL_CAN1::NODES::N_CGW2::MESSAGES::MCUFastCommandResponse::TIMINGS::ActiveCyclePeriod;
    ILFaultInjectionSetMsgCycleTime(CHASSIS1CAN::CGW2::MCUFastCommandResponse, gCAN1DisturbancePeriod);
  }
  else if (@this == -1 && @sysvar::IL_CAN1::NODES::N_CGW2::MESSAGES::MCUFastCommandResponse::TIMINGS::EnableCyclic)
  {
    SetBusContext(gILCAN1_BusContext);
    gCAN1DisturbancePeriod = @sysvar::IL_CAN1::NODES::N_CGW2::MESSAGES::MCUFastCommandResponse::TIMINGS::CyclePeriod;
    ILFaultInjectionSetMsgCycleTime(CHASSIS1CAN::CGW2::MCUFastCommandResponse, gCAN1DisturbancePeriod);
  }
}

on sysvar_update sysvar::IL_CAN1::NODES::N_CGW2::MESSAGES::MCUFastCommandResponse::TIMINGS::SendOnce
{
  if (@this == 1)
  {
    SetBusContext(gILCAN1_BusContext);
    ILSetMsgEvent(CHASSIS1CAN::CGW2::MCUFastCommandResponse);
  }
}

on sysvar_update sysvar::IL_CAN1::NODES::N_CGW2::MESSAGES::NM_CGW::TIMINGS::EnableCyclic
{
  if (@this == 1)
  {
    SetBusContext(gILCAN1_BusContext);
    ILFaultInjectionEnableMsg  (CHASSIS1CAN::CGW2::NM_CGW);
  }
  else
  {
    SetBusContext(gILCAN1_BusContext);
    ILFaultInjectionDisableMsg (CHASSIS1CAN::CGW2::NM_CGW);
  }
}

on sysvar_update sysvar::IL_CAN1::NODES::N_CGW2::MESSAGES::NM_CGW::TIMINGS::SetNormalCycle
{
  if (@this == 1 && @sysvar::IL_CAN1::NODES::N_CGW2::MESSAGES::NM_CGW::TIMINGS::EnableCyclic)
  {
    @sysvar::IL_CAN1::NODES::N_CGW2::MESSAGES::NM_CGW::TIMINGS::SelectedPeriod = 0;
  }
}

on sysvar_update sysvar::IL_CAN1::NODES::N_CGW2::MESSAGES::NM_CGW::TIMINGS::SetNewCycleContinously
{
  if (@this == 1 && @sysvar::IL_CAN1::NODES::N_CGW2::MESSAGES::NM_CGW::TIMINGS::EnableCyclic)
  {
    @sysvar::IL_CAN1::NODES::N_CGW2::MESSAGES::NM_CGW::TIMINGS::SelectedPeriod = -1;
  }
}

on sysvar_update sysvar::IL_CAN1::NODES::N_CGW2::MESSAGES::NM_CGW::TIMINGS::SelectedPeriod
{
  if (@this == 0 && @sysvar::IL_CAN1::NODES::N_CGW2::MESSAGES::NM_CGW::TIMINGS::EnableCyclic)
  {
    SetBusContext(gILCAN1_BusContext);
    gCAN1DisturbancePeriod = @sysvar::IL_CAN1::NODES::N_CGW2::MESSAGES::NM_CGW::TIMINGS::NormalCyclePeriod;
    ILFaultInjectionResetMsgCycleTime(CHASSIS1CAN::CGW2::NM_CGW);
  }
  else if (@this == 1 && @sysvar::IL_CAN1::NODES::N_CGW2::MESSAGES::NM_CGW::TIMINGS::EnableCyclic)
  {
    SetBusContext(gILCAN1_BusContext);
    gCAN1DisturbancePeriod = @sysvar::IL_CAN1::NODES::N_CGW2::MESSAGES::NM_CGW::TIMINGS::ActiveCyclePeriod;
    ILFaultInjectionSetMsgCycleTime(CHASSIS1CAN::CGW2::NM_CGW, gCAN1DisturbancePeriod);
  }
  else if (@this == -1 && @sysvar::IL_CAN1::NODES::N_CGW2::MESSAGES::NM_CGW::TIMINGS::EnableCyclic)
  {
    SetBusContext(gILCAN1_BusContext);
    gCAN1DisturbancePeriod = @sysvar::IL_CAN1::NODES::N_CGW2::MESSAGES::NM_CGW::TIMINGS::CyclePeriod;
    ILFaultInjectionSetMsgCycleTime(CHASSIS1CAN::CGW2::NM_CGW, gCAN1DisturbancePeriod);
  }
}

on sysvar_update sysvar::IL_CAN1::NODES::N_CGW2::MESSAGES::NM_CGW::TIMINGS::SendOnce
{
  if (@this == 1)
  {
    SetBusContext(gILCAN1_BusContext);
    ILSetMsgEvent(CHASSIS1CAN::CGW2::NM_CGW);
  }
}

on sysvar_update sysvar::IL_CAN1::NODES::N_CGW2::MESSAGES::PCU_Msg_VCU::TIMINGS::EnableCyclic
{
  if (@this == 1)
  {
    SetBusContext(gILCAN1_BusContext);
    ILFaultInjectionEnableMsg  (CHASSIS1CAN::CGW2::PCU_Msg_VCU);
  }
  else
  {
    SetBusContext(gILCAN1_BusContext);
    ILFaultInjectionDisableMsg (CHASSIS1CAN::CGW2::PCU_Msg_VCU);
  }
}

on sysvar_update sysvar::IL_CAN1::NODES::N_CGW2::MESSAGES::PCU_Msg_VCU::TIMINGS::SetNormalCycle
{
  if (@this == 1 && @sysvar::IL_CAN1::NODES::N_CGW2::MESSAGES::PCU_Msg_VCU::TIMINGS::EnableCyclic)
  {
    @sysvar::IL_CAN1::NODES::N_CGW2::MESSAGES::PCU_Msg_VCU::TIMINGS::SelectedPeriod = 0;
  }
}

on sysvar_update sysvar::IL_CAN1::NODES::N_CGW2::MESSAGES::PCU_Msg_VCU::TIMINGS::SetNewCycleContinously
{
  if (@this == 1 && @sysvar::IL_CAN1::NODES::N_CGW2::MESSAGES::PCU_Msg_VCU::TIMINGS::EnableCyclic)
  {
    @sysvar::IL_CAN1::NODES::N_CGW2::MESSAGES::PCU_Msg_VCU::TIMINGS::SelectedPeriod = -1;
  }
}

on sysvar_update sysvar::IL_CAN1::NODES::N_CGW2::MESSAGES::PCU_Msg_VCU::TIMINGS::SelectedPeriod
{
  if (@this == 0 && @sysvar::IL_CAN1::NODES::N_CGW2::MESSAGES::PCU_Msg_VCU::TIMINGS::EnableCyclic)
  {
    SetBusContext(gILCAN1_BusContext);
    gCAN1DisturbancePeriod = @sysvar::IL_CAN1::NODES::N_CGW2::MESSAGES::PCU_Msg_VCU::TIMINGS::NormalCyclePeriod;
    ILFaultInjectionResetMsgCycleTime(CHASSIS1CAN::CGW2::PCU_Msg_VCU);
  }
  else if (@this == 1 && @sysvar::IL_CAN1::NODES::N_CGW2::MESSAGES::PCU_Msg_VCU::TIMINGS::EnableCyclic)
  {
    SetBusContext(gILCAN1_BusContext);
    gCAN1DisturbancePeriod = @sysvar::IL_CAN1::NODES::N_CGW2::MESSAGES::PCU_Msg_VCU::TIMINGS::ActiveCyclePeriod;
    ILFaultInjectionSetMsgCycleTime(CHASSIS1CAN::CGW2::PCU_Msg_VCU, gCAN1DisturbancePeriod);
  }
  else if (@this == -1 && @sysvar::IL_CAN1::NODES::N_CGW2::MESSAGES::PCU_Msg_VCU::TIMINGS::EnableCyclic)
  {
    SetBusContext(gILCAN1_BusContext);
    gCAN1DisturbancePeriod = @sysvar::IL_CAN1::NODES::N_CGW2::MESSAGES::PCU_Msg_VCU::TIMINGS::CyclePeriod;
    ILFaultInjectionSetMsgCycleTime(CHASSIS1CAN::CGW2::PCU_Msg_VCU, gCAN1DisturbancePeriod);
  }
}

on sysvar_update sysvar::IL_CAN1::NODES::N_CGW2::MESSAGES::PCU_Msg_VCU::TIMINGS::SendOnce
{
  if (@this == 1)
  {
    SetBusContext(gILCAN1_BusContext);
    ILSetMsgEvent(CHASSIS1CAN::CGW2::PCU_Msg_VCU);
  }
}

on sysvar_update sysvar::IL_CAN1::NODES::N_CGW2::MESSAGES::SDS_CtrlSteeringWheel_Prim::TIMINGS::EnableCyclic
{
  if (@this == 1)
  {
    SetBusContext(gILCAN1_BusContext);
    ILFaultInjectionEnableMsg  (CHASSIS1CAN::CGW2::SDS_CtrlSteeringWheel_Prim);
  }
  else
  {
    SetBusContext(gILCAN1_BusContext);
    ILFaultInjectionDisableMsg (CHASSIS1CAN::CGW2::SDS_CtrlSteeringWheel_Prim);
  }
}

on sysvar_update sysvar::IL_CAN1::NODES::N_CGW2::MESSAGES::SDS_CtrlSteeringWheel_Prim::TIMINGS::SetNormalCycle
{
  if (@this == 1 && @sysvar::IL_CAN1::NODES::N_CGW2::MESSAGES::SDS_CtrlSteeringWheel_Prim::TIMINGS::EnableCyclic)
  {
    @sysvar::IL_CAN1::NODES::N_CGW2::MESSAGES::SDS_CtrlSteeringWheel_Prim::TIMINGS::SelectedPeriod = 0;
  }
}

on sysvar_update sysvar::IL_CAN1::NODES::N_CGW2::MESSAGES::SDS_CtrlSteeringWheel_Prim::TIMINGS::SetNewCycleContinously
{
  if (@this == 1 && @sysvar::IL_CAN1::NODES::N_CGW2::MESSAGES::SDS_CtrlSteeringWheel_Prim::TIMINGS::EnableCyclic)
  {
    @sysvar::IL_CAN1::NODES::N_CGW2::MESSAGES::SDS_CtrlSteeringWheel_Prim::TIMINGS::SelectedPeriod = -1;
  }
}

on sysvar_update sysvar::IL_CAN1::NODES::N_CGW2::MESSAGES::SDS_CtrlSteeringWheel_Prim::TIMINGS::SelectedPeriod
{
  if (@this == 0 && @sysvar::IL_CAN1::NODES::N_CGW2::MESSAGES::SDS_CtrlSteeringWheel_Prim::TIMINGS::EnableCyclic)
  {
    SetBusContext(gILCAN1_BusContext);
    gCAN1DisturbancePeriod = @sysvar::IL_CAN1::NODES::N_CGW2::MESSAGES::SDS_CtrlSteeringWheel_Prim::TIMINGS::NormalCyclePeriod;
    ILFaultInjectionResetMsgCycleTime(CHASSIS1CAN::CGW2::SDS_CtrlSteeringWheel_Prim);
  }
  else if (@this == 1 && @sysvar::IL_CAN1::NODES::N_CGW2::MESSAGES::SDS_CtrlSteeringWheel_Prim::TIMINGS::EnableCyclic)
  {
    SetBusContext(gILCAN1_BusContext);
    gCAN1DisturbancePeriod = @sysvar::IL_CAN1::NODES::N_CGW2::MESSAGES::SDS_CtrlSteeringWheel_Prim::TIMINGS::ActiveCyclePeriod;
    ILFaultInjectionSetMsgCycleTime(CHASSIS1CAN::CGW2::SDS_CtrlSteeringWheel_Prim, gCAN1DisturbancePeriod);
  }
  else if (@this == -1 && @sysvar::IL_CAN1::NODES::N_CGW2::MESSAGES::SDS_CtrlSteeringWheel_Prim::TIMINGS::EnableCyclic)
  {
    SetBusContext(gILCAN1_BusContext);
    gCAN1DisturbancePeriod = @sysvar::IL_CAN1::NODES::N_CGW2::MESSAGES::SDS_CtrlSteeringWheel_Prim::TIMINGS::CyclePeriod;
    ILFaultInjectionSetMsgCycleTime(CHASSIS1CAN::CGW2::SDS_CtrlSteeringWheel_Prim, gCAN1DisturbancePeriod);
  }
}

on sysvar_update sysvar::IL_CAN1::NODES::N_CGW2::MESSAGES::SDS_CtrlSteeringWheel_Prim::TIMINGS::SendOnce
{
  if (@this == 1)
  {
    SetBusContext(gILCAN1_BusContext);
    ILSetMsgEvent(CHASSIS1CAN::CGW2::SDS_CtrlSteeringWheel_Prim);
  }
}

on sysvar_update sysvar::IL_CAN1::NODES::N_CGW2::MESSAGES::SDS_Stability_Info_Prim::TIMINGS::EnableCyclic
{
  if (@this == 1)
  {
    SetBusContext(gILCAN1_BusContext);
    ILFaultInjectionEnableMsg  (CHASSIS1CAN::CGW2::SDS_Stability_Info_Prim);
  }
  else
  {
    SetBusContext(gILCAN1_BusContext);
    ILFaultInjectionDisableMsg (CHASSIS1CAN::CGW2::SDS_Stability_Info_Prim);
  }
}

on sysvar_update sysvar::IL_CAN1::NODES::N_CGW2::MESSAGES::SDS_Stability_Info_Prim::TIMINGS::SetNormalCycle
{
  if (@this == 1 && @sysvar::IL_CAN1::NODES::N_CGW2::MESSAGES::SDS_Stability_Info_Prim::TIMINGS::EnableCyclic)
  {
    @sysvar::IL_CAN1::NODES::N_CGW2::MESSAGES::SDS_Stability_Info_Prim::TIMINGS::SelectedPeriod = 0;
  }
}

on sysvar_update sysvar::IL_CAN1::NODES::N_CGW2::MESSAGES::SDS_Stability_Info_Prim::TIMINGS::SetNewCycleContinously
{
  if (@this == 1 && @sysvar::IL_CAN1::NODES::N_CGW2::MESSAGES::SDS_Stability_Info_Prim::TIMINGS::EnableCyclic)
  {
    @sysvar::IL_CAN1::NODES::N_CGW2::MESSAGES::SDS_Stability_Info_Prim::TIMINGS::SelectedPeriod = -1;
  }
}

on sysvar_update sysvar::IL_CAN1::NODES::N_CGW2::MESSAGES::SDS_Stability_Info_Prim::TIMINGS::SelectedPeriod
{
  if (@this == 0 && @sysvar::IL_CAN1::NODES::N_CGW2::MESSAGES::SDS_Stability_Info_Prim::TIMINGS::EnableCyclic)
  {
    SetBusContext(gILCAN1_BusContext);
    gCAN1DisturbancePeriod = @sysvar::IL_CAN1::NODES::N_CGW2::MESSAGES::SDS_Stability_Info_Prim::TIMINGS::NormalCyclePeriod;
    ILFaultInjectionResetMsgCycleTime(CHASSIS1CAN::CGW2::SDS_Stability_Info_Prim);
  }
  else if (@this == 1 && @sysvar::IL_CAN1::NODES::N_CGW2::MESSAGES::SDS_Stability_Info_Prim::TIMINGS::EnableCyclic)
  {
    SetBusContext(gILCAN1_BusContext);
    gCAN1DisturbancePeriod = @sysvar::IL_CAN1::NODES::N_CGW2::MESSAGES::SDS_Stability_Info_Prim::TIMINGS::ActiveCyclePeriod;
    ILFaultInjectionSetMsgCycleTime(CHASSIS1CAN::CGW2::SDS_Stability_Info_Prim, gCAN1DisturbancePeriod);
  }
  else if (@this == -1 && @sysvar::IL_CAN1::NODES::N_CGW2::MESSAGES::SDS_Stability_Info_Prim::TIMINGS::EnableCyclic)
  {
    SetBusContext(gILCAN1_BusContext);
    gCAN1DisturbancePeriod = @sysvar::IL_CAN1::NODES::N_CGW2::MESSAGES::SDS_Stability_Info_Prim::TIMINGS::CyclePeriod;
    ILFaultInjectionSetMsgCycleTime(CHASSIS1CAN::CGW2::SDS_Stability_Info_Prim, gCAN1DisturbancePeriod);
  }
}

on sysvar_update sysvar::IL_CAN1::NODES::N_CGW2::MESSAGES::SDS_Stability_Info_Prim::TIMINGS::SendOnce
{
  if (@this == 1)
  {
    SetBusContext(gILCAN1_BusContext);
    ILSetMsgEvent(CHASSIS1CAN::CGW2::SDS_Stability_Info_Prim);
  }
}

on sysvar_update sysvar::IL_CAN1::NODES::N_CGW2::MESSAGES::SDS_Status_Prim::TIMINGS::EnableCyclic
{
  if (@this == 1)
  {
    SetBusContext(gILCAN1_BusContext);
    ILFaultInjectionEnableMsg  (CHASSIS1CAN::CGW2::SDS_Status_Prim);
  }
  else
  {
    SetBusContext(gILCAN1_BusContext);
    ILFaultInjectionDisableMsg (CHASSIS1CAN::CGW2::SDS_Status_Prim);
  }
}

on sysvar_update sysvar::IL_CAN1::NODES::N_CGW2::MESSAGES::SDS_Status_Prim::TIMINGS::SetNormalCycle
{
  if (@this == 1 && @sysvar::IL_CAN1::NODES::N_CGW2::MESSAGES::SDS_Status_Prim::TIMINGS::EnableCyclic)
  {
    @sysvar::IL_CAN1::NODES::N_CGW2::MESSAGES::SDS_Status_Prim::TIMINGS::SelectedPeriod = 0;
  }
}

on sysvar_update sysvar::IL_CAN1::NODES::N_CGW2::MESSAGES::SDS_Status_Prim::TIMINGS::SetNewCycleContinously
{
  if (@this == 1 && @sysvar::IL_CAN1::NODES::N_CGW2::MESSAGES::SDS_Status_Prim::TIMINGS::EnableCyclic)
  {
    @sysvar::IL_CAN1::NODES::N_CGW2::MESSAGES::SDS_Status_Prim::TIMINGS::SelectedPeriod = -1;
  }
}

on sysvar_update sysvar::IL_CAN1::NODES::N_CGW2::MESSAGES::SDS_Status_Prim::TIMINGS::SelectedPeriod
{
  if (@this == 0 && @sysvar::IL_CAN1::NODES::N_CGW2::MESSAGES::SDS_Status_Prim::TIMINGS::EnableCyclic)
  {
    SetBusContext(gILCAN1_BusContext);
    gCAN1DisturbancePeriod = @sysvar::IL_CAN1::NODES::N_CGW2::MESSAGES::SDS_Status_Prim::TIMINGS::NormalCyclePeriod;
    ILFaultInjectionResetMsgCycleTime(CHASSIS1CAN::CGW2::SDS_Status_Prim);
  }
  else if (@this == 1 && @sysvar::IL_CAN1::NODES::N_CGW2::MESSAGES::SDS_Status_Prim::TIMINGS::EnableCyclic)
  {
    SetBusContext(gILCAN1_BusContext);
    gCAN1DisturbancePeriod = @sysvar::IL_CAN1::NODES::N_CGW2::MESSAGES::SDS_Status_Prim::TIMINGS::ActiveCyclePeriod;
    ILFaultInjectionSetMsgCycleTime(CHASSIS1CAN::CGW2::SDS_Status_Prim, gCAN1DisturbancePeriod);
  }
  else if (@this == -1 && @sysvar::IL_CAN1::NODES::N_CGW2::MESSAGES::SDS_Status_Prim::TIMINGS::EnableCyclic)
  {
    SetBusContext(gILCAN1_BusContext);
    gCAN1DisturbancePeriod = @sysvar::IL_CAN1::NODES::N_CGW2::MESSAGES::SDS_Status_Prim::TIMINGS::CyclePeriod;
    ILFaultInjectionSetMsgCycleTime(CHASSIS1CAN::CGW2::SDS_Status_Prim, gCAN1DisturbancePeriod);
  }
}

on sysvar_update sysvar::IL_CAN1::NODES::N_CGW2::MESSAGES::SDS_Status_Prim::TIMINGS::SendOnce
{
  if (@this == 1)
  {
    SetBusContext(gILCAN1_BusContext);
    ILSetMsgEvent(CHASSIS1CAN::CGW2::SDS_Status_Prim);
  }
}

on sysvar_update sysvar::IL_CAN1::NODES::N_CGW2::MESSAGES::TCU_AltPositionReq::TIMINGS::EnableCyclic
{
  if (@this == 1)
  {
    SetBusContext(gILCAN1_BusContext);
    ILFaultInjectionEnableMsg  (CHASSIS1CAN::CGW2::TCU_AltPositionReq);
  }
  else
  {
    SetBusContext(gILCAN1_BusContext);
    ILFaultInjectionDisableMsg (CHASSIS1CAN::CGW2::TCU_AltPositionReq);
  }
}

on sysvar_update sysvar::IL_CAN1::NODES::N_CGW2::MESSAGES::TCU_AltPositionReq::TIMINGS::SetNormalCycle
{
  if (@this == 1 && @sysvar::IL_CAN1::NODES::N_CGW2::MESSAGES::TCU_AltPositionReq::TIMINGS::EnableCyclic)
  {
    @sysvar::IL_CAN1::NODES::N_CGW2::MESSAGES::TCU_AltPositionReq::TIMINGS::SelectedPeriod = 0;
  }
}

on sysvar_update sysvar::IL_CAN1::NODES::N_CGW2::MESSAGES::TCU_AltPositionReq::TIMINGS::SetNewCycleContinously
{
  if (@this == 1 && @sysvar::IL_CAN1::NODES::N_CGW2::MESSAGES::TCU_AltPositionReq::TIMINGS::EnableCyclic)
  {
    @sysvar::IL_CAN1::NODES::N_CGW2::MESSAGES::TCU_AltPositionReq::TIMINGS::SelectedPeriod = -1;
  }
}

on sysvar_update sysvar::IL_CAN1::NODES::N_CGW2::MESSAGES::TCU_AltPositionReq::TIMINGS::SelectedPeriod
{
  if (@this == 0 && @sysvar::IL_CAN1::NODES::N_CGW2::MESSAGES::TCU_AltPositionReq::TIMINGS::EnableCyclic)
  {
    SetBusContext(gILCAN1_BusContext);
    gCAN1DisturbancePeriod = @sysvar::IL_CAN1::NODES::N_CGW2::MESSAGES::TCU_AltPositionReq::TIMINGS::NormalCyclePeriod;
    ILFaultInjectionResetMsgCycleTime(CHASSIS1CAN::CGW2::TCU_AltPositionReq);
  }
  else if (@this == 1 && @sysvar::IL_CAN1::NODES::N_CGW2::MESSAGES::TCU_AltPositionReq::TIMINGS::EnableCyclic)
  {
    SetBusContext(gILCAN1_BusContext);
    gCAN1DisturbancePeriod = @sysvar::IL_CAN1::NODES::N_CGW2::MESSAGES::TCU_AltPositionReq::TIMINGS::ActiveCyclePeriod;
    ILFaultInjectionSetMsgCycleTime(CHASSIS1CAN::CGW2::TCU_AltPositionReq, gCAN1DisturbancePeriod);
  }
  else if (@this == -1 && @sysvar::IL_CAN1::NODES::N_CGW2::MESSAGES::TCU_AltPositionReq::TIMINGS::EnableCyclic)
  {
    SetBusContext(gILCAN1_BusContext);
    gCAN1DisturbancePeriod = @sysvar::IL_CAN1::NODES::N_CGW2::MESSAGES::TCU_AltPositionReq::TIMINGS::CyclePeriod;
    ILFaultInjectionSetMsgCycleTime(CHASSIS1CAN::CGW2::TCU_AltPositionReq, gCAN1DisturbancePeriod);
  }
}

on sysvar_update sysvar::IL_CAN1::NODES::N_CGW2::MESSAGES::TCU_AltPositionReq::TIMINGS::SendOnce
{
  if (@this == 1)
  {
    SetBusContext(gILCAN1_BusContext);
    ILSetMsgEvent(CHASSIS1CAN::CGW2::TCU_AltPositionReq);
  }
}

on sysvar_update sysvar::IL_CAN1::NODES::N_CGW2::MESSAGES::TCU_FuncReq2::TIMINGS::EnableCyclic
{
  if (@this == 1)
  {
    SetBusContext(gILCAN1_BusContext);
    ILFaultInjectionEnableMsg  (CHASSIS1CAN::CGW2::TCU_FuncReq2);
  }
  else
  {
    SetBusContext(gILCAN1_BusContext);
    ILFaultInjectionDisableMsg (CHASSIS1CAN::CGW2::TCU_FuncReq2);
  }
}

on sysvar_update sysvar::IL_CAN1::NODES::N_CGW2::MESSAGES::TCU_FuncReq2::TIMINGS::SetNormalCycle
{
  if (@this == 1 && @sysvar::IL_CAN1::NODES::N_CGW2::MESSAGES::TCU_FuncReq2::TIMINGS::EnableCyclic)
  {
    @sysvar::IL_CAN1::NODES::N_CGW2::MESSAGES::TCU_FuncReq2::TIMINGS::SelectedPeriod = 0;
  }
}

on sysvar_update sysvar::IL_CAN1::NODES::N_CGW2::MESSAGES::TCU_FuncReq2::TIMINGS::SetNewCycleContinously
{
  if (@this == 1 && @sysvar::IL_CAN1::NODES::N_CGW2::MESSAGES::TCU_FuncReq2::TIMINGS::EnableCyclic)
  {
    @sysvar::IL_CAN1::NODES::N_CGW2::MESSAGES::TCU_FuncReq2::TIMINGS::SelectedPeriod = -1;
  }
}

on sysvar_update sysvar::IL_CAN1::NODES::N_CGW2::MESSAGES::TCU_FuncReq2::TIMINGS::SelectedPeriod
{
  if (@this == 0 && @sysvar::IL_CAN1::NODES::N_CGW2::MESSAGES::TCU_FuncReq2::TIMINGS::EnableCyclic)
  {
    SetBusContext(gILCAN1_BusContext);
    gCAN1DisturbancePeriod = @sysvar::IL_CAN1::NODES::N_CGW2::MESSAGES::TCU_FuncReq2::TIMINGS::NormalCyclePeriod;
    ILFaultInjectionResetMsgCycleTime(CHASSIS1CAN::CGW2::TCU_FuncReq2);
  }
  else if (@this == 1 && @sysvar::IL_CAN1::NODES::N_CGW2::MESSAGES::TCU_FuncReq2::TIMINGS::EnableCyclic)
  {
    SetBusContext(gILCAN1_BusContext);
    gCAN1DisturbancePeriod = @sysvar::IL_CAN1::NODES::N_CGW2::MESSAGES::TCU_FuncReq2::TIMINGS::ActiveCyclePeriod;
    ILFaultInjectionSetMsgCycleTime(CHASSIS1CAN::CGW2::TCU_FuncReq2, gCAN1DisturbancePeriod);
  }
  else if (@this == -1 && @sysvar::IL_CAN1::NODES::N_CGW2::MESSAGES::TCU_FuncReq2::TIMINGS::EnableCyclic)
  {
    SetBusContext(gILCAN1_BusContext);
    gCAN1DisturbancePeriod = @sysvar::IL_CAN1::NODES::N_CGW2::MESSAGES::TCU_FuncReq2::TIMINGS::CyclePeriod;
    ILFaultInjectionSetMsgCycleTime(CHASSIS1CAN::CGW2::TCU_FuncReq2, gCAN1DisturbancePeriod);
  }
}

on sysvar_update sysvar::IL_CAN1::NODES::N_CGW2::MESSAGES::TCU_FuncReq2::TIMINGS::SendOnce
{
  if (@this == 1)
  {
    SetBusContext(gILCAN1_BusContext);
    ILSetMsgEvent(CHASSIS1CAN::CGW2::TCU_FuncReq2);
  }
}

on sysvar_update sysvar::IL_CAN1::NODES::N_CGW2::MESSAGES::TCU_LatPositionReq::TIMINGS::EnableCyclic
{
  if (@this == 1)
  {
    SetBusContext(gILCAN1_BusContext);
    ILFaultInjectionEnableMsg  (CHASSIS1CAN::CGW2::TCU_LatPositionReq);
  }
  else
  {
    SetBusContext(gILCAN1_BusContext);
    ILFaultInjectionDisableMsg (CHASSIS1CAN::CGW2::TCU_LatPositionReq);
  }
}

on sysvar_update sysvar::IL_CAN1::NODES::N_CGW2::MESSAGES::TCU_LatPositionReq::TIMINGS::SetNormalCycle
{
  if (@this == 1 && @sysvar::IL_CAN1::NODES::N_CGW2::MESSAGES::TCU_LatPositionReq::TIMINGS::EnableCyclic)
  {
    @sysvar::IL_CAN1::NODES::N_CGW2::MESSAGES::TCU_LatPositionReq::TIMINGS::SelectedPeriod = 0;
  }
}

on sysvar_update sysvar::IL_CAN1::NODES::N_CGW2::MESSAGES::TCU_LatPositionReq::TIMINGS::SetNewCycleContinously
{
  if (@this == 1 && @sysvar::IL_CAN1::NODES::N_CGW2::MESSAGES::TCU_LatPositionReq::TIMINGS::EnableCyclic)
  {
    @sysvar::IL_CAN1::NODES::N_CGW2::MESSAGES::TCU_LatPositionReq::TIMINGS::SelectedPeriod = -1;
  }
}

on sysvar_update sysvar::IL_CAN1::NODES::N_CGW2::MESSAGES::TCU_LatPositionReq::TIMINGS::SelectedPeriod
{
  if (@this == 0 && @sysvar::IL_CAN1::NODES::N_CGW2::MESSAGES::TCU_LatPositionReq::TIMINGS::EnableCyclic)
  {
    SetBusContext(gILCAN1_BusContext);
    gCAN1DisturbancePeriod = @sysvar::IL_CAN1::NODES::N_CGW2::MESSAGES::TCU_LatPositionReq::TIMINGS::NormalCyclePeriod;
    ILFaultInjectionResetMsgCycleTime(CHASSIS1CAN::CGW2::TCU_LatPositionReq);
  }
  else if (@this == 1 && @sysvar::IL_CAN1::NODES::N_CGW2::MESSAGES::TCU_LatPositionReq::TIMINGS::EnableCyclic)
  {
    SetBusContext(gILCAN1_BusContext);
    gCAN1DisturbancePeriod = @sysvar::IL_CAN1::NODES::N_CGW2::MESSAGES::TCU_LatPositionReq::TIMINGS::ActiveCyclePeriod;
    ILFaultInjectionSetMsgCycleTime(CHASSIS1CAN::CGW2::TCU_LatPositionReq, gCAN1DisturbancePeriod);
  }
  else if (@this == -1 && @sysvar::IL_CAN1::NODES::N_CGW2::MESSAGES::TCU_LatPositionReq::TIMINGS::EnableCyclic)
  {
    SetBusContext(gILCAN1_BusContext);
    gCAN1DisturbancePeriod = @sysvar::IL_CAN1::NODES::N_CGW2::MESSAGES::TCU_LatPositionReq::TIMINGS::CyclePeriod;
    ILFaultInjectionSetMsgCycleTime(CHASSIS1CAN::CGW2::TCU_LatPositionReq, gCAN1DisturbancePeriod);
  }
}

on sysvar_update sysvar::IL_CAN1::NODES::N_CGW2::MESSAGES::TCU_LatPositionReq::TIMINGS::SendOnce
{
  if (@this == 1)
  {
    SetBusContext(gILCAN1_BusContext);
    ILSetMsgEvent(CHASSIS1CAN::CGW2::TCU_LatPositionReq);
  }
}

on sysvar_update sysvar::IL_CAN1::NODES::N_CGW2::MESSAGES::TCU_LongPositionReq::TIMINGS::EnableCyclic
{
  if (@this == 1)
  {
    SetBusContext(gILCAN1_BusContext);
    ILFaultInjectionEnableMsg  (CHASSIS1CAN::CGW2::TCU_LongPositionReq);
  }
  else
  {
    SetBusContext(gILCAN1_BusContext);
    ILFaultInjectionDisableMsg (CHASSIS1CAN::CGW2::TCU_LongPositionReq);
  }
}

on sysvar_update sysvar::IL_CAN1::NODES::N_CGW2::MESSAGES::TCU_LongPositionReq::TIMINGS::SetNormalCycle
{
  if (@this == 1 && @sysvar::IL_CAN1::NODES::N_CGW2::MESSAGES::TCU_LongPositionReq::TIMINGS::EnableCyclic)
  {
    @sysvar::IL_CAN1::NODES::N_CGW2::MESSAGES::TCU_LongPositionReq::TIMINGS::SelectedPeriod = 0;
  }
}

on sysvar_update sysvar::IL_CAN1::NODES::N_CGW2::MESSAGES::TCU_LongPositionReq::TIMINGS::SetNewCycleContinously
{
  if (@this == 1 && @sysvar::IL_CAN1::NODES::N_CGW2::MESSAGES::TCU_LongPositionReq::TIMINGS::EnableCyclic)
  {
    @sysvar::IL_CAN1::NODES::N_CGW2::MESSAGES::TCU_LongPositionReq::TIMINGS::SelectedPeriod = -1;
  }
}

on sysvar_update sysvar::IL_CAN1::NODES::N_CGW2::MESSAGES::TCU_LongPositionReq::TIMINGS::SelectedPeriod
{
  if (@this == 0 && @sysvar::IL_CAN1::NODES::N_CGW2::MESSAGES::TCU_LongPositionReq::TIMINGS::EnableCyclic)
  {
    SetBusContext(gILCAN1_BusContext);
    gCAN1DisturbancePeriod = @sysvar::IL_CAN1::NODES::N_CGW2::MESSAGES::TCU_LongPositionReq::TIMINGS::NormalCyclePeriod;
    ILFaultInjectionResetMsgCycleTime(CHASSIS1CAN::CGW2::TCU_LongPositionReq);
  }
  else if (@this == 1 && @sysvar::IL_CAN1::NODES::N_CGW2::MESSAGES::TCU_LongPositionReq::TIMINGS::EnableCyclic)
  {
    SetBusContext(gILCAN1_BusContext);
    gCAN1DisturbancePeriod = @sysvar::IL_CAN1::NODES::N_CGW2::MESSAGES::TCU_LongPositionReq::TIMINGS::ActiveCyclePeriod;
    ILFaultInjectionSetMsgCycleTime(CHASSIS1CAN::CGW2::TCU_LongPositionReq, gCAN1DisturbancePeriod);
  }
  else if (@this == -1 && @sysvar::IL_CAN1::NODES::N_CGW2::MESSAGES::TCU_LongPositionReq::TIMINGS::EnableCyclic)
  {
    SetBusContext(gILCAN1_BusContext);
    gCAN1DisturbancePeriod = @sysvar::IL_CAN1::NODES::N_CGW2::MESSAGES::TCU_LongPositionReq::TIMINGS::CyclePeriod;
    ILFaultInjectionSetMsgCycleTime(CHASSIS1CAN::CGW2::TCU_LongPositionReq, gCAN1DisturbancePeriod);
  }
}

on sysvar_update sysvar::IL_CAN1::NODES::N_CGW2::MESSAGES::TCU_LongPositionReq::TIMINGS::SendOnce
{
  if (@this == 1)
  {
    SetBusContext(gILCAN1_BusContext);
    ILSetMsgEvent(CHASSIS1CAN::CGW2::TCU_LongPositionReq);
  }
}

on sysvar_update sysvar::IL_CAN1::NODES::N_CGW2::MESSAGES::TCU_PositionReq1::TIMINGS::EnableCyclic
{
  if (@this == 1)
  {
    SetBusContext(gILCAN1_BusContext);
    ILFaultInjectionEnableMsg  (CHASSIS1CAN::CGW2::TCU_PositionReq1);
  }
  else
  {
    SetBusContext(gILCAN1_BusContext);
    ILFaultInjectionDisableMsg (CHASSIS1CAN::CGW2::TCU_PositionReq1);
  }
}

on sysvar_update sysvar::IL_CAN1::NODES::N_CGW2::MESSAGES::TCU_PositionReq1::TIMINGS::SetNormalCycle
{
  if (@this == 1 && @sysvar::IL_CAN1::NODES::N_CGW2::MESSAGES::TCU_PositionReq1::TIMINGS::EnableCyclic)
  {
    @sysvar::IL_CAN1::NODES::N_CGW2::MESSAGES::TCU_PositionReq1::TIMINGS::SelectedPeriod = 0;
  }
}

on sysvar_update sysvar::IL_CAN1::NODES::N_CGW2::MESSAGES::TCU_PositionReq1::TIMINGS::SetNewCycleContinously
{
  if (@this == 1 && @sysvar::IL_CAN1::NODES::N_CGW2::MESSAGES::TCU_PositionReq1::TIMINGS::EnableCyclic)
  {
    @sysvar::IL_CAN1::NODES::N_CGW2::MESSAGES::TCU_PositionReq1::TIMINGS::SelectedPeriod = -1;
  }
}

on sysvar_update sysvar::IL_CAN1::NODES::N_CGW2::MESSAGES::TCU_PositionReq1::TIMINGS::SelectedPeriod
{
  if (@this == 0 && @sysvar::IL_CAN1::NODES::N_CGW2::MESSAGES::TCU_PositionReq1::TIMINGS::EnableCyclic)
  {
    SetBusContext(gILCAN1_BusContext);
    gCAN1DisturbancePeriod = @sysvar::IL_CAN1::NODES::N_CGW2::MESSAGES::TCU_PositionReq1::TIMINGS::NormalCyclePeriod;
    ILFaultInjectionResetMsgCycleTime(CHASSIS1CAN::CGW2::TCU_PositionReq1);
  }
  else if (@this == 1 && @sysvar::IL_CAN1::NODES::N_CGW2::MESSAGES::TCU_PositionReq1::TIMINGS::EnableCyclic)
  {
    SetBusContext(gILCAN1_BusContext);
    gCAN1DisturbancePeriod = @sysvar::IL_CAN1::NODES::N_CGW2::MESSAGES::TCU_PositionReq1::TIMINGS::ActiveCyclePeriod;
    ILFaultInjectionSetMsgCycleTime(CHASSIS1CAN::CGW2::TCU_PositionReq1, gCAN1DisturbancePeriod);
  }
  else if (@this == -1 && @sysvar::IL_CAN1::NODES::N_CGW2::MESSAGES::TCU_PositionReq1::TIMINGS::EnableCyclic)
  {
    SetBusContext(gILCAN1_BusContext);
    gCAN1DisturbancePeriod = @sysvar::IL_CAN1::NODES::N_CGW2::MESSAGES::TCU_PositionReq1::TIMINGS::CyclePeriod;
    ILFaultInjectionSetMsgCycleTime(CHASSIS1CAN::CGW2::TCU_PositionReq1, gCAN1DisturbancePeriod);
  }
}

on sysvar_update sysvar::IL_CAN1::NODES::N_CGW2::MESSAGES::TCU_PositionReq1::TIMINGS::SendOnce
{
  if (@this == 1)
  {
    SetBusContext(gILCAN1_BusContext);
    ILSetMsgEvent(CHASSIS1CAN::CGW2::TCU_PositionReq1);
  }
}

on sysvar_update sysvar::IL_CAN1::NODES::N_CGW2::MESSAGES::TCU_PositionReq2::TIMINGS::EnableCyclic
{
  if (@this == 1)
  {
    SetBusContext(gILCAN1_BusContext);
    ILFaultInjectionEnableMsg  (CHASSIS1CAN::CGW2::TCU_PositionReq2);
  }
  else
  {
    SetBusContext(gILCAN1_BusContext);
    ILFaultInjectionDisableMsg (CHASSIS1CAN::CGW2::TCU_PositionReq2);
  }
}

on sysvar_update sysvar::IL_CAN1::NODES::N_CGW2::MESSAGES::TCU_PositionReq2::TIMINGS::SetNormalCycle
{
  if (@this == 1 && @sysvar::IL_CAN1::NODES::N_CGW2::MESSAGES::TCU_PositionReq2::TIMINGS::EnableCyclic)
  {
    @sysvar::IL_CAN1::NODES::N_CGW2::MESSAGES::TCU_PositionReq2::TIMINGS::SelectedPeriod = 0;
  }
}

on sysvar_update sysvar::IL_CAN1::NODES::N_CGW2::MESSAGES::TCU_PositionReq2::TIMINGS::SetNewCycleContinously
{
  if (@this == 1 && @sysvar::IL_CAN1::NODES::N_CGW2::MESSAGES::TCU_PositionReq2::TIMINGS::EnableCyclic)
  {
    @sysvar::IL_CAN1::NODES::N_CGW2::MESSAGES::TCU_PositionReq2::TIMINGS::SelectedPeriod = -1;
  }
}

on sysvar_update sysvar::IL_CAN1::NODES::N_CGW2::MESSAGES::TCU_PositionReq2::TIMINGS::SelectedPeriod
{
  if (@this == 0 && @sysvar::IL_CAN1::NODES::N_CGW2::MESSAGES::TCU_PositionReq2::TIMINGS::EnableCyclic)
  {
    SetBusContext(gILCAN1_BusContext);
    gCAN1DisturbancePeriod = @sysvar::IL_CAN1::NODES::N_CGW2::MESSAGES::TCU_PositionReq2::TIMINGS::NormalCyclePeriod;
    ILFaultInjectionResetMsgCycleTime(CHASSIS1CAN::CGW2::TCU_PositionReq2);
  }
  else if (@this == 1 && @sysvar::IL_CAN1::NODES::N_CGW2::MESSAGES::TCU_PositionReq2::TIMINGS::EnableCyclic)
  {
    SetBusContext(gILCAN1_BusContext);
    gCAN1DisturbancePeriod = @sysvar::IL_CAN1::NODES::N_CGW2::MESSAGES::TCU_PositionReq2::TIMINGS::ActiveCyclePeriod;
    ILFaultInjectionSetMsgCycleTime(CHASSIS1CAN::CGW2::TCU_PositionReq2, gCAN1DisturbancePeriod);
  }
  else if (@this == -1 && @sysvar::IL_CAN1::NODES::N_CGW2::MESSAGES::TCU_PositionReq2::TIMINGS::EnableCyclic)
  {
    SetBusContext(gILCAN1_BusContext);
    gCAN1DisturbancePeriod = @sysvar::IL_CAN1::NODES::N_CGW2::MESSAGES::TCU_PositionReq2::TIMINGS::CyclePeriod;
    ILFaultInjectionSetMsgCycleTime(CHASSIS1CAN::CGW2::TCU_PositionReq2, gCAN1DisturbancePeriod);
  }
}

on sysvar_update sysvar::IL_CAN1::NODES::N_CGW2::MESSAGES::TCU_PositionReq2::TIMINGS::SendOnce
{
  if (@this == 1)
  {
    SetBusContext(gILCAN1_BusContext);
    ILSetMsgEvent(CHASSIS1CAN::CGW2::TCU_PositionReq2);
  }
}

on sysvar_update sysvar::IL_CAN1::NODES::N_CGW2::MESSAGES::TCU_PositionReq3::TIMINGS::EnableCyclic
{
  if (@this == 1)
  {
    SetBusContext(gILCAN1_BusContext);
    ILFaultInjectionEnableMsg  (CHASSIS1CAN::CGW2::TCU_PositionReq3);
  }
  else
  {
    SetBusContext(gILCAN1_BusContext);
    ILFaultInjectionDisableMsg (CHASSIS1CAN::CGW2::TCU_PositionReq3);
  }
}

on sysvar_update sysvar::IL_CAN1::NODES::N_CGW2::MESSAGES::TCU_PositionReq3::TIMINGS::SetNormalCycle
{
  if (@this == 1 && @sysvar::IL_CAN1::NODES::N_CGW2::MESSAGES::TCU_PositionReq3::TIMINGS::EnableCyclic)
  {
    @sysvar::IL_CAN1::NODES::N_CGW2::MESSAGES::TCU_PositionReq3::TIMINGS::SelectedPeriod = 0;
  }
}

on sysvar_update sysvar::IL_CAN1::NODES::N_CGW2::MESSAGES::TCU_PositionReq3::TIMINGS::SetNewCycleContinously
{
  if (@this == 1 && @sysvar::IL_CAN1::NODES::N_CGW2::MESSAGES::TCU_PositionReq3::TIMINGS::EnableCyclic)
  {
    @sysvar::IL_CAN1::NODES::N_CGW2::MESSAGES::TCU_PositionReq3::TIMINGS::SelectedPeriod = -1;
  }
}

on sysvar_update sysvar::IL_CAN1::NODES::N_CGW2::MESSAGES::TCU_PositionReq3::TIMINGS::SelectedPeriod
{
  if (@this == 0 && @sysvar::IL_CAN1::NODES::N_CGW2::MESSAGES::TCU_PositionReq3::TIMINGS::EnableCyclic)
  {
    SetBusContext(gILCAN1_BusContext);
    gCAN1DisturbancePeriod = @sysvar::IL_CAN1::NODES::N_CGW2::MESSAGES::TCU_PositionReq3::TIMINGS::NormalCyclePeriod;
    ILFaultInjectionResetMsgCycleTime(CHASSIS1CAN::CGW2::TCU_PositionReq3);
  }
  else if (@this == 1 && @sysvar::IL_CAN1::NODES::N_CGW2::MESSAGES::TCU_PositionReq3::TIMINGS::EnableCyclic)
  {
    SetBusContext(gILCAN1_BusContext);
    gCAN1DisturbancePeriod = @sysvar::IL_CAN1::NODES::N_CGW2::MESSAGES::TCU_PositionReq3::TIMINGS::ActiveCyclePeriod;
    ILFaultInjectionSetMsgCycleTime(CHASSIS1CAN::CGW2::TCU_PositionReq3, gCAN1DisturbancePeriod);
  }
  else if (@this == -1 && @sysvar::IL_CAN1::NODES::N_CGW2::MESSAGES::TCU_PositionReq3::TIMINGS::EnableCyclic)
  {
    SetBusContext(gILCAN1_BusContext);
    gCAN1DisturbancePeriod = @sysvar::IL_CAN1::NODES::N_CGW2::MESSAGES::TCU_PositionReq3::TIMINGS::CyclePeriod;
    ILFaultInjectionSetMsgCycleTime(CHASSIS1CAN::CGW2::TCU_PositionReq3, gCAN1DisturbancePeriod);
  }
}

on sysvar_update sysvar::IL_CAN1::NODES::N_CGW2::MESSAGES::TCU_PositionReq3::TIMINGS::SendOnce
{
  if (@this == 1)
  {
    SetBusContext(gILCAN1_BusContext);
    ILSetMsgEvent(CHASSIS1CAN::CGW2::TCU_PositionReq3);
  }
}

on sysvar_update sysvar::IL_CAN1::NODES::N_CGW2::MESSAGES::TM_Status_0::TIMINGS::EnableCyclic
{
  if (@this == 1)
  {
    SetBusContext(gILCAN1_BusContext);
    ILFaultInjectionEnableMsg  (CHASSIS1CAN::CGW2::TM_Status_0);
  }
  else
  {
    SetBusContext(gILCAN1_BusContext);
    ILFaultInjectionDisableMsg (CHASSIS1CAN::CGW2::TM_Status_0);
  }
}

on sysvar_update sysvar::IL_CAN1::NODES::N_CGW2::MESSAGES::TM_Status_0::TIMINGS::SetNormalCycle
{
  if (@this == 1 && @sysvar::IL_CAN1::NODES::N_CGW2::MESSAGES::TM_Status_0::TIMINGS::EnableCyclic)
  {
    @sysvar::IL_CAN1::NODES::N_CGW2::MESSAGES::TM_Status_0::TIMINGS::SelectedPeriod = 0;
  }
}

on sysvar_update sysvar::IL_CAN1::NODES::N_CGW2::MESSAGES::TM_Status_0::TIMINGS::SetNewCycleContinously
{
  if (@this == 1 && @sysvar::IL_CAN1::NODES::N_CGW2::MESSAGES::TM_Status_0::TIMINGS::EnableCyclic)
  {
    @sysvar::IL_CAN1::NODES::N_CGW2::MESSAGES::TM_Status_0::TIMINGS::SelectedPeriod = -1;
  }
}

on sysvar_update sysvar::IL_CAN1::NODES::N_CGW2::MESSAGES::TM_Status_0::TIMINGS::SelectedPeriod
{
  if (@this == 0 && @sysvar::IL_CAN1::NODES::N_CGW2::MESSAGES::TM_Status_0::TIMINGS::EnableCyclic)
  {
    SetBusContext(gILCAN1_BusContext);
    gCAN1DisturbancePeriod = @sysvar::IL_CAN1::NODES::N_CGW2::MESSAGES::TM_Status_0::TIMINGS::NormalCyclePeriod;
    ILFaultInjectionResetMsgCycleTime(CHASSIS1CAN::CGW2::TM_Status_0);
  }
  else if (@this == 1 && @sysvar::IL_CAN1::NODES::N_CGW2::MESSAGES::TM_Status_0::TIMINGS::EnableCyclic)
  {
    SetBusContext(gILCAN1_BusContext);
    gCAN1DisturbancePeriod = @sysvar::IL_CAN1::NODES::N_CGW2::MESSAGES::TM_Status_0::TIMINGS::ActiveCyclePeriod;
    ILFaultInjectionSetMsgCycleTime(CHASSIS1CAN::CGW2::TM_Status_0, gCAN1DisturbancePeriod);
  }
  else if (@this == -1 && @sysvar::IL_CAN1::NODES::N_CGW2::MESSAGES::TM_Status_0::TIMINGS::EnableCyclic)
  {
    SetBusContext(gILCAN1_BusContext);
    gCAN1DisturbancePeriod = @sysvar::IL_CAN1::NODES::N_CGW2::MESSAGES::TM_Status_0::TIMINGS::CyclePeriod;
    ILFaultInjectionSetMsgCycleTime(CHASSIS1CAN::CGW2::TM_Status_0, gCAN1DisturbancePeriod);
  }
}

on sysvar_update sysvar::IL_CAN1::NODES::N_CGW2::MESSAGES::TM_Status_0::TIMINGS::SendOnce
{
  if (@this == 1)
  {
    SetBusContext(gILCAN1_BusContext);
    ILSetMsgEvent(CHASSIS1CAN::CGW2::TM_Status_0);
  }
}

on sysvar_update sysvar::IL_CAN1::NODES::N_CGW2::MESSAGES::VCU_HVInfo::TIMINGS::EnableCyclic
{
  if (@this == 1)
  {
    SetBusContext(gILCAN1_BusContext);
   // ILFaultInjectionEnableMsg  (CHASSIS1CAN::CGW2::VCU_HVInfo);
  }
  else
  {
    SetBusContext(gILCAN1_BusContext);
    //ILFaultInjectionDisableMsg (CHASSIS1CAN::CGW2::VCU_HVInfo);
  }
}

on sysvar_update sysvar::IL_CAN1::NODES::N_CGW2::MESSAGES::VCU_HVInfo::TIMINGS::SetNormalCycle
{
  if (@this == 1 && @sysvar::IL_CAN1::NODES::N_CGW2::MESSAGES::VCU_HVInfo::TIMINGS::EnableCyclic)
  {
    @sysvar::IL_CAN1::NODES::N_CGW2::MESSAGES::VCU_HVInfo::TIMINGS::SelectedPeriod = 0;
  }
}

on sysvar_update sysvar::IL_CAN1::NODES::N_CGW2::MESSAGES::VCU_HVInfo::TIMINGS::SetNewCycleContinously
{
  if (@this == 1 && @sysvar::IL_CAN1::NODES::N_CGW2::MESSAGES::VCU_HVInfo::TIMINGS::EnableCyclic)
  {
    @sysvar::IL_CAN1::NODES::N_CGW2::MESSAGES::VCU_HVInfo::TIMINGS::SelectedPeriod = -1;
  }
}

on sysvar_update sysvar::IL_CAN1::NODES::N_CGW2::MESSAGES::VCU_HVInfo::TIMINGS::SelectedPeriod
{
  if (@this == 0 && @sysvar::IL_CAN1::NODES::N_CGW2::MESSAGES::VCU_HVInfo::TIMINGS::EnableCyclic)
  {
    SetBusContext(gILCAN1_BusContext);
    gCAN1DisturbancePeriod = @sysvar::IL_CAN1::NODES::N_CGW2::MESSAGES::VCU_HVInfo::TIMINGS::NormalCyclePeriod;
   // ILFaultInjectionResetMsgCycleTime(CHASSIS1CAN::CGW2::VCU_HVInfo);
  }
  else if (@this == 1 && @sysvar::IL_CAN1::NODES::N_CGW2::MESSAGES::VCU_HVInfo::TIMINGS::EnableCyclic)
  {
    SetBusContext(gILCAN1_BusContext);
    gCAN1DisturbancePeriod = @sysvar::IL_CAN1::NODES::N_CGW2::MESSAGES::VCU_HVInfo::TIMINGS::ActiveCyclePeriod;
   // ILFaultInjectionSetMsgCycleTime(CHASSIS1CAN::CGW2::VCU_HVInfo, gCAN1DisturbancePeriod);
  }
  else if (@this == -1 && @sysvar::IL_CAN1::NODES::N_CGW2::MESSAGES::VCU_HVInfo::TIMINGS::EnableCyclic)
  {
    SetBusContext(gILCAN1_BusContext);
    gCAN1DisturbancePeriod = @sysvar::IL_CAN1::NODES::N_CGW2::MESSAGES::VCU_HVInfo::TIMINGS::CyclePeriod;
   // ILFaultInjectionSetMsgCycleTime(CHASSIS1CAN::CGW2::VCU_HVInfo, gCAN1DisturbancePeriod);
  }
}

on sysvar_update sysvar::IL_CAN1::NODES::N_CGW2::MESSAGES::VCU_HVInfo::TIMINGS::SendOnce
{
  if (@this == 1)
  {
    SetBusContext(gILCAN1_BusContext);
   // ILSetMsgEvent(CHASSIS1CAN::CGW2::VCU_HVInfo);
  }
}

on sysvar_update sysvar::IL_CAN1::NODES::N_CGW2::MESSAGES::VCU_Info::TIMINGS::EnableCyclic
{
  if (@this == 1)
  {
    SetBusContext(gILCAN1_BusContext);
    ILFaultInjectionEnableMsg  (CHASSIS1CAN::CGW2::VCU_Info);
  }
  else
  {
    SetBusContext(gILCAN1_BusContext);
    ILFaultInjectionDisableMsg (CHASSIS1CAN::CGW2::VCU_Info);
  }
}

on sysvar_update sysvar::IL_CAN1::NODES::N_CGW2::MESSAGES::VCU_Info::TIMINGS::SetNormalCycle
{
  if (@this == 1 && @sysvar::IL_CAN1::NODES::N_CGW2::MESSAGES::VCU_Info::TIMINGS::EnableCyclic)
  {
    @sysvar::IL_CAN1::NODES::N_CGW2::MESSAGES::VCU_Info::TIMINGS::SelectedPeriod = 0;
  }
}

on sysvar_update sysvar::IL_CAN1::NODES::N_CGW2::MESSAGES::VCU_Info::TIMINGS::SetNewCycleContinously
{
  if (@this == 1 && @sysvar::IL_CAN1::NODES::N_CGW2::MESSAGES::VCU_Info::TIMINGS::EnableCyclic)
  {
    @sysvar::IL_CAN1::NODES::N_CGW2::MESSAGES::VCU_Info::TIMINGS::SelectedPeriod = -1;
  }
}

on sysvar_update sysvar::IL_CAN1::NODES::N_CGW2::MESSAGES::VCU_Info::TIMINGS::SelectedPeriod
{
  if (@this == 0 && @sysvar::IL_CAN1::NODES::N_CGW2::MESSAGES::VCU_Info::TIMINGS::EnableCyclic)
  {
    SetBusContext(gILCAN1_BusContext);
    gCAN1DisturbancePeriod = @sysvar::IL_CAN1::NODES::N_CGW2::MESSAGES::VCU_Info::TIMINGS::NormalCyclePeriod;
    ILFaultInjectionResetMsgCycleTime(CHASSIS1CAN::CGW2::VCU_Info);
  }
  else if (@this == 1 && @sysvar::IL_CAN1::NODES::N_CGW2::MESSAGES::VCU_Info::TIMINGS::EnableCyclic)
  {
    SetBusContext(gILCAN1_BusContext);
    gCAN1DisturbancePeriod = @sysvar::IL_CAN1::NODES::N_CGW2::MESSAGES::VCU_Info::TIMINGS::ActiveCyclePeriod;
    ILFaultInjectionSetMsgCycleTime(CHASSIS1CAN::CGW2::VCU_Info, gCAN1DisturbancePeriod);
  }
  else if (@this == -1 && @sysvar::IL_CAN1::NODES::N_CGW2::MESSAGES::VCU_Info::TIMINGS::EnableCyclic)
  {
    SetBusContext(gILCAN1_BusContext);
    gCAN1DisturbancePeriod = @sysvar::IL_CAN1::NODES::N_CGW2::MESSAGES::VCU_Info::TIMINGS::CyclePeriod;
    ILFaultInjectionSetMsgCycleTime(CHASSIS1CAN::CGW2::VCU_Info, gCAN1DisturbancePeriod);
  }
}

on sysvar_update sysvar::IL_CAN1::NODES::N_CGW2::MESSAGES::VCU_Info::TIMINGS::SendOnce
{
  if (@this == 1)
  {
    SetBusContext(gILCAN1_BusContext);
    ILSetMsgEvent(CHASSIS1CAN::CGW2::VCU_Info);
  }
}

on sysvar_update sysvar::IL_CAN1::NODES::N_CGW2::MESSAGES::VCU_LoadShed::TIMINGS::EnableCyclic
{
  if (@this == 1)
  {
    SetBusContext(gILCAN1_BusContext);
    ILFaultInjectionEnableMsg  (CHASSIS1CAN::CGW2::VCU_LoadShed);
  }
  else
  {
    SetBusContext(gILCAN1_BusContext);
    ILFaultInjectionDisableMsg (CHASSIS1CAN::CGW2::VCU_LoadShed);
  }
}

on sysvar_update sysvar::IL_CAN1::NODES::N_CGW2::MESSAGES::VCU_LoadShed::TIMINGS::SetNormalCycle
{
  if (@this == 1 && @sysvar::IL_CAN1::NODES::N_CGW2::MESSAGES::VCU_LoadShed::TIMINGS::EnableCyclic)
  {
    @sysvar::IL_CAN1::NODES::N_CGW2::MESSAGES::VCU_LoadShed::TIMINGS::SelectedPeriod = 0;
  }
}

on sysvar_update sysvar::IL_CAN1::NODES::N_CGW2::MESSAGES::VCU_LoadShed::TIMINGS::SetNewCycleContinously
{
  if (@this == 1 && @sysvar::IL_CAN1::NODES::N_CGW2::MESSAGES::VCU_LoadShed::TIMINGS::EnableCyclic)
  {
    @sysvar::IL_CAN1::NODES::N_CGW2::MESSAGES::VCU_LoadShed::TIMINGS::SelectedPeriod = -1;
  }
}

on sysvar_update sysvar::IL_CAN1::NODES::N_CGW2::MESSAGES::VCU_LoadShed::TIMINGS::SelectedPeriod
{
  if (@this == 0 && @sysvar::IL_CAN1::NODES::N_CGW2::MESSAGES::VCU_LoadShed::TIMINGS::EnableCyclic)
  {
    SetBusContext(gILCAN1_BusContext);
    gCAN1DisturbancePeriod = @sysvar::IL_CAN1::NODES::N_CGW2::MESSAGES::VCU_LoadShed::TIMINGS::NormalCyclePeriod;
    ILFaultInjectionResetMsgCycleTime(CHASSIS1CAN::CGW2::VCU_LoadShed);
  }
  else if (@this == 1 && @sysvar::IL_CAN1::NODES::N_CGW2::MESSAGES::VCU_LoadShed::TIMINGS::EnableCyclic)
  {
    SetBusContext(gILCAN1_BusContext);
    gCAN1DisturbancePeriod = @sysvar::IL_CAN1::NODES::N_CGW2::MESSAGES::VCU_LoadShed::TIMINGS::ActiveCyclePeriod;
    ILFaultInjectionSetMsgCycleTime(CHASSIS1CAN::CGW2::VCU_LoadShed, gCAN1DisturbancePeriod);
  }
  else if (@this == -1 && @sysvar::IL_CAN1::NODES::N_CGW2::MESSAGES::VCU_LoadShed::TIMINGS::EnableCyclic)
  {
    SetBusContext(gILCAN1_BusContext);
    gCAN1DisturbancePeriod = @sysvar::IL_CAN1::NODES::N_CGW2::MESSAGES::VCU_LoadShed::TIMINGS::CyclePeriod;
    ILFaultInjectionSetMsgCycleTime(CHASSIS1CAN::CGW2::VCU_LoadShed, gCAN1DisturbancePeriod);
  }
}

on sysvar_update sysvar::IL_CAN1::NODES::N_CGW2::MESSAGES::VCU_LoadShed::TIMINGS::SendOnce
{
  if (@this == 1)
  {
    SetBusContext(gILCAN1_BusContext);
    ILSetMsgEvent(CHASSIS1CAN::CGW2::VCU_LoadShed);
  }
}

on sysvar_update sysvar::IL_CAN1::NODES::N_CGW2::MESSAGES::VCU_LVBatt1Info::TIMINGS::EnableCyclic
{
  if (@this == 1)
  {
    SetBusContext(gILCAN1_BusContext);
    ILFaultInjectionEnableMsg  (CHASSIS1CAN::CGW2::VCU_LVBatt1Info);
  }
  else
  {
    SetBusContext(gILCAN1_BusContext);
    ILFaultInjectionDisableMsg (CHASSIS1CAN::CGW2::VCU_LVBatt1Info);
  }
}

on sysvar_update sysvar::IL_CAN1::NODES::N_CGW2::MESSAGES::VCU_LVBatt1Info::TIMINGS::SetNormalCycle
{
  if (@this == 1 && @sysvar::IL_CAN1::NODES::N_CGW2::MESSAGES::VCU_LVBatt1Info::TIMINGS::EnableCyclic)
  {
    @sysvar::IL_CAN1::NODES::N_CGW2::MESSAGES::VCU_LVBatt1Info::TIMINGS::SelectedPeriod = 0;
  }
}

on sysvar_update sysvar::IL_CAN1::NODES::N_CGW2::MESSAGES::VCU_LVBatt1Info::TIMINGS::SetNewCycleContinously
{
  if (@this == 1 && @sysvar::IL_CAN1::NODES::N_CGW2::MESSAGES::VCU_LVBatt1Info::TIMINGS::EnableCyclic)
  {
    @sysvar::IL_CAN1::NODES::N_CGW2::MESSAGES::VCU_LVBatt1Info::TIMINGS::SelectedPeriod = -1;
  }
}

on sysvar_update sysvar::IL_CAN1::NODES::N_CGW2::MESSAGES::VCU_LVBatt1Info::TIMINGS::SelectedPeriod
{
  if (@this == 0 && @sysvar::IL_CAN1::NODES::N_CGW2::MESSAGES::VCU_LVBatt1Info::TIMINGS::EnableCyclic)
  {
    SetBusContext(gILCAN1_BusContext);
    gCAN1DisturbancePeriod = @sysvar::IL_CAN1::NODES::N_CGW2::MESSAGES::VCU_LVBatt1Info::TIMINGS::NormalCyclePeriod;
    ILFaultInjectionResetMsgCycleTime(CHASSIS1CAN::CGW2::VCU_LVBatt1Info);
  }
  else if (@this == 1 && @sysvar::IL_CAN1::NODES::N_CGW2::MESSAGES::VCU_LVBatt1Info::TIMINGS::EnableCyclic)
  {
    SetBusContext(gILCAN1_BusContext);
    gCAN1DisturbancePeriod = @sysvar::IL_CAN1::NODES::N_CGW2::MESSAGES::VCU_LVBatt1Info::TIMINGS::ActiveCyclePeriod;
    ILFaultInjectionSetMsgCycleTime(CHASSIS1CAN::CGW2::VCU_LVBatt1Info, gCAN1DisturbancePeriod);
  }
  else if (@this == -1 && @sysvar::IL_CAN1::NODES::N_CGW2::MESSAGES::VCU_LVBatt1Info::TIMINGS::EnableCyclic)
  {
    SetBusContext(gILCAN1_BusContext);
    gCAN1DisturbancePeriod = @sysvar::IL_CAN1::NODES::N_CGW2::MESSAGES::VCU_LVBatt1Info::TIMINGS::CyclePeriod;
    ILFaultInjectionSetMsgCycleTime(CHASSIS1CAN::CGW2::VCU_LVBatt1Info, gCAN1DisturbancePeriod);
  }
}

on sysvar_update sysvar::IL_CAN1::NODES::N_CGW2::MESSAGES::VCU_LVBatt1Info::TIMINGS::SendOnce
{
  if (@this == 1)
  {
    SetBusContext(gILCAN1_BusContext);
    ILSetMsgEvent(CHASSIS1CAN::CGW2::VCU_LVBatt1Info);
  }
}

on sysvar_update sysvar::IL_CAN1::NODES::N_CGW2::MESSAGES::VCU_LVBatt2Info::TIMINGS::EnableCyclic
{
  if (@this == 1)
  {
    SetBusContext(gILCAN1_BusContext);
  //  ILFaultInjectionEnableMsg  (CHASSIS1CAN::CGW2::VCU_LVBatt2Info);
  }
  else
  {
    SetBusContext(gILCAN1_BusContext);
   // ILFaultInjectionDisableMsg (CHASSIS1CAN::CGW2::VCU_LVBatt2Info);
  }
}

on sysvar_update sysvar::IL_CAN1::NODES::N_CGW2::MESSAGES::VCU_LVBatt2Info::TIMINGS::SetNormalCycle
{
  if (@this == 1 && @sysvar::IL_CAN1::NODES::N_CGW2::MESSAGES::VCU_LVBatt2Info::TIMINGS::EnableCyclic)
  {
    @sysvar::IL_CAN1::NODES::N_CGW2::MESSAGES::VCU_LVBatt2Info::TIMINGS::SelectedPeriod = 0;
  }
}

on sysvar_update sysvar::IL_CAN1::NODES::N_CGW2::MESSAGES::VCU_LVBatt2Info::TIMINGS::SetNewCycleContinously
{
  if (@this == 1 && @sysvar::IL_CAN1::NODES::N_CGW2::MESSAGES::VCU_LVBatt2Info::TIMINGS::EnableCyclic)
  {
    @sysvar::IL_CAN1::NODES::N_CGW2::MESSAGES::VCU_LVBatt2Info::TIMINGS::SelectedPeriod = -1;
  }
}

on sysvar_update sysvar::IL_CAN1::NODES::N_CGW2::MESSAGES::VCU_LVBatt2Info::TIMINGS::SelectedPeriod
{
  if (@this == 0 && @sysvar::IL_CAN1::NODES::N_CGW2::MESSAGES::VCU_LVBatt2Info::TIMINGS::EnableCyclic)
  {
    SetBusContext(gILCAN1_BusContext);
    gCAN1DisturbancePeriod = @sysvar::IL_CAN1::NODES::N_CGW2::MESSAGES::VCU_LVBatt2Info::TIMINGS::NormalCyclePeriod;
   // ILFaultInjectionResetMsgCycleTime(CHASSIS1CAN::CGW2::VCU_LVBatt2Info);
  }
  else if (@this == 1 && @sysvar::IL_CAN1::NODES::N_CGW2::MESSAGES::VCU_LVBatt2Info::TIMINGS::EnableCyclic)
  {
    SetBusContext(gILCAN1_BusContext);
    gCAN1DisturbancePeriod = @sysvar::IL_CAN1::NODES::N_CGW2::MESSAGES::VCU_LVBatt2Info::TIMINGS::ActiveCyclePeriod;
   // ILFaultInjectionSetMsgCycleTime(CHASSIS1CAN::CGW2::VCU_LVBatt2Info, gCAN1DisturbancePeriod);
  }
  else if (@this == -1 && @sysvar::IL_CAN1::NODES::N_CGW2::MESSAGES::VCU_LVBatt2Info::TIMINGS::EnableCyclic)
  {
    SetBusContext(gILCAN1_BusContext);
    gCAN1DisturbancePeriod = @sysvar::IL_CAN1::NODES::N_CGW2::MESSAGES::VCU_LVBatt2Info::TIMINGS::CyclePeriod;
   // ILFaultInjectionSetMsgCycleTime(CHASSIS1CAN::CGW2::VCU_LVBatt2Info, gCAN1DisturbancePeriod);
  }
}

on sysvar_update sysvar::IL_CAN1::NODES::N_CGW2::MESSAGES::VCU_LVBatt2Info::TIMINGS::SendOnce
{
  if (@this == 1)
  {
    SetBusContext(gILCAN1_BusContext);
    //ILSetMsgEvent(CHASSIS1CAN::CGW2::VCU_LVBatt2Info);
  }
}

on sysvar_update sysvar::IL_CAN1::NODES::N_CGW2::MESSAGES::VCU_ManualOperationInfo_Prim::TIMINGS::EnableCyclic
{
  if (@this == 1)
  {
    SetBusContext(gILCAN1_BusContext);
    ILFaultInjectionEnableMsg  (CHASSIS1CAN::CGW2::VCU_ManualOperationInfo_Prim);
  }
  else
  {
    SetBusContext(gILCAN1_BusContext);
    ILFaultInjectionDisableMsg (CHASSIS1CAN::CGW2::VCU_ManualOperationInfo_Prim);
  }
}

on sysvar_update sysvar::IL_CAN1::NODES::N_CGW2::MESSAGES::VCU_ManualOperationInfo_Prim::TIMINGS::SetNormalCycle
{
  if (@this == 1 && @sysvar::IL_CAN1::NODES::N_CGW2::MESSAGES::VCU_ManualOperationInfo_Prim::TIMINGS::EnableCyclic)
  {
    @sysvar::IL_CAN1::NODES::N_CGW2::MESSAGES::VCU_ManualOperationInfo_Prim::TIMINGS::SelectedPeriod = 0;
  }
}

on sysvar_update sysvar::IL_CAN1::NODES::N_CGW2::MESSAGES::VCU_ManualOperationInfo_Prim::TIMINGS::SetNewCycleContinously
{
  if (@this == 1 && @sysvar::IL_CAN1::NODES::N_CGW2::MESSAGES::VCU_ManualOperationInfo_Prim::TIMINGS::EnableCyclic)
  {
    @sysvar::IL_CAN1::NODES::N_CGW2::MESSAGES::VCU_ManualOperationInfo_Prim::TIMINGS::SelectedPeriod = -1;
  }
}

on sysvar_update sysvar::IL_CAN1::NODES::N_CGW2::MESSAGES::VCU_ManualOperationInfo_Prim::TIMINGS::SelectedPeriod
{
  if (@this == 0 && @sysvar::IL_CAN1::NODES::N_CGW2::MESSAGES::VCU_ManualOperationInfo_Prim::TIMINGS::EnableCyclic)
  {
    SetBusContext(gILCAN1_BusContext);
    gCAN1DisturbancePeriod = @sysvar::IL_CAN1::NODES::N_CGW2::MESSAGES::VCU_ManualOperationInfo_Prim::TIMINGS::NormalCyclePeriod;
    ILFaultInjectionResetMsgCycleTime(CHASSIS1CAN::CGW2::VCU_ManualOperationInfo_Prim);
  }
  else if (@this == 1 && @sysvar::IL_CAN1::NODES::N_CGW2::MESSAGES::VCU_ManualOperationInfo_Prim::TIMINGS::EnableCyclic)
  {
    SetBusContext(gILCAN1_BusContext);
    gCAN1DisturbancePeriod = @sysvar::IL_CAN1::NODES::N_CGW2::MESSAGES::VCU_ManualOperationInfo_Prim::TIMINGS::ActiveCyclePeriod;
    ILFaultInjectionSetMsgCycleTime(CHASSIS1CAN::CGW2::VCU_ManualOperationInfo_Prim, gCAN1DisturbancePeriod);
  }
  else if (@this == -1 && @sysvar::IL_CAN1::NODES::N_CGW2::MESSAGES::VCU_ManualOperationInfo_Prim::TIMINGS::EnableCyclic)
  {
    SetBusContext(gILCAN1_BusContext);
    gCAN1DisturbancePeriod = @sysvar::IL_CAN1::NODES::N_CGW2::MESSAGES::VCU_ManualOperationInfo_Prim::TIMINGS::CyclePeriod;
    ILFaultInjectionSetMsgCycleTime(CHASSIS1CAN::CGW2::VCU_ManualOperationInfo_Prim, gCAN1DisturbancePeriod);
  }
}

on sysvar_update sysvar::IL_CAN1::NODES::N_CGW2::MESSAGES::VCU_ManualOperationInfo_Prim::TIMINGS::SendOnce
{
  if (@this == 1)
  {
    SetBusContext(gILCAN1_BusContext);
    ILSetMsgEvent(CHASSIS1CAN::CGW2::VCU_ManualOperationInfo_Prim);
  }
}

on sysvar_update sysvar::IL_CAN1::NODES::N_CGW2::MESSAGES::VCU_ManualOperationInfo_Sec::TIMINGS::EnableCyclic
{
  if (@this == 1)
  {
    SetBusContext(gILCAN1_BusContext);
    ILFaultInjectionEnableMsg  (CHASSIS1CAN::CGW2::VCU_ManualOperationInfo_Sec);
  }
  else
  {
    SetBusContext(gILCAN1_BusContext);
    ILFaultInjectionDisableMsg (CHASSIS1CAN::CGW2::VCU_ManualOperationInfo_Sec);
  }
}

on sysvar_update sysvar::IL_CAN1::NODES::N_CGW2::MESSAGES::VCU_ManualOperationInfo_Sec::TIMINGS::SetNormalCycle
{
  if (@this == 1 && @sysvar::IL_CAN1::NODES::N_CGW2::MESSAGES::VCU_ManualOperationInfo_Sec::TIMINGS::EnableCyclic)
  {
    @sysvar::IL_CAN1::NODES::N_CGW2::MESSAGES::VCU_ManualOperationInfo_Sec::TIMINGS::SelectedPeriod = 0;
  }
}

on sysvar_update sysvar::IL_CAN1::NODES::N_CGW2::MESSAGES::VCU_ManualOperationInfo_Sec::TIMINGS::SetNewCycleContinously
{
  if (@this == 1 && @sysvar::IL_CAN1::NODES::N_CGW2::MESSAGES::VCU_ManualOperationInfo_Sec::TIMINGS::EnableCyclic)
  {
    @sysvar::IL_CAN1::NODES::N_CGW2::MESSAGES::VCU_ManualOperationInfo_Sec::TIMINGS::SelectedPeriod = -1;
  }
}

on sysvar_update sysvar::IL_CAN1::NODES::N_CGW2::MESSAGES::VCU_ManualOperationInfo_Sec::TIMINGS::SelectedPeriod
{
  if (@this == 0 && @sysvar::IL_CAN1::NODES::N_CGW2::MESSAGES::VCU_ManualOperationInfo_Sec::TIMINGS::EnableCyclic)
  {
    SetBusContext(gILCAN1_BusContext);
    gCAN1DisturbancePeriod = @sysvar::IL_CAN1::NODES::N_CGW2::MESSAGES::VCU_ManualOperationInfo_Sec::TIMINGS::NormalCyclePeriod;
    ILFaultInjectionResetMsgCycleTime(CHASSIS1CAN::CGW2::VCU_ManualOperationInfo_Sec);
  }
  else if (@this == 1 && @sysvar::IL_CAN1::NODES::N_CGW2::MESSAGES::VCU_ManualOperationInfo_Sec::TIMINGS::EnableCyclic)
  {
    SetBusContext(gILCAN1_BusContext);
    gCAN1DisturbancePeriod = @sysvar::IL_CAN1::NODES::N_CGW2::MESSAGES::VCU_ManualOperationInfo_Sec::TIMINGS::ActiveCyclePeriod;
    ILFaultInjectionSetMsgCycleTime(CHASSIS1CAN::CGW2::VCU_ManualOperationInfo_Sec, gCAN1DisturbancePeriod);
  }
  else if (@this == -1 && @sysvar::IL_CAN1::NODES::N_CGW2::MESSAGES::VCU_ManualOperationInfo_Sec::TIMINGS::EnableCyclic)
  {
    SetBusContext(gILCAN1_BusContext);
    gCAN1DisturbancePeriod = @sysvar::IL_CAN1::NODES::N_CGW2::MESSAGES::VCU_ManualOperationInfo_Sec::TIMINGS::CyclePeriod;
    ILFaultInjectionSetMsgCycleTime(CHASSIS1CAN::CGW2::VCU_ManualOperationInfo_Sec, gCAN1DisturbancePeriod);
  }
}

on sysvar_update sysvar::IL_CAN1::NODES::N_CGW2::MESSAGES::VCU_ManualOperationInfo_Sec::TIMINGS::SendOnce
{
  if (@this == 1)
  {
    SetBusContext(gILCAN1_BusContext);
    ILSetMsgEvent(CHASSIS1CAN::CGW2::VCU_ManualOperationInfo_Sec);
  }
}

on sysvar_update sysvar::IL_CAN1::NODES::N_CGW2::MESSAGES::VCU_VehicleTravel1Info::TIMINGS::EnableCyclic
{
  if (@this == 1)
  {
    SetBusContext(gILCAN1_BusContext);
    ILFaultInjectionEnableMsg  (CHASSIS1CAN::CGW2::VCU_VehicleTravel1Info);
  }
  else
  {
    SetBusContext(gILCAN1_BusContext);
    ILFaultInjectionDisableMsg (CHASSIS1CAN::CGW2::VCU_VehicleTravel1Info);
  }
}

on sysvar_update sysvar::IL_CAN1::NODES::N_CGW2::MESSAGES::VCU_VehicleTravel1Info::TIMINGS::SetNormalCycle
{
  if (@this == 1 && @sysvar::IL_CAN1::NODES::N_CGW2::MESSAGES::VCU_VehicleTravel1Info::TIMINGS::EnableCyclic)
  {
    @sysvar::IL_CAN1::NODES::N_CGW2::MESSAGES::VCU_VehicleTravel1Info::TIMINGS::SelectedPeriod = 0;
  }
}

on sysvar_update sysvar::IL_CAN1::NODES::N_CGW2::MESSAGES::VCU_VehicleTravel1Info::TIMINGS::SetNewCycleContinously
{
  if (@this == 1 && @sysvar::IL_CAN1::NODES::N_CGW2::MESSAGES::VCU_VehicleTravel1Info::TIMINGS::EnableCyclic)
  {
    @sysvar::IL_CAN1::NODES::N_CGW2::MESSAGES::VCU_VehicleTravel1Info::TIMINGS::SelectedPeriod = -1;
  }
}

on sysvar_update sysvar::IL_CAN1::NODES::N_CGW2::MESSAGES::VCU_VehicleTravel1Info::TIMINGS::SelectedPeriod
{
  if (@this == 0 && @sysvar::IL_CAN1::NODES::N_CGW2::MESSAGES::VCU_VehicleTravel1Info::TIMINGS::EnableCyclic)
  {
    SetBusContext(gILCAN1_BusContext);
    gCAN1DisturbancePeriod = @sysvar::IL_CAN1::NODES::N_CGW2::MESSAGES::VCU_VehicleTravel1Info::TIMINGS::NormalCyclePeriod;
    ILFaultInjectionResetMsgCycleTime(CHASSIS1CAN::CGW2::VCU_VehicleTravel1Info);
  }
  else if (@this == 1 && @sysvar::IL_CAN1::NODES::N_CGW2::MESSAGES::VCU_VehicleTravel1Info::TIMINGS::EnableCyclic)
  {
    SetBusContext(gILCAN1_BusContext);
    gCAN1DisturbancePeriod = @sysvar::IL_CAN1::NODES::N_CGW2::MESSAGES::VCU_VehicleTravel1Info::TIMINGS::ActiveCyclePeriod;
    ILFaultInjectionSetMsgCycleTime(CHASSIS1CAN::CGW2::VCU_VehicleTravel1Info, gCAN1DisturbancePeriod);
  }
  else if (@this == -1 && @sysvar::IL_CAN1::NODES::N_CGW2::MESSAGES::VCU_VehicleTravel1Info::TIMINGS::EnableCyclic)
  {
    SetBusContext(gILCAN1_BusContext);
    gCAN1DisturbancePeriod = @sysvar::IL_CAN1::NODES::N_CGW2::MESSAGES::VCU_VehicleTravel1Info::TIMINGS::CyclePeriod;
    ILFaultInjectionSetMsgCycleTime(CHASSIS1CAN::CGW2::VCU_VehicleTravel1Info, gCAN1DisturbancePeriod);
  }
}

on sysvar_update sysvar::IL_CAN1::NODES::N_CGW2::MESSAGES::VCU_VehicleTravel1Info::TIMINGS::SendOnce
{
  if (@this == 1)
  {
    SetBusContext(gILCAN1_BusContext);
    ILSetMsgEvent(CHASSIS1CAN::CGW2::VCU_VehicleTravel1Info);
  }
}

on sysvar_update sysvar::IL_CAN1::NODES::N_CGW2::MESSAGES::VCU_VSMInfo::TIMINGS::EnableCyclic
{
  if (@this == 1)
  {
    SetBusContext(gILCAN1_BusContext);
    ILFaultInjectionEnableMsg  (CHASSIS1CAN::CGW2::VCU_VSMInfo);
  }
  else
  {
    SetBusContext(gILCAN1_BusContext);
    ILFaultInjectionDisableMsg (CHASSIS1CAN::CGW2::VCU_VSMInfo);
  }
}

on sysvar_update sysvar::IL_CAN1::NODES::N_CGW2::MESSAGES::VCU_VSMInfo::TIMINGS::SetNormalCycle
{
  if (@this == 1 && @sysvar::IL_CAN1::NODES::N_CGW2::MESSAGES::VCU_VSMInfo::TIMINGS::EnableCyclic)
  {
    @sysvar::IL_CAN1::NODES::N_CGW2::MESSAGES::VCU_VSMInfo::TIMINGS::SelectedPeriod = 0;
  }
}

on sysvar_update sysvar::IL_CAN1::NODES::N_CGW2::MESSAGES::VCU_VSMInfo::TIMINGS::SetNewCycleContinously
{
  if (@this == 1 && @sysvar::IL_CAN1::NODES::N_CGW2::MESSAGES::VCU_VSMInfo::TIMINGS::EnableCyclic)
  {
    @sysvar::IL_CAN1::NODES::N_CGW2::MESSAGES::VCU_VSMInfo::TIMINGS::SelectedPeriod = -1;
  }
}

on sysvar_update sysvar::IL_CAN1::NODES::N_CGW2::MESSAGES::VCU_VSMInfo::TIMINGS::SelectedPeriod
{
  if (@this == 0 && @sysvar::IL_CAN1::NODES::N_CGW2::MESSAGES::VCU_VSMInfo::TIMINGS::EnableCyclic)
  {
    SetBusContext(gILCAN1_BusContext);
    gCAN1DisturbancePeriod = @sysvar::IL_CAN1::NODES::N_CGW2::MESSAGES::VCU_VSMInfo::TIMINGS::NormalCyclePeriod;
    ILFaultInjectionResetMsgCycleTime(CHASSIS1CAN::CGW2::VCU_VSMInfo);
  }
  else if (@this == 1 && @sysvar::IL_CAN1::NODES::N_CGW2::MESSAGES::VCU_VSMInfo::TIMINGS::EnableCyclic)
  {
    SetBusContext(gILCAN1_BusContext);
    gCAN1DisturbancePeriod = @sysvar::IL_CAN1::NODES::N_CGW2::MESSAGES::VCU_VSMInfo::TIMINGS::ActiveCyclePeriod;
    ILFaultInjectionSetMsgCycleTime(CHASSIS1CAN::CGW2::VCU_VSMInfo, gCAN1DisturbancePeriod);
  }
  else if (@this == -1 && @sysvar::IL_CAN1::NODES::N_CGW2::MESSAGES::VCU_VSMInfo::TIMINGS::EnableCyclic)
  {
    SetBusContext(gILCAN1_BusContext);
    gCAN1DisturbancePeriod = @sysvar::IL_CAN1::NODES::N_CGW2::MESSAGES::VCU_VSMInfo::TIMINGS::CyclePeriod;
    ILFaultInjectionSetMsgCycleTime(CHASSIS1CAN::CGW2::VCU_VSMInfo, gCAN1DisturbancePeriod);
  }
}

on sysvar_update sysvar::IL_CAN1::NODES::N_CGW2::MESSAGES::VCU_VSMInfo::TIMINGS::SendOnce
{
  if (@this == 1)
  {
    SetBusContext(gILCAN1_BusContext);
    ILSetMsgEvent(CHASSIS1CAN::CGW2::VCU_VSMInfo);
  }
}

on sysvar_update sysvar::IL_CAN1::NODES::N_CGW2::MESSAGES::VehTi::TIMINGS::EnableCyclic
{
  if (@this == 1)
  {
    SetBusContext(gILCAN1_BusContext);
    ILFaultInjectionEnableMsg  (CHASSIS1CAN::CGW2::VehTi);
  }
  else
  {
    SetBusContext(gILCAN1_BusContext);
    ILFaultInjectionDisableMsg (CHASSIS1CAN::CGW2::VehTi);
  }
}

on sysvar_update sysvar::IL_CAN1::NODES::N_CGW2::MESSAGES::VehTi::TIMINGS::SetNormalCycle
{
  if (@this == 1 && @sysvar::IL_CAN1::NODES::N_CGW2::MESSAGES::VehTi::TIMINGS::EnableCyclic)
  {
    @sysvar::IL_CAN1::NODES::N_CGW2::MESSAGES::VehTi::TIMINGS::SelectedPeriod = 0;
  }
}

on sysvar_update sysvar::IL_CAN1::NODES::N_CGW2::MESSAGES::VehTi::TIMINGS::SetNewCycleContinously
{
  if (@this == 1 && @sysvar::IL_CAN1::NODES::N_CGW2::MESSAGES::VehTi::TIMINGS::EnableCyclic)
  {
    @sysvar::IL_CAN1::NODES::N_CGW2::MESSAGES::VehTi::TIMINGS::SelectedPeriod = -1;
  }
}

on sysvar_update sysvar::IL_CAN1::NODES::N_CGW2::MESSAGES::VehTi::TIMINGS::SelectedPeriod
{
  if (@this == 0 && @sysvar::IL_CAN1::NODES::N_CGW2::MESSAGES::VehTi::TIMINGS::EnableCyclic)
  {
    SetBusContext(gILCAN1_BusContext);
    gCAN1DisturbancePeriod = @sysvar::IL_CAN1::NODES::N_CGW2::MESSAGES::VehTi::TIMINGS::NormalCyclePeriod;
    ILFaultInjectionResetMsgCycleTime(CHASSIS1CAN::CGW2::VehTi);
  }
  else if (@this == 1 && @sysvar::IL_CAN1::NODES::N_CGW2::MESSAGES::VehTi::TIMINGS::EnableCyclic)
  {
    SetBusContext(gILCAN1_BusContext);
    gCAN1DisturbancePeriod = @sysvar::IL_CAN1::NODES::N_CGW2::MESSAGES::VehTi::TIMINGS::ActiveCyclePeriod;
    ILFaultInjectionSetMsgCycleTime(CHASSIS1CAN::CGW2::VehTi, gCAN1DisturbancePeriod);
  }
  else if (@this == -1 && @sysvar::IL_CAN1::NODES::N_CGW2::MESSAGES::VehTi::TIMINGS::EnableCyclic)
  {
    SetBusContext(gILCAN1_BusContext);
    gCAN1DisturbancePeriod = @sysvar::IL_CAN1::NODES::N_CGW2::MESSAGES::VehTi::TIMINGS::CyclePeriod;
    ILFaultInjectionSetMsgCycleTime(CHASSIS1CAN::CGW2::VehTi, gCAN1DisturbancePeriod);
  }
}

on sysvar_update sysvar::IL_CAN1::NODES::N_CGW2::MESSAGES::VehTi::TIMINGS::SendOnce
{
  if (@this == 1)
  {
    SetBusContext(gILCAN1_BusContext);
    ILSetMsgEvent(CHASSIS1CAN::CGW2::VehTi);
  }
}

on sysvar_update sysvar::NM_CAN1::NODES::N_CGW2::OpenNodePanel
{
  OpenNodePanel("CHASSIS1CAN::CGW2", 1);
}

on sysvar_update sysvar::NM_CAN1::StateControl::CloseNodePanels
{
  OpenNodePanel("CHASSIS1CAN::CGW2", 0);
}

/* #ChannelEnd# |CAN1| #BusEnd# |CHASSIS1CAN| */
//--- end generated part --- Block end <#SysVar_Handler#> do not delete this line! Add application code below this line.

//--- begin generated part --- Block start <#MsgUpdateFcns#> do not delete this line and do not add application code in this code block!
/* #ChannelStart# |CAN1| #BusStart# |CHASSIS1CAN| */
/* #ChannelEnd# |CAN1| #BusEnd# |CHASSIS1CAN| */
//--- end generated part --- Block end <#MsgUpdateFcns#> do not delete this line! Add application code below this line.

