/*@!Encoding:1252*/
includes
{
  // Import required CAPL include files
  //--- begin generated part --- Block start #GlobalBody_Includes#; do not delete this line and do not add application code in this code block!
  /* #ChannelGlobalStart# |CAN2| #BusGlobalStart# |CHASSIS2CAN| */
  /* #ChannelGlobalEnd# |CAN2| #BusGlobalEnd# |CHASSIS2CAN| */
  //--- end generated part --- Block end #GlobalBody_Includes#; do not delete this line! Add application code below this line.
  //--- begin generated part --- Block start #Body_Includes#; do not delete this line and do not add application code in this code block!
  /* #ChannelStart# |CAN2| #BusStart# |CHASSIS2CAN| */
  #include "..\CAPL\Vector-NM-Panel-Helper_CAN2.cin"
  #include "..\CAPL\Vector-IL-KL15-Helper_CAN2.cin"
  /* #ChannelEnd# |CAN2| #BusEnd# |CHASSIS2CAN| */
  //--- end generated part --- Block end #Body_Includes#; do not delete this line! Add application code below this line.
}

variables
{
  // Define global variables for this CAPL file

  /*--- #GenHeader Begin# --- begin generated comment ---
  | Generated on Friday, February 14, 2025, 17:19:14
  | By ModelGenerator for Vector 1.6.4.13, ModelGeneratorVectorDLL 1.6.4.69
  | Package Vector 4.0.59
  | Target Bus: CHASSIS2CAN; Channel: CAN2; DB Cluster: DBC_SW030201_Chassis2_CAN;
  | From Database: DBC_SW03.02.01_Chassis2_CAN.dbc
  | CANoe Version 17.3.91.0
    --- #GenHeader End  # --- end generated comment --- */

  char gECU[256] = "VCU";
  //--- begin generated part --- Block start #Hdr_GlobalVariables#; do not delete this line and do not add application code in this code block!
  /* #ChannelStart# |CAN2| #BusStart# |CHASSIS2CAN| */
  /* #ChannelEnd# |CAN2| #BusEnd# |CHASSIS2CAN| */
  //--- end generated part --- Block end #Hdr_GlobalVariables#; do not delete this line! Add application code below this line.
  //--- begin generated part --- Block start #GlobalBody_GlobalVariables#; do not delete this line and do not add application code in this code block!
  /* #ChannelGlobalStart# |CAN2| #BusGlobalStart# |CHASSIS2CAN| */
  /* #ChannelGlobalEnd# |CAN2| #BusGlobalEnd# |CHASSIS2CAN| */
  //--- end generated part --- Block end #GlobalBody_GlobalVariables#; do not delete this line! Add application code below this line.
  //--- begin generated part --- Block start #Body_GlobalVariables#; do not delete this line and do not add application code in this code block!
  /* #ChannelStart# |CAN2| #BusStart# |CHASSIS2CAN| */
  char gCAN2BusName[256] = "CHASSIS2CAN";
  int gCAN2Channel = 2; // The channel the bus is attached to

  long gCAN2DisturbanceMode;
  long gCAN2DisturbanceCount;
  long gCAN2DisturbanceValue;
  long gCAN2DisturbanceContinueMode;
  double gCAN2DisturbancePeriod;
  /* #ChannelEnd# |CAN2| #BusEnd# |CHASSIS2CAN| */
  //--- end generated part --- Block end #Body_GlobalVariables#; do not delete this line! Add application code below this line.
}

on preStart
{
  // Initialize CAPL includes and node's modules/DLLs
  //--- begin generated part --- Block start #Hdr_OnInit#; do not delete this line and do not add application code in this code block!
  /* #ChannelStart# |CAN2| #BusStart# |CHASSIS2CAN| */
  /* #ChannelEnd# |CAN2| #BusEnd# |CHASSIS2CAN| */
  //--- end generated part --- Block end #Hdr_OnInit#; do not delete this line! Add application code below this line.
  //--- begin generated part --- Block start #GlobalBody_OnInit#; do not delete this line and do not add application code in this code block!
  /* #ChannelGlobalStart# |CAN2| #BusGlobalStart# |CHASSIS2CAN| */
  /* #ChannelGlobalEnd# |CAN2| #BusGlobalEnd# |CHASSIS2CAN| */
  //--- end generated part --- Block end #GlobalBody_OnInit#; do not delete this line! Add application code below this line.
  //--- begin generated part --- Block start #Body_OnInit#; do not delete this line and do not add application code in this code block!
  /* #ChannelStart# |CAN2| #BusStart# |CHASSIS2CAN| */
  ILCAN2_OnInit();
  /* #ChannelEnd# |CAN2| #BusEnd# |CHASSIS2CAN| */
  //--- end generated part --- Block end #Body_OnInit#; do not delete this line! Add application code below this line.
}

on start
{
  // Start CAPL includes and node's modules/DLLs
  //--- begin generated part --- Block start #Hdr_OnStart#; do not delete this line and do not add application code in this code block!
  /* #ChannelStart# |CAN2| #BusStart# |CHASSIS2CAN| */
  /* #ChannelEnd# |CAN2| #BusEnd# |CHASSIS2CAN| */
  //--- end generated part --- Block end #Hdr_OnStart#; do not delete this line! Add application code below this line.
  //--- begin generated part --- Block start #GlobalBody_OnStart#; do not delete this line and do not add application code in this code block!
  /* #ChannelGlobalStart# |CAN2| #BusGlobalStart# |CHASSIS2CAN| */
  /* #ChannelGlobalEnd# |CAN2| #BusGlobalEnd# |CHASSIS2CAN| */
  //--- end generated part --- Block end #GlobalBody_OnStart#; do not delete this line! Add application code below this line.
  //--- begin generated part --- Block start #Body_OnStart#; do not delete this line and do not add application code in this code block!
  /* #ChannelStart# |CAN2| #BusStart# |CHASSIS2CAN| */
  ILCAN2_OnStart();
  /* #ChannelEnd# |CAN2| #BusEnd# |CHASSIS2CAN| */
  //--- end generated part --- Block end #Body_OnStart#; do not delete this line! Add application code below this line.
}

on preStop
{
  // Prepare stopping
  //--- begin generated part --- Block start #Hdr_OnStopping#; do not delete this line and do not add application code in this code block!
  /* #ChannelStart# |CAN2| #BusStart# |CHASSIS2CAN| */
  /* #ChannelEnd# |CAN2| #BusEnd# |CHASSIS2CAN| */
  //--- end generated part --- Block end #Hdr_OnStopping#; do not delete this line! Add application code below this line.
  //--- begin generated part --- Block start #GlobalBody_OnStopping#; do not delete this line and do not add application code in this code block!
  /* #ChannelGlobalStart# |CAN2| #BusGlobalStart# |CHASSIS2CAN| */
  /* #ChannelGlobalEnd# |CAN2| #BusGlobalEnd# |CHASSIS2CAN| */
  //--- end generated part --- Block end #GlobalBody_OnStopping#; do not delete this line! Add application code below this line.
  //--- begin generated part --- Block start #Body_OnStopping#; do not delete this line and do not add application code in this code block!
  /* #ChannelStart# |CAN2| #BusStart# |CHASSIS2CAN| */
  /* #ChannelEnd# |CAN2| #BusEnd# |CHASSIS2CAN| */
  //--- end generated part --- Block end #Body_OnStopping#; do not delete this line! Add application code below this line.
}

on stopMeasurement
{
  // Stop actions
  //--- begin generated part --- Block start #Hdr_OnStop#; do not delete this line and do not add application code in this code block!
  /* #ChannelStart# |CAN2| #BusStart# |CHASSIS2CAN| */
  /* #ChannelEnd# |CAN2| #BusEnd# |CHASSIS2CAN| */
  //--- end generated part --- Block end #Hdr_OnStop#; do not delete this line! Add application code below this line.
  //--- begin generated part --- Block start #GlobalBody_OnStop#; do not delete this line and do not add application code in this code block!
  /* #ChannelGlobalStart# |CAN2| #BusGlobalStart# |CHASSIS2CAN| */
  /* #ChannelGlobalEnd# |CAN2| #BusGlobalEnd# |CHASSIS2CAN| */
  //--- end generated part --- Block end #GlobalBody_OnStop#; do not delete this line! Add application code below this line.
  //--- begin generated part --- Block start #Body_OnStop#; do not delete this line and do not add application code in this code block!
  /* #ChannelStart# |CAN2| #BusStart# |CHASSIS2CAN| */
  /* #ChannelEnd# |CAN2| #BusEnd# |CHASSIS2CAN| */
  //--- end generated part --- Block end #Body_OnStop#; do not delete this line! Add application code below this line.
}

void StartSim(dword busContext, int busActive, int mode)
{
  // Called when ... due to ...
  //   mode == 1: ILControlResume
  //   mode == 2: ILControlStart
  //   mode == 3: ILControlSimulationOn
  //--- begin generated part --- Block start #Hdr_StartSim#; do not delete this line and do not add application code in this code block!
  /* #ChannelStart# |CAN2| #BusStart# |CHASSIS2CAN| */
  /* #ChannelEnd# |CAN2| #BusEnd# |CHASSIS2CAN| */
  //--- end generated part --- Block end #Hdr_StartSim#; do not delete this line! Add application code below this line.
  //write("[%.6f %NODE_NAME%] StartSim(0x%X, %d, %d)", TimeNowNS()/1e9, busContext, busActive, mode);
  //--- begin generated part --- Block start #Body_StartSim#; do not delete this line and do not add application code in this code block!
  /* #ChannelStart# |CAN2| #BusStart# |CHASSIS2CAN| */
  /* #ChannelEnd# |CAN2| #BusEnd# |CHASSIS2CAN| */
  //--- end generated part --- Block end #Body_StartSim#; do not delete this line! Add application code below this line.
}

void StopSim(dword busContext, int busActive, int mode)
{
  // Called when ... due to ...
  //   mode == 1: ILControlWait
  //   mode == 2: ILControlStop
  //   mode == 3: ILControlSimulationOff
  //--- begin generated part --- Block start #Hdr_StopSim#; do not delete this line and do not add application code in this code block!
  /* #ChannelStart# |CAN2| #BusStart# |CHASSIS2CAN| */
  /* #ChannelEnd# |CAN2| #BusEnd# |CHASSIS2CAN| */
  //--- end generated part --- Block end #Hdr_StopSim#; do not delete this line! Add application code below this line.
  //write("[%.6f %NODE_NAME%] StopSim(0x%X, %d, %d)", TimeNowNS()/1e9, busContext, busActive, mode);
  //--- begin generated part --- Block start #Body_StopSim#; do not delete this line and do not add application code in this code block!
  /* #ChannelStart# |CAN2| #BusStart# |CHASSIS2CAN| */
  /* #ChannelEnd# |CAN2| #BusEnd# |CHASSIS2CAN| */
  //--- end generated part --- Block end #Body_StopSim#; do not delete this line! Add application code below this line.
}

on sysvar_update sysvar::IL::Klemme15
{
  // Handle system state variable
  //--- begin generated part --- Block start #Hdr_KL15_Klemme15#; do not delete this line and do not add application code in this code block!
  /* #ChannelStart# |CAN2| #BusStart# |CHASSIS2CAN| */
  /* #ChannelEnd# |CAN2| #BusEnd# |CHASSIS2CAN| */
  //--- end generated part --- Block end #Hdr_KL15_Klemme15#; do not delete this line! Add application code below this line.
  //--- begin generated part --- Block start #Body_KL15_Klemme15#; do not delete this line and do not add application code in this code block!
  /* #ChannelStart# |CAN2| #BusStart# |CHASSIS2CAN| */
  ILCAN2_OnEnvKlemme15(@this);
  /* #ChannelEnd# |CAN2| #BusEnd# |CHASSIS2CAN| */
  //--- end generated part --- Block end #Body_KL15_Klemme15#; do not delete this line! Add application code below this line.
}

on sysvar_update sysvar::IL::Klemme30
{
  // Handle system state variable
  //--- begin generated part --- Block start #Hdr_KL30_Klemme30#; do not delete this line and do not add application code in this code block!
  /* #ChannelStart# |CAN2| #BusStart# |CHASSIS2CAN| */
  /* #ChannelEnd# |CAN2| #BusEnd# |CHASSIS2CAN| */
  //--- end generated part --- Block end #Hdr_KL30_Klemme30#; do not delete this line! Add application code below this line.
  //--- begin generated part --- Block start #Body_KL30_Klemme30#; do not delete this line and do not add application code in this code block!
  /* #ChannelStart# |CAN2| #BusStart# |CHASSIS2CAN| */
  ILCAN2_OnEnvKlemme30(@this);
  /* #ChannelEnd# |CAN2| #BusEnd# |CHASSIS2CAN| */
  //--- end generated part --- Block end #Body_KL30_Klemme30#; do not delete this line! Add application code below this line.
}

dword applILTxPending(long aId, dword aDlc, byte data[])
{
  dword ret = 1;
  //--- begin generated part --- Block start #Hdr_applILTxPending#; do not delete this line and do not add application code in this code block!
  /* #ChannelStart# |CAN2| #BusStart# |CHASSIS2CAN| */
  /* #ChannelEnd# |CAN2| #BusEnd# |CHASSIS2CAN| */
  //--- end generated part --- Block end #Hdr_applILTxPending#; do not delete this line! Add application code below this line.
  //--- begin generated part --- Block start #Body_applILTxPending#; do not delete this line and do not add application code in this code block!
  /* #ChannelStart# |CAN2| #BusStart# |CHASSIS2CAN| */
  /* #ChannelEnd# |CAN2| #BusEnd# |CHASSIS2CAN| */
  //--- end generated part --- Block end #Body_applILTxPending#; do not delete this line! Add application code below this line.
  return ret;
}

//--- begin generated part --- Block start <#Helper_Functions#> do not delete this line and do not add application code in this code block!
/* #ChannelStart# |CAN2| #BusStart# |CHASSIS2CAN| */
/* #ChannelEnd# |CAN2| #BusEnd# |CHASSIS2CAN| */
//--- end generated part --- Block end <#Helper_Functions#> do not delete this line! Add application code below this line.

//--- begin generated part --- Block start <#SysVar_Handler#> do not delete this line and do not add application code in this code block!
/* #ChannelStart# |CAN2| #BusStart# |CHASSIS2CAN| */
on sysvar_update sysvar::IL_CAN2::NODES::N_VCU::EnableNode
{
  ILCAN2_Enable(@this && @sysvar::IL_CAN2::enable_AllNodes && @sysvar::IL::Klemme30);
}

on sysvar_update sysvar::IL_CAN2::enable_AllNodes
{
  ILCAN2_Enable(@this && @sysvar::IL_CAN2::NODES::N_VCU::EnableNode && @sysvar::IL::Klemme30);
}

on sysvar_update sysvar::IL_CAN2::NODES::N_VCU::MESSAGES::BatSox::TIMINGS::EnableCyclic
{
  if (@this == 1)
  {
    SetBusContext(gILCAN2_BusContext);
    ILFaultInjectionEnableMsg  (CHASSIS2CAN::VCU::BatSox);
  }
  else
  {
    SetBusContext(gILCAN2_BusContext);
    ILFaultInjectionDisableMsg (CHASSIS2CAN::VCU::BatSox);
  }
}

on sysvar_update sysvar::IL_CAN2::NODES::N_VCU::MESSAGES::BatSox::TIMINGS::SetNormalCycle
{
  if (@this == 1 && @sysvar::IL_CAN2::NODES::N_VCU::MESSAGES::BatSox::TIMINGS::EnableCyclic)
  {
    @sysvar::IL_CAN2::NODES::N_VCU::MESSAGES::BatSox::TIMINGS::SelectedPeriod = 0;
  }
}

on sysvar_update sysvar::IL_CAN2::NODES::N_VCU::MESSAGES::BatSox::TIMINGS::SetNewCycleContinously
{
  if (@this == 1 && @sysvar::IL_CAN2::NODES::N_VCU::MESSAGES::BatSox::TIMINGS::EnableCyclic)
  {
    @sysvar::IL_CAN2::NODES::N_VCU::MESSAGES::BatSox::TIMINGS::SelectedPeriod = -1;
  }
}

on sysvar_update sysvar::IL_CAN2::NODES::N_VCU::MESSAGES::BatSox::TIMINGS::SelectedPeriod
{
  if (@this == 0 && @sysvar::IL_CAN2::NODES::N_VCU::MESSAGES::BatSox::TIMINGS::EnableCyclic)
  {
    SetBusContext(gILCAN2_BusContext);
    gCAN2DisturbancePeriod = @sysvar::IL_CAN2::NODES::N_VCU::MESSAGES::BatSox::TIMINGS::NormalCyclePeriod;
    ILFaultInjectionResetMsgCycleTime(CHASSIS2CAN::VCU::BatSox);
  }
  else if (@this == 1 && @sysvar::IL_CAN2::NODES::N_VCU::MESSAGES::BatSox::TIMINGS::EnableCyclic)
  {
    SetBusContext(gILCAN2_BusContext);
    gCAN2DisturbancePeriod = @sysvar::IL_CAN2::NODES::N_VCU::MESSAGES::BatSox::TIMINGS::ActiveCyclePeriod;
    ILFaultInjectionSetMsgCycleTime(CHASSIS2CAN::VCU::BatSox, gCAN2DisturbancePeriod);
  }
  else if (@this == -1 && @sysvar::IL_CAN2::NODES::N_VCU::MESSAGES::BatSox::TIMINGS::EnableCyclic)
  {
    SetBusContext(gILCAN2_BusContext);
    gCAN2DisturbancePeriod = @sysvar::IL_CAN2::NODES::N_VCU::MESSAGES::BatSox::TIMINGS::CyclePeriod;
    ILFaultInjectionSetMsgCycleTime(CHASSIS2CAN::VCU::BatSox, gCAN2DisturbancePeriod);
  }
}

on sysvar_update sysvar::IL_CAN2::NODES::N_VCU::MESSAGES::BatSox::TIMINGS::SendOnce
{
  if (@this == 1)
  {
    SetBusContext(gILCAN2_BusContext);
    ILSetMsgEvent(CHASSIS2CAN::VCU::BatSox);
  }
}

on sysvar_update sysvar::IL_CAN2::NODES::N_VCU::MESSAGES::BatUMps::TIMINGS::EnableCyclic
{
  if (@this == 1)
  {
    SetBusContext(gILCAN2_BusContext);
   // ILFaultInjectionEnableMsg  (CHASSIS2CAN::VCU::BatUMps);
  }
  else
  {
    SetBusContext(gILCAN2_BusContext);
   // ILFaultInjectionDisableMsg (CHASSIS2CAN::VCU::BatUMps);
  }
}

on sysvar_update sysvar::IL_CAN2::NODES::N_VCU::MESSAGES::BatUMps::TIMINGS::SetNormalCycle
{
  if (@this == 1 && @sysvar::IL_CAN2::NODES::N_VCU::MESSAGES::BatUMps::TIMINGS::EnableCyclic)
  {
    @sysvar::IL_CAN2::NODES::N_VCU::MESSAGES::BatUMps::TIMINGS::SelectedPeriod = 0;
  }
}

on sysvar_update sysvar::IL_CAN2::NODES::N_VCU::MESSAGES::BatUMps::TIMINGS::SetNewCycleContinously
{
  if (@this == 1 && @sysvar::IL_CAN2::NODES::N_VCU::MESSAGES::BatUMps::TIMINGS::EnableCyclic)
  {
    @sysvar::IL_CAN2::NODES::N_VCU::MESSAGES::BatUMps::TIMINGS::SelectedPeriod = -1;
  }
}

on sysvar_update sysvar::IL_CAN2::NODES::N_VCU::MESSAGES::BatUMps::TIMINGS::SelectedPeriod
{
  if (@this == 0 && @sysvar::IL_CAN2::NODES::N_VCU::MESSAGES::BatUMps::TIMINGS::EnableCyclic)
  {
    SetBusContext(gILCAN2_BusContext);
    gCAN2DisturbancePeriod = @sysvar::IL_CAN2::NODES::N_VCU::MESSAGES::BatUMps::TIMINGS::NormalCyclePeriod;
   // ILFaultInjectionResetMsgCycleTime(CHASSIS2CAN::VCU::BatUMps);
  }
  else if (@this == 1 && @sysvar::IL_CAN2::NODES::N_VCU::MESSAGES::BatUMps::TIMINGS::EnableCyclic)
  {
    SetBusContext(gILCAN2_BusContext);
    gCAN2DisturbancePeriod = @sysvar::IL_CAN2::NODES::N_VCU::MESSAGES::BatUMps::TIMINGS::ActiveCyclePeriod;
    //ILFaultInjectionSetMsgCycleTime(CHASSIS2CAN::VCU::BatUMps, gCAN2DisturbancePeriod);
  }
  else if (@this == -1 && @sysvar::IL_CAN2::NODES::N_VCU::MESSAGES::BatUMps::TIMINGS::EnableCyclic)
  {
    SetBusContext(gILCAN2_BusContext);
    gCAN2DisturbancePeriod = @sysvar::IL_CAN2::NODES::N_VCU::MESSAGES::BatUMps::TIMINGS::CyclePeriod;
   // ILFaultInjectionSetMsgCycleTime(CHASSIS2CAN::VCU::BatUMps, gCAN2DisturbancePeriod);
  }
}

on sysvar_update sysvar::IL_CAN2::NODES::N_VCU::MESSAGES::BatUMps::TIMINGS::SendOnce
{
  if (@this == 1)
  {
    SetBusContext(gILCAN2_BusContext);
    //ILSetMsgEvent(CHASSIS2CAN::VCU::BatUMps);
  }
}

on sysvar_update sysvar::IL_CAN2::NODES::N_VCU::MESSAGES::PCU_Msg_VCU::TIMINGS::EnableCyclic
{
  if (@this == 1)
  {
    SetBusContext(gILCAN2_BusContext);
    ILFaultInjectionEnableMsg  (CHASSIS2CAN::VCU::PCU_Msg_VCU);
  }
  else
  {
    SetBusContext(gILCAN2_BusContext);
    ILFaultInjectionDisableMsg (CHASSIS2CAN::VCU::PCU_Msg_VCU);
  }
}

on sysvar_update sysvar::IL_CAN2::NODES::N_VCU::MESSAGES::PCU_Msg_VCU::TIMINGS::SetNormalCycle
{
  if (@this == 1 && @sysvar::IL_CAN2::NODES::N_VCU::MESSAGES::PCU_Msg_VCU::TIMINGS::EnableCyclic)
  {
    @sysvar::IL_CAN2::NODES::N_VCU::MESSAGES::PCU_Msg_VCU::TIMINGS::SelectedPeriod = 0;
  }
}

on sysvar_update sysvar::IL_CAN2::NODES::N_VCU::MESSAGES::PCU_Msg_VCU::TIMINGS::SetNewCycleContinously
{
  if (@this == 1 && @sysvar::IL_CAN2::NODES::N_VCU::MESSAGES::PCU_Msg_VCU::TIMINGS::EnableCyclic)
  {
    @sysvar::IL_CAN2::NODES::N_VCU::MESSAGES::PCU_Msg_VCU::TIMINGS::SelectedPeriod = -1;
  }
}

on sysvar_update sysvar::IL_CAN2::NODES::N_VCU::MESSAGES::PCU_Msg_VCU::TIMINGS::SelectedPeriod
{
  if (@this == 0 && @sysvar::IL_CAN2::NODES::N_VCU::MESSAGES::PCU_Msg_VCU::TIMINGS::EnableCyclic)
  {
    SetBusContext(gILCAN2_BusContext);
    gCAN2DisturbancePeriod = @sysvar::IL_CAN2::NODES::N_VCU::MESSAGES::PCU_Msg_VCU::TIMINGS::NormalCyclePeriod;
    ILFaultInjectionResetMsgCycleTime(CHASSIS2CAN::VCU::PCU_Msg_VCU);
  }
  else if (@this == 1 && @sysvar::IL_CAN2::NODES::N_VCU::MESSAGES::PCU_Msg_VCU::TIMINGS::EnableCyclic)
  {
    SetBusContext(gILCAN2_BusContext);
    gCAN2DisturbancePeriod = @sysvar::IL_CAN2::NODES::N_VCU::MESSAGES::PCU_Msg_VCU::TIMINGS::ActiveCyclePeriod;
    ILFaultInjectionSetMsgCycleTime(CHASSIS2CAN::VCU::PCU_Msg_VCU, gCAN2DisturbancePeriod);
  }
  else if (@this == -1 && @sysvar::IL_CAN2::NODES::N_VCU::MESSAGES::PCU_Msg_VCU::TIMINGS::EnableCyclic)
  {
    SetBusContext(gILCAN2_BusContext);
    gCAN2DisturbancePeriod = @sysvar::IL_CAN2::NODES::N_VCU::MESSAGES::PCU_Msg_VCU::TIMINGS::CyclePeriod;
    ILFaultInjectionSetMsgCycleTime(CHASSIS2CAN::VCU::PCU_Msg_VCU, gCAN2DisturbancePeriod);
  }
}

on sysvar_update sysvar::IL_CAN2::NODES::N_VCU::MESSAGES::PCU_Msg_VCU::TIMINGS::SendOnce
{
  if (@this == 1)
  {
    SetBusContext(gILCAN2_BusContext);
    ILSetMsgEvent(CHASSIS2CAN::VCU::PCU_Msg_VCU);
  }
}

on sysvar_update sysvar::IL_CAN2::NODES::N_VCU::MESSAGES::TM_Status_0::TIMINGS::EnableCyclic
{
  if (@this == 1)
  {
    SetBusContext(gILCAN2_BusContext);
    ILFaultInjectionEnableMsg  (CHASSIS2CAN::VCU::TM_Status_0);
  }
  else
  {
    SetBusContext(gILCAN2_BusContext);
    ILFaultInjectionDisableMsg (CHASSIS2CAN::VCU::TM_Status_0);
  }
}

on sysvar_update sysvar::IL_CAN2::NODES::N_VCU::MESSAGES::TM_Status_0::TIMINGS::SetNormalCycle
{
  if (@this == 1 && @sysvar::IL_CAN2::NODES::N_VCU::MESSAGES::TM_Status_0::TIMINGS::EnableCyclic)
  {
    @sysvar::IL_CAN2::NODES::N_VCU::MESSAGES::TM_Status_0::TIMINGS::SelectedPeriod = 0;
  }
}

on sysvar_update sysvar::IL_CAN2::NODES::N_VCU::MESSAGES::TM_Status_0::TIMINGS::SetNewCycleContinously
{
  if (@this == 1 && @sysvar::IL_CAN2::NODES::N_VCU::MESSAGES::TM_Status_0::TIMINGS::EnableCyclic)
  {
    @sysvar::IL_CAN2::NODES::N_VCU::MESSAGES::TM_Status_0::TIMINGS::SelectedPeriod = -1;
  }
}

on sysvar_update sysvar::IL_CAN2::NODES::N_VCU::MESSAGES::TM_Status_0::TIMINGS::SelectedPeriod
{
  if (@this == 0 && @sysvar::IL_CAN2::NODES::N_VCU::MESSAGES::TM_Status_0::TIMINGS::EnableCyclic)
  {
    SetBusContext(gILCAN2_BusContext);
    gCAN2DisturbancePeriod = @sysvar::IL_CAN2::NODES::N_VCU::MESSAGES::TM_Status_0::TIMINGS::NormalCyclePeriod;
    ILFaultInjectionResetMsgCycleTime(CHASSIS2CAN::VCU::TM_Status_0);
  }
  else if (@this == 1 && @sysvar::IL_CAN2::NODES::N_VCU::MESSAGES::TM_Status_0::TIMINGS::EnableCyclic)
  {
    SetBusContext(gILCAN2_BusContext);
    gCAN2DisturbancePeriod = @sysvar::IL_CAN2::NODES::N_VCU::MESSAGES::TM_Status_0::TIMINGS::ActiveCyclePeriod;
    ILFaultInjectionSetMsgCycleTime(CHASSIS2CAN::VCU::TM_Status_0, gCAN2DisturbancePeriod);
  }
  else if (@this == -1 && @sysvar::IL_CAN2::NODES::N_VCU::MESSAGES::TM_Status_0::TIMINGS::EnableCyclic)
  {
    SetBusContext(gILCAN2_BusContext);
    gCAN2DisturbancePeriod = @sysvar::IL_CAN2::NODES::N_VCU::MESSAGES::TM_Status_0::TIMINGS::CyclePeriod;
    ILFaultInjectionSetMsgCycleTime(CHASSIS2CAN::VCU::TM_Status_0, gCAN2DisturbancePeriod);
  }
}

on sysvar_update sysvar::IL_CAN2::NODES::N_VCU::MESSAGES::TM_Status_0::TIMINGS::SendOnce
{
  if (@this == 1)
  {
    SetBusContext(gILCAN2_BusContext);
    ILSetMsgEvent(CHASSIS2CAN::VCU::TM_Status_0);
  }
}

on sysvar_update sysvar::IL_CAN2::NODES::N_VCU::MESSAGES::VCU_BrkInfo::TIMINGS::EnableCyclic
{
  if (@this == 1)
  {
    SetBusContext(gILCAN2_BusContext);
    ILFaultInjectionEnableMsg  (CHASSIS2CAN::VCU::VCU_BrkInfo);
  }
  else
  {
    SetBusContext(gILCAN2_BusContext);
    ILFaultInjectionDisableMsg (CHASSIS2CAN::VCU::VCU_BrkInfo);
  }
}

on sysvar_update sysvar::IL_CAN2::NODES::N_VCU::MESSAGES::VCU_BrkInfo::TIMINGS::SetNormalCycle
{
  if (@this == 1 && @sysvar::IL_CAN2::NODES::N_VCU::MESSAGES::VCU_BrkInfo::TIMINGS::EnableCyclic)
  {
    @sysvar::IL_CAN2::NODES::N_VCU::MESSAGES::VCU_BrkInfo::TIMINGS::SelectedPeriod = 0;
  }
}

on sysvar_update sysvar::IL_CAN2::NODES::N_VCU::MESSAGES::VCU_BrkInfo::TIMINGS::SetNewCycleContinously
{
  if (@this == 1 && @sysvar::IL_CAN2::NODES::N_VCU::MESSAGES::VCU_BrkInfo::TIMINGS::EnableCyclic)
  {
    @sysvar::IL_CAN2::NODES::N_VCU::MESSAGES::VCU_BrkInfo::TIMINGS::SelectedPeriod = -1;
  }
}

on sysvar_update sysvar::IL_CAN2::NODES::N_VCU::MESSAGES::VCU_BrkInfo::TIMINGS::SelectedPeriod
{
  if (@this == 0 && @sysvar::IL_CAN2::NODES::N_VCU::MESSAGES::VCU_BrkInfo::TIMINGS::EnableCyclic)
  {
    SetBusContext(gILCAN2_BusContext);
    gCAN2DisturbancePeriod = @sysvar::IL_CAN2::NODES::N_VCU::MESSAGES::VCU_BrkInfo::TIMINGS::NormalCyclePeriod;
    ILFaultInjectionResetMsgCycleTime(CHASSIS2CAN::VCU::VCU_BrkInfo);
  }
  else if (@this == 1 && @sysvar::IL_CAN2::NODES::N_VCU::MESSAGES::VCU_BrkInfo::TIMINGS::EnableCyclic)
  {
    SetBusContext(gILCAN2_BusContext);
    gCAN2DisturbancePeriod = @sysvar::IL_CAN2::NODES::N_VCU::MESSAGES::VCU_BrkInfo::TIMINGS::ActiveCyclePeriod;
    ILFaultInjectionSetMsgCycleTime(CHASSIS2CAN::VCU::VCU_BrkInfo, gCAN2DisturbancePeriod);
  }
  else if (@this == -1 && @sysvar::IL_CAN2::NODES::N_VCU::MESSAGES::VCU_BrkInfo::TIMINGS::EnableCyclic)
  {
    SetBusContext(gILCAN2_BusContext);
    gCAN2DisturbancePeriod = @sysvar::IL_CAN2::NODES::N_VCU::MESSAGES::VCU_BrkInfo::TIMINGS::CyclePeriod;
    ILFaultInjectionSetMsgCycleTime(CHASSIS2CAN::VCU::VCU_BrkInfo, gCAN2DisturbancePeriod);
  }
}

on sysvar_update sysvar::IL_CAN2::NODES::N_VCU::MESSAGES::VCU_BrkInfo::TIMINGS::SendOnce
{
  if (@this == 1)
  {
    SetBusContext(gILCAN2_BusContext);
    ILSetMsgEvent(CHASSIS2CAN::VCU::VCU_BrkInfo);
  }
}

on sysvar_update sysvar::IL_CAN2::NODES::N_VCU::MESSAGES::VCU_FaultInfo::TIMINGS::EnableCyclic
{
  if (@this == 1)
  {
    SetBusContext(gILCAN2_BusContext);
    ILFaultInjectionEnableMsg  (CHASSIS2CAN::VCU::VCU_FaultInfo);
  }
  else
  {
    SetBusContext(gILCAN2_BusContext);
    ILFaultInjectionDisableMsg (CHASSIS2CAN::VCU::VCU_FaultInfo);
  }
}

on sysvar_update sysvar::IL_CAN2::NODES::N_VCU::MESSAGES::VCU_FaultInfo::TIMINGS::SetNormalCycle
{
  if (@this == 1 && @sysvar::IL_CAN2::NODES::N_VCU::MESSAGES::VCU_FaultInfo::TIMINGS::EnableCyclic)
  {
    @sysvar::IL_CAN2::NODES::N_VCU::MESSAGES::VCU_FaultInfo::TIMINGS::SelectedPeriod = 0;
  }
}

on sysvar_update sysvar::IL_CAN2::NODES::N_VCU::MESSAGES::VCU_FaultInfo::TIMINGS::SetNewCycleContinously
{
  if (@this == 1 && @sysvar::IL_CAN2::NODES::N_VCU::MESSAGES::VCU_FaultInfo::TIMINGS::EnableCyclic)
  {
    @sysvar::IL_CAN2::NODES::N_VCU::MESSAGES::VCU_FaultInfo::TIMINGS::SelectedPeriod = -1;
  }
}

on sysvar_update sysvar::IL_CAN2::NODES::N_VCU::MESSAGES::VCU_FaultInfo::TIMINGS::SelectedPeriod
{
  if (@this == 0 && @sysvar::IL_CAN2::NODES::N_VCU::MESSAGES::VCU_FaultInfo::TIMINGS::EnableCyclic)
  {
    SetBusContext(gILCAN2_BusContext);
    gCAN2DisturbancePeriod = @sysvar::IL_CAN2::NODES::N_VCU::MESSAGES::VCU_FaultInfo::TIMINGS::NormalCyclePeriod;
    ILFaultInjectionResetMsgCycleTime(CHASSIS2CAN::VCU::VCU_FaultInfo);
  }
  else if (@this == 1 && @sysvar::IL_CAN2::NODES::N_VCU::MESSAGES::VCU_FaultInfo::TIMINGS::EnableCyclic)
  {
    SetBusContext(gILCAN2_BusContext);
    gCAN2DisturbancePeriod = @sysvar::IL_CAN2::NODES::N_VCU::MESSAGES::VCU_FaultInfo::TIMINGS::ActiveCyclePeriod;
    ILFaultInjectionSetMsgCycleTime(CHASSIS2CAN::VCU::VCU_FaultInfo, gCAN2DisturbancePeriod);
  }
  else if (@this == -1 && @sysvar::IL_CAN2::NODES::N_VCU::MESSAGES::VCU_FaultInfo::TIMINGS::EnableCyclic)
  {
    SetBusContext(gILCAN2_BusContext);
    gCAN2DisturbancePeriod = @sysvar::IL_CAN2::NODES::N_VCU::MESSAGES::VCU_FaultInfo::TIMINGS::CyclePeriod;
    ILFaultInjectionSetMsgCycleTime(CHASSIS2CAN::VCU::VCU_FaultInfo, gCAN2DisturbancePeriod);
  }
}

on sysvar_update sysvar::IL_CAN2::NODES::N_VCU::MESSAGES::VCU_FaultInfo::TIMINGS::SendOnce
{
  if (@this == 1)
  {
    SetBusContext(gILCAN2_BusContext);
    ILSetMsgEvent(CHASSIS2CAN::VCU::VCU_FaultInfo);
  }
}

on sysvar_update sysvar::IL_CAN2::NODES::N_VCU::MESSAGES::VCU_FC_NPDU::TIMINGS::EnableCyclic
{
  if (@this == 1)
  {
    SetBusContext(gILCAN2_BusContext);
    ILFaultInjectionEnableMsg  (CHASSIS2CAN::VCU::VCU_FC_NPDU);
  }
  else
  {
    SetBusContext(gILCAN2_BusContext);
    ILFaultInjectionDisableMsg (CHASSIS2CAN::VCU::VCU_FC_NPDU);
  }
}

on sysvar_update sysvar::IL_CAN2::NODES::N_VCU::MESSAGES::VCU_FC_NPDU::TIMINGS::SetNormalCycle
{
  if (@this == 1 && @sysvar::IL_CAN2::NODES::N_VCU::MESSAGES::VCU_FC_NPDU::TIMINGS::EnableCyclic)
  {
    @sysvar::IL_CAN2::NODES::N_VCU::MESSAGES::VCU_FC_NPDU::TIMINGS::SelectedPeriod = 0;
  }
}

on sysvar_update sysvar::IL_CAN2::NODES::N_VCU::MESSAGES::VCU_FC_NPDU::TIMINGS::SetNewCycleContinously
{
  if (@this == 1 && @sysvar::IL_CAN2::NODES::N_VCU::MESSAGES::VCU_FC_NPDU::TIMINGS::EnableCyclic)
  {
    @sysvar::IL_CAN2::NODES::N_VCU::MESSAGES::VCU_FC_NPDU::TIMINGS::SelectedPeriod = -1;
  }
}

on sysvar_update sysvar::IL_CAN2::NODES::N_VCU::MESSAGES::VCU_FC_NPDU::TIMINGS::SelectedPeriod
{
  if (@this == 0 && @sysvar::IL_CAN2::NODES::N_VCU::MESSAGES::VCU_FC_NPDU::TIMINGS::EnableCyclic)
  {
    SetBusContext(gILCAN2_BusContext);
    gCAN2DisturbancePeriod = @sysvar::IL_CAN2::NODES::N_VCU::MESSAGES::VCU_FC_NPDU::TIMINGS::NormalCyclePeriod;
    ILFaultInjectionResetMsgCycleTime(CHASSIS2CAN::VCU::VCU_FC_NPDU);
  }
  else if (@this == 1 && @sysvar::IL_CAN2::NODES::N_VCU::MESSAGES::VCU_FC_NPDU::TIMINGS::EnableCyclic)
  {
    SetBusContext(gILCAN2_BusContext);
    gCAN2DisturbancePeriod = @sysvar::IL_CAN2::NODES::N_VCU::MESSAGES::VCU_FC_NPDU::TIMINGS::ActiveCyclePeriod;
    ILFaultInjectionSetMsgCycleTime(CHASSIS2CAN::VCU::VCU_FC_NPDU, gCAN2DisturbancePeriod);
  }
  else if (@this == -1 && @sysvar::IL_CAN2::NODES::N_VCU::MESSAGES::VCU_FC_NPDU::TIMINGS::EnableCyclic)
  {
    SetBusContext(gILCAN2_BusContext);
    gCAN2DisturbancePeriod = @sysvar::IL_CAN2::NODES::N_VCU::MESSAGES::VCU_FC_NPDU::TIMINGS::CyclePeriod;
    ILFaultInjectionSetMsgCycleTime(CHASSIS2CAN::VCU::VCU_FC_NPDU, gCAN2DisturbancePeriod);
  }
}

on sysvar_update sysvar::IL_CAN2::NODES::N_VCU::MESSAGES::VCU_FC_NPDU::TIMINGS::SendOnce
{
  if (@this == 1)
  {
    SetBusContext(gILCAN2_BusContext);
    ILSetMsgEvent(CHASSIS2CAN::VCU::VCU_FC_NPDU);
  }
}

on sysvar_update sysvar::IL_CAN2::NODES::N_VCU::MESSAGES::VCU_HVInfo::TIMINGS::EnableCyclic
{
  if (@this == 1)
  {
    SetBusContext(gILCAN2_BusContext);
   // ILFaultInjectionEnableMsg  (CHASSIS2CAN::VCU::VCU_HVInfo);
  }
  else
  {
    SetBusContext(gILCAN2_BusContext);
   // ILFaultInjectionDisableMsg (CHASSIS2CAN::VCU::VCU_HVInfo);
  }
}

on sysvar_update sysvar::IL_CAN2::NODES::N_VCU::MESSAGES::VCU_HVInfo::TIMINGS::SetNormalCycle
{
  if (@this == 1 && @sysvar::IL_CAN2::NODES::N_VCU::MESSAGES::VCU_HVInfo::TIMINGS::EnableCyclic)
  {
    @sysvar::IL_CAN2::NODES::N_VCU::MESSAGES::VCU_HVInfo::TIMINGS::SelectedPeriod = 0;
  }
}

on sysvar_update sysvar::IL_CAN2::NODES::N_VCU::MESSAGES::VCU_HVInfo::TIMINGS::SetNewCycleContinously
{
  if (@this == 1 && @sysvar::IL_CAN2::NODES::N_VCU::MESSAGES::VCU_HVInfo::TIMINGS::EnableCyclic)
  {
    @sysvar::IL_CAN2::NODES::N_VCU::MESSAGES::VCU_HVInfo::TIMINGS::SelectedPeriod = -1;
  }
}

on sysvar_update sysvar::IL_CAN2::NODES::N_VCU::MESSAGES::VCU_HVInfo::TIMINGS::SelectedPeriod
{
  if (@this == 0 && @sysvar::IL_CAN2::NODES::N_VCU::MESSAGES::VCU_HVInfo::TIMINGS::EnableCyclic)
  {
    SetBusContext(gILCAN2_BusContext);
    gCAN2DisturbancePeriod = @sysvar::IL_CAN2::NODES::N_VCU::MESSAGES::VCU_HVInfo::TIMINGS::NormalCyclePeriod;
    //ILFaultInjectionResetMsgCycleTime(CHASSIS2CAN::VCU::VCU_HVInfo);
  }
  else if (@this == 1 && @sysvar::IL_CAN2::NODES::N_VCU::MESSAGES::VCU_HVInfo::TIMINGS::EnableCyclic)
  {
    SetBusContext(gILCAN2_BusContext);
    gCAN2DisturbancePeriod = @sysvar::IL_CAN2::NODES::N_VCU::MESSAGES::VCU_HVInfo::TIMINGS::ActiveCyclePeriod;
   // ILFaultInjectionSetMsgCycleTime(CHASSIS2CAN::VCU::VCU_HVInfo, gCAN2DisturbancePeriod);
  }
  else if (@this == -1 && @sysvar::IL_CAN2::NODES::N_VCU::MESSAGES::VCU_HVInfo::TIMINGS::EnableCyclic)
  {
    SetBusContext(gILCAN2_BusContext);
    gCAN2DisturbancePeriod = @sysvar::IL_CAN2::NODES::N_VCU::MESSAGES::VCU_HVInfo::TIMINGS::CyclePeriod;
   // ILFaultInjectionSetMsgCycleTime(CHASSIS2CAN::VCU::VCU_HVInfo, gCAN2DisturbancePeriod);
  }
}

on sysvar_update sysvar::IL_CAN2::NODES::N_VCU::MESSAGES::VCU_HVInfo::TIMINGS::SendOnce
{
  if (@this == 1)
  {
    SetBusContext(gILCAN2_BusContext);
   // ILSetMsgEvent(CHASSIS2CAN::VCU::VCU_HVInfo);
  }
}

on sysvar_update sysvar::IL_CAN2::NODES::N_VCU::MESSAGES::VCU_Info::TIMINGS::EnableCyclic
{
  if (@this == 1)
  {
    SetBusContext(gILCAN2_BusContext);
    ILFaultInjectionEnableMsg  (CHASSIS2CAN::VCU::VCU_Info);
  }
  else
  {
    SetBusContext(gILCAN2_BusContext);
    ILFaultInjectionDisableMsg (CHASSIS2CAN::VCU::VCU_Info);
  }
}

on sysvar_update sysvar::IL_CAN2::NODES::N_VCU::MESSAGES::VCU_Info::TIMINGS::SetNormalCycle
{
  if (@this == 1 && @sysvar::IL_CAN2::NODES::N_VCU::MESSAGES::VCU_Info::TIMINGS::EnableCyclic)
  {
    @sysvar::IL_CAN2::NODES::N_VCU::MESSAGES::VCU_Info::TIMINGS::SelectedPeriod = 0;
  }
}

on sysvar_update sysvar::IL_CAN2::NODES::N_VCU::MESSAGES::VCU_Info::TIMINGS::SetNewCycleContinously
{
  if (@this == 1 && @sysvar::IL_CAN2::NODES::N_VCU::MESSAGES::VCU_Info::TIMINGS::EnableCyclic)
  {
    @sysvar::IL_CAN2::NODES::N_VCU::MESSAGES::VCU_Info::TIMINGS::SelectedPeriod = -1;
  }
}

on sysvar_update sysvar::IL_CAN2::NODES::N_VCU::MESSAGES::VCU_Info::TIMINGS::SelectedPeriod
{
  if (@this == 0 && @sysvar::IL_CAN2::NODES::N_VCU::MESSAGES::VCU_Info::TIMINGS::EnableCyclic)
  {
    SetBusContext(gILCAN2_BusContext);
    gCAN2DisturbancePeriod = @sysvar::IL_CAN2::NODES::N_VCU::MESSAGES::VCU_Info::TIMINGS::NormalCyclePeriod;
    ILFaultInjectionResetMsgCycleTime(CHASSIS2CAN::VCU::VCU_Info);
  }
  else if (@this == 1 && @sysvar::IL_CAN2::NODES::N_VCU::MESSAGES::VCU_Info::TIMINGS::EnableCyclic)
  {
    SetBusContext(gILCAN2_BusContext);
    gCAN2DisturbancePeriod = @sysvar::IL_CAN2::NODES::N_VCU::MESSAGES::VCU_Info::TIMINGS::ActiveCyclePeriod;
    ILFaultInjectionSetMsgCycleTime(CHASSIS2CAN::VCU::VCU_Info, gCAN2DisturbancePeriod);
  }
  else if (@this == -1 && @sysvar::IL_CAN2::NODES::N_VCU::MESSAGES::VCU_Info::TIMINGS::EnableCyclic)
  {
    SetBusContext(gILCAN2_BusContext);
    gCAN2DisturbancePeriod = @sysvar::IL_CAN2::NODES::N_VCU::MESSAGES::VCU_Info::TIMINGS::CyclePeriod;
    ILFaultInjectionSetMsgCycleTime(CHASSIS2CAN::VCU::VCU_Info, gCAN2DisturbancePeriod);
  }
}

on sysvar_update sysvar::IL_CAN2::NODES::N_VCU::MESSAGES::VCU_Info::TIMINGS::SendOnce
{
  if (@this == 1)
  {
    SetBusContext(gILCAN2_BusContext);
    ILSetMsgEvent(CHASSIS2CAN::VCU::VCU_Info);
  }
}

on sysvar_update sysvar::IL_CAN2::NODES::N_VCU::MESSAGES::VCU_LoadShed::TIMINGS::EnableCyclic
{
  if (@this == 1)
  {
    SetBusContext(gILCAN2_BusContext);
    ILFaultInjectionEnableMsg  (CHASSIS2CAN::VCU::VCU_LoadShed);
  }
  else
  {
    SetBusContext(gILCAN2_BusContext);
    ILFaultInjectionDisableMsg (CHASSIS2CAN::VCU::VCU_LoadShed);
  }
}

on sysvar_update sysvar::IL_CAN2::NODES::N_VCU::MESSAGES::VCU_LoadShed::TIMINGS::SetNormalCycle
{
  if (@this == 1 && @sysvar::IL_CAN2::NODES::N_VCU::MESSAGES::VCU_LoadShed::TIMINGS::EnableCyclic)
  {
    @sysvar::IL_CAN2::NODES::N_VCU::MESSAGES::VCU_LoadShed::TIMINGS::SelectedPeriod = 0;
  }
}

on sysvar_update sysvar::IL_CAN2::NODES::N_VCU::MESSAGES::VCU_LoadShed::TIMINGS::SetNewCycleContinously
{
  if (@this == 1 && @sysvar::IL_CAN2::NODES::N_VCU::MESSAGES::VCU_LoadShed::TIMINGS::EnableCyclic)
  {
    @sysvar::IL_CAN2::NODES::N_VCU::MESSAGES::VCU_LoadShed::TIMINGS::SelectedPeriod = -1;
  }
}

on sysvar_update sysvar::IL_CAN2::NODES::N_VCU::MESSAGES::VCU_LoadShed::TIMINGS::SelectedPeriod
{
  if (@this == 0 && @sysvar::IL_CAN2::NODES::N_VCU::MESSAGES::VCU_LoadShed::TIMINGS::EnableCyclic)
  {
    SetBusContext(gILCAN2_BusContext);
    gCAN2DisturbancePeriod = @sysvar::IL_CAN2::NODES::N_VCU::MESSAGES::VCU_LoadShed::TIMINGS::NormalCyclePeriod;
    ILFaultInjectionResetMsgCycleTime(CHASSIS2CAN::VCU::VCU_LoadShed);
  }
  else if (@this == 1 && @sysvar::IL_CAN2::NODES::N_VCU::MESSAGES::VCU_LoadShed::TIMINGS::EnableCyclic)
  {
    SetBusContext(gILCAN2_BusContext);
    gCAN2DisturbancePeriod = @sysvar::IL_CAN2::NODES::N_VCU::MESSAGES::VCU_LoadShed::TIMINGS::ActiveCyclePeriod;
    ILFaultInjectionSetMsgCycleTime(CHASSIS2CAN::VCU::VCU_LoadShed, gCAN2DisturbancePeriod);
  }
  else if (@this == -1 && @sysvar::IL_CAN2::NODES::N_VCU::MESSAGES::VCU_LoadShed::TIMINGS::EnableCyclic)
  {
    SetBusContext(gILCAN2_BusContext);
    gCAN2DisturbancePeriod = @sysvar::IL_CAN2::NODES::N_VCU::MESSAGES::VCU_LoadShed::TIMINGS::CyclePeriod;
    ILFaultInjectionSetMsgCycleTime(CHASSIS2CAN::VCU::VCU_LoadShed, gCAN2DisturbancePeriod);
  }
}

on sysvar_update sysvar::IL_CAN2::NODES::N_VCU::MESSAGES::VCU_LoadShed::TIMINGS::SendOnce
{
  if (@this == 1)
  {
    SetBusContext(gILCAN2_BusContext);
    ILSetMsgEvent(CHASSIS2CAN::VCU::VCU_LoadShed);
  }
}

on sysvar_update sysvar::IL_CAN2::NODES::N_VCU::MESSAGES::VCU_LVBatt1Info::TIMINGS::EnableCyclic
{
  if (@this == 1)
  {
    SetBusContext(gILCAN2_BusContext);
    ILFaultInjectionEnableMsg  (CHASSIS2CAN::VCU::VCU_LVBatt1Info);
  }
  else
  {
    SetBusContext(gILCAN2_BusContext);
    ILFaultInjectionDisableMsg (CHASSIS2CAN::VCU::VCU_LVBatt1Info);
  }
}

on sysvar_update sysvar::IL_CAN2::NODES::N_VCU::MESSAGES::VCU_LVBatt1Info::TIMINGS::SetNormalCycle
{
  if (@this == 1 && @sysvar::IL_CAN2::NODES::N_VCU::MESSAGES::VCU_LVBatt1Info::TIMINGS::EnableCyclic)
  {
    @sysvar::IL_CAN2::NODES::N_VCU::MESSAGES::VCU_LVBatt1Info::TIMINGS::SelectedPeriod = 0;
  }
}

on sysvar_update sysvar::IL_CAN2::NODES::N_VCU::MESSAGES::VCU_LVBatt1Info::TIMINGS::SetNewCycleContinously
{
  if (@this == 1 && @sysvar::IL_CAN2::NODES::N_VCU::MESSAGES::VCU_LVBatt1Info::TIMINGS::EnableCyclic)
  {
    @sysvar::IL_CAN2::NODES::N_VCU::MESSAGES::VCU_LVBatt1Info::TIMINGS::SelectedPeriod = -1;
  }
}

on sysvar_update sysvar::IL_CAN2::NODES::N_VCU::MESSAGES::VCU_LVBatt1Info::TIMINGS::SelectedPeriod
{
  if (@this == 0 && @sysvar::IL_CAN2::NODES::N_VCU::MESSAGES::VCU_LVBatt1Info::TIMINGS::EnableCyclic)
  {
    SetBusContext(gILCAN2_BusContext);
    gCAN2DisturbancePeriod = @sysvar::IL_CAN2::NODES::N_VCU::MESSAGES::VCU_LVBatt1Info::TIMINGS::NormalCyclePeriod;
    ILFaultInjectionResetMsgCycleTime(CHASSIS2CAN::VCU::VCU_LVBatt1Info);
  }
  else if (@this == 1 && @sysvar::IL_CAN2::NODES::N_VCU::MESSAGES::VCU_LVBatt1Info::TIMINGS::EnableCyclic)
  {
    SetBusContext(gILCAN2_BusContext);
    gCAN2DisturbancePeriod = @sysvar::IL_CAN2::NODES::N_VCU::MESSAGES::VCU_LVBatt1Info::TIMINGS::ActiveCyclePeriod;
    ILFaultInjectionSetMsgCycleTime(CHASSIS2CAN::VCU::VCU_LVBatt1Info, gCAN2DisturbancePeriod);
  }
  else if (@this == -1 && @sysvar::IL_CAN2::NODES::N_VCU::MESSAGES::VCU_LVBatt1Info::TIMINGS::EnableCyclic)
  {
    SetBusContext(gILCAN2_BusContext);
    gCAN2DisturbancePeriod = @sysvar::IL_CAN2::NODES::N_VCU::MESSAGES::VCU_LVBatt1Info::TIMINGS::CyclePeriod;
    ILFaultInjectionSetMsgCycleTime(CHASSIS2CAN::VCU::VCU_LVBatt1Info, gCAN2DisturbancePeriod);
  }
}

on sysvar_update sysvar::IL_CAN2::NODES::N_VCU::MESSAGES::VCU_LVBatt1Info::TIMINGS::SendOnce
{
  if (@this == 1)
  {
    SetBusContext(gILCAN2_BusContext);
    ILSetMsgEvent(CHASSIS2CAN::VCU::VCU_LVBatt1Info);
  }
}

on sysvar_update sysvar::IL_CAN2::NODES::N_VCU::MESSAGES::VCU_LVBatt2Info::TIMINGS::EnableCyclic
{
  if (@this == 1)
  {
    SetBusContext(gILCAN2_BusContext);
   // ILFaultInjectionEnableMsg  (CHASSIS2CAN::VCU::VCU_LVBatt2Info);
  }
  else
  {
    SetBusContext(gILCAN2_BusContext);
    //ILFaultInjectionDisableMsg (CHASSIS2CAN::VCU::VCU_LVBatt2Info);
  }
}

on sysvar_update sysvar::IL_CAN2::NODES::N_VCU::MESSAGES::VCU_LVBatt2Info::TIMINGS::SetNormalCycle
{
  if (@this == 1 && @sysvar::IL_CAN2::NODES::N_VCU::MESSAGES::VCU_LVBatt2Info::TIMINGS::EnableCyclic)
  {
    @sysvar::IL_CAN2::NODES::N_VCU::MESSAGES::VCU_LVBatt2Info::TIMINGS::SelectedPeriod = 0;
  }
}

on sysvar_update sysvar::IL_CAN2::NODES::N_VCU::MESSAGES::VCU_LVBatt2Info::TIMINGS::SetNewCycleContinously
{
  if (@this == 1 && @sysvar::IL_CAN2::NODES::N_VCU::MESSAGES::VCU_LVBatt2Info::TIMINGS::EnableCyclic)
  {
    @sysvar::IL_CAN2::NODES::N_VCU::MESSAGES::VCU_LVBatt2Info::TIMINGS::SelectedPeriod = -1;
  }
}

on sysvar_update sysvar::IL_CAN2::NODES::N_VCU::MESSAGES::VCU_LVBatt2Info::TIMINGS::SelectedPeriod
{
  if (@this == 0 && @sysvar::IL_CAN2::NODES::N_VCU::MESSAGES::VCU_LVBatt2Info::TIMINGS::EnableCyclic)
  {
    SetBusContext(gILCAN2_BusContext);
    gCAN2DisturbancePeriod = @sysvar::IL_CAN2::NODES::N_VCU::MESSAGES::VCU_LVBatt2Info::TIMINGS::NormalCyclePeriod;
   // ILFaultInjectionResetMsgCycleTime(CHASSIS2CAN::VCU::VCU_LVBatt2Info);
  }
  else if (@this == 1 && @sysvar::IL_CAN2::NODES::N_VCU::MESSAGES::VCU_LVBatt2Info::TIMINGS::EnableCyclic)
  {
    SetBusContext(gILCAN2_BusContext);
    gCAN2DisturbancePeriod = @sysvar::IL_CAN2::NODES::N_VCU::MESSAGES::VCU_LVBatt2Info::TIMINGS::ActiveCyclePeriod;
   // ILFaultInjectionSetMsgCycleTime(CHASSIS2CAN::VCU::VCU_LVBatt2Info, gCAN2DisturbancePeriod);
  }
  else if (@this == -1 && @sysvar::IL_CAN2::NODES::N_VCU::MESSAGES::VCU_LVBatt2Info::TIMINGS::EnableCyclic)
  {
    SetBusContext(gILCAN2_BusContext);
    gCAN2DisturbancePeriod = @sysvar::IL_CAN2::NODES::N_VCU::MESSAGES::VCU_LVBatt2Info::TIMINGS::CyclePeriod;
   // ILFaultInjectionSetMsgCycleTime(CHASSIS2CAN::VCU::VCU_LVBatt2Info, gCAN2DisturbancePeriod);
  }
}

on sysvar_update sysvar::IL_CAN2::NODES::N_VCU::MESSAGES::VCU_LVBatt2Info::TIMINGS::SendOnce
{
  if (@this == 1)
  {
    SetBusContext(gILCAN2_BusContext);
   // ILSetMsgEvent(CHASSIS2CAN::VCU::VCU_LVBatt2Info);
  }
}

on sysvar_update sysvar::IL_CAN2::NODES::N_VCU::MESSAGES::VCU_ManualDriveInfo::TIMINGS::EnableCyclic
{
  if (@this == 1)
  {
    SetBusContext(gILCAN2_BusContext);
    ILFaultInjectionEnableMsg  (CHASSIS2CAN::VCU::VCU_ManualDriveInfo);
  }
  else
  {
    SetBusContext(gILCAN2_BusContext);
    ILFaultInjectionDisableMsg (CHASSIS2CAN::VCU::VCU_ManualDriveInfo);
  }
}

on sysvar_update sysvar::IL_CAN2::NODES::N_VCU::MESSAGES::VCU_ManualDriveInfo::TIMINGS::SetNormalCycle
{
  if (@this == 1 && @sysvar::IL_CAN2::NODES::N_VCU::MESSAGES::VCU_ManualDriveInfo::TIMINGS::EnableCyclic)
  {
    @sysvar::IL_CAN2::NODES::N_VCU::MESSAGES::VCU_ManualDriveInfo::TIMINGS::SelectedPeriod = 0;
  }
}

on sysvar_update sysvar::IL_CAN2::NODES::N_VCU::MESSAGES::VCU_ManualDriveInfo::TIMINGS::SetNewCycleContinously
{
  if (@this == 1 && @sysvar::IL_CAN2::NODES::N_VCU::MESSAGES::VCU_ManualDriveInfo::TIMINGS::EnableCyclic)
  {
    @sysvar::IL_CAN2::NODES::N_VCU::MESSAGES::VCU_ManualDriveInfo::TIMINGS::SelectedPeriod = -1;
  }
}

on sysvar_update sysvar::IL_CAN2::NODES::N_VCU::MESSAGES::VCU_ManualDriveInfo::TIMINGS::SelectedPeriod
{
  if (@this == 0 && @sysvar::IL_CAN2::NODES::N_VCU::MESSAGES::VCU_ManualDriveInfo::TIMINGS::EnableCyclic)
  {
    SetBusContext(gILCAN2_BusContext);
    gCAN2DisturbancePeriod = @sysvar::IL_CAN2::NODES::N_VCU::MESSAGES::VCU_ManualDriveInfo::TIMINGS::NormalCyclePeriod;
    ILFaultInjectionResetMsgCycleTime(CHASSIS2CAN::VCU::VCU_ManualDriveInfo);
  }
  else if (@this == 1 && @sysvar::IL_CAN2::NODES::N_VCU::MESSAGES::VCU_ManualDriveInfo::TIMINGS::EnableCyclic)
  {
    SetBusContext(gILCAN2_BusContext);
    gCAN2DisturbancePeriod = @sysvar::IL_CAN2::NODES::N_VCU::MESSAGES::VCU_ManualDriveInfo::TIMINGS::ActiveCyclePeriod;
    ILFaultInjectionSetMsgCycleTime(CHASSIS2CAN::VCU::VCU_ManualDriveInfo, gCAN2DisturbancePeriod);
  }
  else if (@this == -1 && @sysvar::IL_CAN2::NODES::N_VCU::MESSAGES::VCU_ManualDriveInfo::TIMINGS::EnableCyclic)
  {
    SetBusContext(gILCAN2_BusContext);
    gCAN2DisturbancePeriod = @sysvar::IL_CAN2::NODES::N_VCU::MESSAGES::VCU_ManualDriveInfo::TIMINGS::CyclePeriod;
    ILFaultInjectionSetMsgCycleTime(CHASSIS2CAN::VCU::VCU_ManualDriveInfo, gCAN2DisturbancePeriod);
  }
}

on sysvar_update sysvar::IL_CAN2::NODES::N_VCU::MESSAGES::VCU_ManualDriveInfo::TIMINGS::SendOnce
{
  if (@this == 1)
  {
    SetBusContext(gILCAN2_BusContext);
    ILSetMsgEvent(CHASSIS2CAN::VCU::VCU_ManualDriveInfo);
  }
}

on sysvar_update sysvar::IL_CAN2::NODES::N_VCU::MESSAGES::VCU_ManualOperationInfo_Prim::TIMINGS::EnableCyclic
{
  if (@this == 1)
  {
    SetBusContext(gILCAN2_BusContext);
    ILFaultInjectionEnableMsg  (CHASSIS2CAN::VCU::VCU_ManualOperationInfo_Prim);
  }
  else
  {
    SetBusContext(gILCAN2_BusContext);
    ILFaultInjectionDisableMsg (CHASSIS2CAN::VCU::VCU_ManualOperationInfo_Prim);
  }
}

on sysvar_update sysvar::IL_CAN2::NODES::N_VCU::MESSAGES::VCU_ManualOperationInfo_Prim::TIMINGS::SetNormalCycle
{
  if (@this == 1 && @sysvar::IL_CAN2::NODES::N_VCU::MESSAGES::VCU_ManualOperationInfo_Prim::TIMINGS::EnableCyclic)
  {
    @sysvar::IL_CAN2::NODES::N_VCU::MESSAGES::VCU_ManualOperationInfo_Prim::TIMINGS::SelectedPeriod = 0;
  }
}

on sysvar_update sysvar::IL_CAN2::NODES::N_VCU::MESSAGES::VCU_ManualOperationInfo_Prim::TIMINGS::SetNewCycleContinously
{
  if (@this == 1 && @sysvar::IL_CAN2::NODES::N_VCU::MESSAGES::VCU_ManualOperationInfo_Prim::TIMINGS::EnableCyclic)
  {
    @sysvar::IL_CAN2::NODES::N_VCU::MESSAGES::VCU_ManualOperationInfo_Prim::TIMINGS::SelectedPeriod = -1;
  }
}

on sysvar_update sysvar::IL_CAN2::NODES::N_VCU::MESSAGES::VCU_ManualOperationInfo_Prim::TIMINGS::SelectedPeriod
{
  if (@this == 0 && @sysvar::IL_CAN2::NODES::N_VCU::MESSAGES::VCU_ManualOperationInfo_Prim::TIMINGS::EnableCyclic)
  {
    SetBusContext(gILCAN2_BusContext);
    gCAN2DisturbancePeriod = @sysvar::IL_CAN2::NODES::N_VCU::MESSAGES::VCU_ManualOperationInfo_Prim::TIMINGS::NormalCyclePeriod;
    ILFaultInjectionResetMsgCycleTime(CHASSIS2CAN::VCU::VCU_ManualOperationInfo_Prim);
  }
  else if (@this == 1 && @sysvar::IL_CAN2::NODES::N_VCU::MESSAGES::VCU_ManualOperationInfo_Prim::TIMINGS::EnableCyclic)
  {
    SetBusContext(gILCAN2_BusContext);
    gCAN2DisturbancePeriod = @sysvar::IL_CAN2::NODES::N_VCU::MESSAGES::VCU_ManualOperationInfo_Prim::TIMINGS::ActiveCyclePeriod;
    ILFaultInjectionSetMsgCycleTime(CHASSIS2CAN::VCU::VCU_ManualOperationInfo_Prim, gCAN2DisturbancePeriod);
  }
  else if (@this == -1 && @sysvar::IL_CAN2::NODES::N_VCU::MESSAGES::VCU_ManualOperationInfo_Prim::TIMINGS::EnableCyclic)
  {
    SetBusContext(gILCAN2_BusContext);
    gCAN2DisturbancePeriod = @sysvar::IL_CAN2::NODES::N_VCU::MESSAGES::VCU_ManualOperationInfo_Prim::TIMINGS::CyclePeriod;
    ILFaultInjectionSetMsgCycleTime(CHASSIS2CAN::VCU::VCU_ManualOperationInfo_Prim, gCAN2DisturbancePeriod);
  }
}

on sysvar_update sysvar::IL_CAN2::NODES::N_VCU::MESSAGES::VCU_ManualOperationInfo_Prim::TIMINGS::SendOnce
{
  if (@this == 1)
  {
    SetBusContext(gILCAN2_BusContext);
    ILSetMsgEvent(CHASSIS2CAN::VCU::VCU_ManualOperationInfo_Prim);
  }
}

on sysvar_update sysvar::IL_CAN2::NODES::N_VCU::MESSAGES::VCU_TrqRecup::TIMINGS::EnableCyclic
{
  if (@this == 1)
  {
    SetBusContext(gILCAN2_BusContext);
    ILFaultInjectionEnableMsg  (CHASSIS2CAN::VCU::VCU_TrqRecup);
  }
  else
  {
    SetBusContext(gILCAN2_BusContext);
    ILFaultInjectionDisableMsg (CHASSIS2CAN::VCU::VCU_TrqRecup);
  }
}

on sysvar_update sysvar::IL_CAN2::NODES::N_VCU::MESSAGES::VCU_TrqRecup::TIMINGS::SetNormalCycle
{
  if (@this == 1 && @sysvar::IL_CAN2::NODES::N_VCU::MESSAGES::VCU_TrqRecup::TIMINGS::EnableCyclic)
  {
    @sysvar::IL_CAN2::NODES::N_VCU::MESSAGES::VCU_TrqRecup::TIMINGS::SelectedPeriod = 0;
  }
}

on sysvar_update sysvar::IL_CAN2::NODES::N_VCU::MESSAGES::VCU_TrqRecup::TIMINGS::SetNewCycleContinously
{
  if (@this == 1 && @sysvar::IL_CAN2::NODES::N_VCU::MESSAGES::VCU_TrqRecup::TIMINGS::EnableCyclic)
  {
    @sysvar::IL_CAN2::NODES::N_VCU::MESSAGES::VCU_TrqRecup::TIMINGS::SelectedPeriod = -1;
  }
}

on sysvar_update sysvar::IL_CAN2::NODES::N_VCU::MESSAGES::VCU_TrqRecup::TIMINGS::SelectedPeriod
{
  if (@this == 0 && @sysvar::IL_CAN2::NODES::N_VCU::MESSAGES::VCU_TrqRecup::TIMINGS::EnableCyclic)
  {
    SetBusContext(gILCAN2_BusContext);
    gCAN2DisturbancePeriod = @sysvar::IL_CAN2::NODES::N_VCU::MESSAGES::VCU_TrqRecup::TIMINGS::NormalCyclePeriod;
    ILFaultInjectionResetMsgCycleTime(CHASSIS2CAN::VCU::VCU_TrqRecup);
  }
  else if (@this == 1 && @sysvar::IL_CAN2::NODES::N_VCU::MESSAGES::VCU_TrqRecup::TIMINGS::EnableCyclic)
  {
    SetBusContext(gILCAN2_BusContext);
    gCAN2DisturbancePeriod = @sysvar::IL_CAN2::NODES::N_VCU::MESSAGES::VCU_TrqRecup::TIMINGS::ActiveCyclePeriod;
    ILFaultInjectionSetMsgCycleTime(CHASSIS2CAN::VCU::VCU_TrqRecup, gCAN2DisturbancePeriod);
  }
  else if (@this == -1 && @sysvar::IL_CAN2::NODES::N_VCU::MESSAGES::VCU_TrqRecup::TIMINGS::EnableCyclic)
  {
    SetBusContext(gILCAN2_BusContext);
    gCAN2DisturbancePeriod = @sysvar::IL_CAN2::NODES::N_VCU::MESSAGES::VCU_TrqRecup::TIMINGS::CyclePeriod;
    ILFaultInjectionSetMsgCycleTime(CHASSIS2CAN::VCU::VCU_TrqRecup, gCAN2DisturbancePeriod);
  }
}

on sysvar_update sysvar::IL_CAN2::NODES::N_VCU::MESSAGES::VCU_TrqRecup::TIMINGS::SendOnce
{
  if (@this == 1)
  {
    SetBusContext(gILCAN2_BusContext);
    ILSetMsgEvent(CHASSIS2CAN::VCU::VCU_TrqRecup);
  }
}

on sysvar_update sysvar::IL_CAN2::NODES::N_VCU::MESSAGES::VCU_VehicleTravel1Info::TIMINGS::EnableCyclic
{
  if (@this == 1)
  {
    SetBusContext(gILCAN2_BusContext);
    ILFaultInjectionEnableMsg  (CHASSIS2CAN::VCU::VCU_VehicleTravel1Info);
  }
  else
  {
    SetBusContext(gILCAN2_BusContext);
    ILFaultInjectionDisableMsg (CHASSIS2CAN::VCU::VCU_VehicleTravel1Info);
  }
}

on sysvar_update sysvar::IL_CAN2::NODES::N_VCU::MESSAGES::VCU_VehicleTravel1Info::TIMINGS::SetNormalCycle
{
  if (@this == 1 && @sysvar::IL_CAN2::NODES::N_VCU::MESSAGES::VCU_VehicleTravel1Info::TIMINGS::EnableCyclic)
  {
    @sysvar::IL_CAN2::NODES::N_VCU::MESSAGES::VCU_VehicleTravel1Info::TIMINGS::SelectedPeriod = 0;
  }
}

on sysvar_update sysvar::IL_CAN2::NODES::N_VCU::MESSAGES::VCU_VehicleTravel1Info::TIMINGS::SetNewCycleContinously
{
  if (@this == 1 && @sysvar::IL_CAN2::NODES::N_VCU::MESSAGES::VCU_VehicleTravel1Info::TIMINGS::EnableCyclic)
  {
    @sysvar::IL_CAN2::NODES::N_VCU::MESSAGES::VCU_VehicleTravel1Info::TIMINGS::SelectedPeriod = -1;
  }
}

on sysvar_update sysvar::IL_CAN2::NODES::N_VCU::MESSAGES::VCU_VehicleTravel1Info::TIMINGS::SelectedPeriod
{
  if (@this == 0 && @sysvar::IL_CAN2::NODES::N_VCU::MESSAGES::VCU_VehicleTravel1Info::TIMINGS::EnableCyclic)
  {
    SetBusContext(gILCAN2_BusContext);
    gCAN2DisturbancePeriod = @sysvar::IL_CAN2::NODES::N_VCU::MESSAGES::VCU_VehicleTravel1Info::TIMINGS::NormalCyclePeriod;
    ILFaultInjectionResetMsgCycleTime(CHASSIS2CAN::VCU::VCU_VehicleTravel1Info);
  }
  else if (@this == 1 && @sysvar::IL_CAN2::NODES::N_VCU::MESSAGES::VCU_VehicleTravel1Info::TIMINGS::EnableCyclic)
  {
    SetBusContext(gILCAN2_BusContext);
    gCAN2DisturbancePeriod = @sysvar::IL_CAN2::NODES::N_VCU::MESSAGES::VCU_VehicleTravel1Info::TIMINGS::ActiveCyclePeriod;
    ILFaultInjectionSetMsgCycleTime(CHASSIS2CAN::VCU::VCU_VehicleTravel1Info, gCAN2DisturbancePeriod);
  }
  else if (@this == -1 && @sysvar::IL_CAN2::NODES::N_VCU::MESSAGES::VCU_VehicleTravel1Info::TIMINGS::EnableCyclic)
  {
    SetBusContext(gILCAN2_BusContext);
    gCAN2DisturbancePeriod = @sysvar::IL_CAN2::NODES::N_VCU::MESSAGES::VCU_VehicleTravel1Info::TIMINGS::CyclePeriod;
    ILFaultInjectionSetMsgCycleTime(CHASSIS2CAN::VCU::VCU_VehicleTravel1Info, gCAN2DisturbancePeriod);
  }
}

on sysvar_update sysvar::IL_CAN2::NODES::N_VCU::MESSAGES::VCU_VehicleTravel1Info::TIMINGS::SendOnce
{
  if (@this == 1)
  {
    SetBusContext(gILCAN2_BusContext);
    ILSetMsgEvent(CHASSIS2CAN::VCU::VCU_VehicleTravel1Info);
  }
}

on sysvar_update sysvar::IL_CAN2::NODES::N_VCU::MESSAGES::VCU_VSMInfo::TIMINGS::EnableCyclic
{
  if (@this == 1)
  {
    SetBusContext(gILCAN2_BusContext);
    ILFaultInjectionEnableMsg  (CHASSIS2CAN::VCU::VCU_VSMInfo);
  }
  else
  {
    SetBusContext(gILCAN2_BusContext);
    ILFaultInjectionDisableMsg (CHASSIS2CAN::VCU::VCU_VSMInfo);
  }
}

on sysvar_update sysvar::IL_CAN2::NODES::N_VCU::MESSAGES::VCU_VSMInfo::TIMINGS::SetNormalCycle
{
  if (@this == 1 && @sysvar::IL_CAN2::NODES::N_VCU::MESSAGES::VCU_VSMInfo::TIMINGS::EnableCyclic)
  {
    @sysvar::IL_CAN2::NODES::N_VCU::MESSAGES::VCU_VSMInfo::TIMINGS::SelectedPeriod = 0;
  }
}

on sysvar_update sysvar::IL_CAN2::NODES::N_VCU::MESSAGES::VCU_VSMInfo::TIMINGS::SetNewCycleContinously
{
  if (@this == 1 && @sysvar::IL_CAN2::NODES::N_VCU::MESSAGES::VCU_VSMInfo::TIMINGS::EnableCyclic)
  {
    @sysvar::IL_CAN2::NODES::N_VCU::MESSAGES::VCU_VSMInfo::TIMINGS::SelectedPeriod = -1;
  }
}

on sysvar_update sysvar::IL_CAN2::NODES::N_VCU::MESSAGES::VCU_VSMInfo::TIMINGS::SelectedPeriod
{
  if (@this == 0 && @sysvar::IL_CAN2::NODES::N_VCU::MESSAGES::VCU_VSMInfo::TIMINGS::EnableCyclic)
  {
    SetBusContext(gILCAN2_BusContext);
    gCAN2DisturbancePeriod = @sysvar::IL_CAN2::NODES::N_VCU::MESSAGES::VCU_VSMInfo::TIMINGS::NormalCyclePeriod;
    ILFaultInjectionResetMsgCycleTime(CHASSIS2CAN::VCU::VCU_VSMInfo);
  }
  else if (@this == 1 && @sysvar::IL_CAN2::NODES::N_VCU::MESSAGES::VCU_VSMInfo::TIMINGS::EnableCyclic)
  {
    SetBusContext(gILCAN2_BusContext);
    gCAN2DisturbancePeriod = @sysvar::IL_CAN2::NODES::N_VCU::MESSAGES::VCU_VSMInfo::TIMINGS::ActiveCyclePeriod;
    ILFaultInjectionSetMsgCycleTime(CHASSIS2CAN::VCU::VCU_VSMInfo, gCAN2DisturbancePeriod);
  }
  else if (@this == -1 && @sysvar::IL_CAN2::NODES::N_VCU::MESSAGES::VCU_VSMInfo::TIMINGS::EnableCyclic)
  {
    SetBusContext(gILCAN2_BusContext);
    gCAN2DisturbancePeriod = @sysvar::IL_CAN2::NODES::N_VCU::MESSAGES::VCU_VSMInfo::TIMINGS::CyclePeriod;
    ILFaultInjectionSetMsgCycleTime(CHASSIS2CAN::VCU::VCU_VSMInfo, gCAN2DisturbancePeriod);
  }
}

on sysvar_update sysvar::IL_CAN2::NODES::N_VCU::MESSAGES::VCU_VSMInfo::TIMINGS::SendOnce
{
  if (@this == 1)
  {
    SetBusContext(gILCAN2_BusContext);
    ILSetMsgEvent(CHASSIS2CAN::VCU::VCU_VSMInfo);
  }
}

on sysvar_update sysvar::IL_CAN2::NODES::N_VCU::MESSAGES::VCUFastCommandResponse::TIMINGS::EnableCyclic
{
  if (@this == 1)
  {
    SetBusContext(gILCAN2_BusContext);
    ILFaultInjectionEnableMsg  (CHASSIS2CAN::VCU::VCUFastCommandResponse);
  }
  else
  {
    SetBusContext(gILCAN2_BusContext);
    ILFaultInjectionDisableMsg (CHASSIS2CAN::VCU::VCUFastCommandResponse);
  }
}

on sysvar_update sysvar::IL_CAN2::NODES::N_VCU::MESSAGES::VCUFastCommandResponse::TIMINGS::SetNormalCycle
{
  if (@this == 1 && @sysvar::IL_CAN2::NODES::N_VCU::MESSAGES::VCUFastCommandResponse::TIMINGS::EnableCyclic)
  {
    @sysvar::IL_CAN2::NODES::N_VCU::MESSAGES::VCUFastCommandResponse::TIMINGS::SelectedPeriod = 0;
  }
}

on sysvar_update sysvar::IL_CAN2::NODES::N_VCU::MESSAGES::VCUFastCommandResponse::TIMINGS::SetNewCycleContinously
{
  if (@this == 1 && @sysvar::IL_CAN2::NODES::N_VCU::MESSAGES::VCUFastCommandResponse::TIMINGS::EnableCyclic)
  {
    @sysvar::IL_CAN2::NODES::N_VCU::MESSAGES::VCUFastCommandResponse::TIMINGS::SelectedPeriod = -1;
  }
}

on sysvar_update sysvar::IL_CAN2::NODES::N_VCU::MESSAGES::VCUFastCommandResponse::TIMINGS::SelectedPeriod
{
  if (@this == 0 && @sysvar::IL_CAN2::NODES::N_VCU::MESSAGES::VCUFastCommandResponse::TIMINGS::EnableCyclic)
  {
    SetBusContext(gILCAN2_BusContext);
    gCAN2DisturbancePeriod = @sysvar::IL_CAN2::NODES::N_VCU::MESSAGES::VCUFastCommandResponse::TIMINGS::NormalCyclePeriod;
    ILFaultInjectionResetMsgCycleTime(CHASSIS2CAN::VCU::VCUFastCommandResponse);
  }
  else if (@this == 1 && @sysvar::IL_CAN2::NODES::N_VCU::MESSAGES::VCUFastCommandResponse::TIMINGS::EnableCyclic)
  {
    SetBusContext(gILCAN2_BusContext);
    gCAN2DisturbancePeriod = @sysvar::IL_CAN2::NODES::N_VCU::MESSAGES::VCUFastCommandResponse::TIMINGS::ActiveCyclePeriod;
    ILFaultInjectionSetMsgCycleTime(CHASSIS2CAN::VCU::VCUFastCommandResponse, gCAN2DisturbancePeriod);
  }
  else if (@this == -1 && @sysvar::IL_CAN2::NODES::N_VCU::MESSAGES::VCUFastCommandResponse::TIMINGS::EnableCyclic)
  {
    SetBusContext(gILCAN2_BusContext);
    gCAN2DisturbancePeriod = @sysvar::IL_CAN2::NODES::N_VCU::MESSAGES::VCUFastCommandResponse::TIMINGS::CyclePeriod;
    ILFaultInjectionSetMsgCycleTime(CHASSIS2CAN::VCU::VCUFastCommandResponse, gCAN2DisturbancePeriod);
  }
}

on sysvar_update sysvar::IL_CAN2::NODES::N_VCU::MESSAGES::VCUFastCommandResponse::TIMINGS::SendOnce
{
  if (@this == 1)
  {
    SetBusContext(gILCAN2_BusContext);
    ILSetMsgEvent(CHASSIS2CAN::VCU::VCUFastCommandResponse);
  }
}

on sysvar_update sysvar::IL_CAN2::NODES::N_VCU::MESSAGES::VCUSlowCommandResponse::TIMINGS::EnableCyclic
{
  if (@this == 1)
  {
    SetBusContext(gILCAN2_BusContext);
    ILFaultInjectionEnableMsg  (CHASSIS2CAN::VCU::VCUSlowCommandResponse);
  }
  else
  {
    SetBusContext(gILCAN2_BusContext);
    ILFaultInjectionDisableMsg (CHASSIS2CAN::VCU::VCUSlowCommandResponse);
  }
}

on sysvar_update sysvar::IL_CAN2::NODES::N_VCU::MESSAGES::VCUSlowCommandResponse::TIMINGS::SetNormalCycle
{
  if (@this == 1 && @sysvar::IL_CAN2::NODES::N_VCU::MESSAGES::VCUSlowCommandResponse::TIMINGS::EnableCyclic)
  {
    @sysvar::IL_CAN2::NODES::N_VCU::MESSAGES::VCUSlowCommandResponse::TIMINGS::SelectedPeriod = 0;
  }
}

on sysvar_update sysvar::IL_CAN2::NODES::N_VCU::MESSAGES::VCUSlowCommandResponse::TIMINGS::SetNewCycleContinously
{
  if (@this == 1 && @sysvar::IL_CAN2::NODES::N_VCU::MESSAGES::VCUSlowCommandResponse::TIMINGS::EnableCyclic)
  {
    @sysvar::IL_CAN2::NODES::N_VCU::MESSAGES::VCUSlowCommandResponse::TIMINGS::SelectedPeriod = -1;
  }
}

on sysvar_update sysvar::IL_CAN2::NODES::N_VCU::MESSAGES::VCUSlowCommandResponse::TIMINGS::SelectedPeriod
{
  if (@this == 0 && @sysvar::IL_CAN2::NODES::N_VCU::MESSAGES::VCUSlowCommandResponse::TIMINGS::EnableCyclic)
  {
    SetBusContext(gILCAN2_BusContext);
    gCAN2DisturbancePeriod = @sysvar::IL_CAN2::NODES::N_VCU::MESSAGES::VCUSlowCommandResponse::TIMINGS::NormalCyclePeriod;
    ILFaultInjectionResetMsgCycleTime(CHASSIS2CAN::VCU::VCUSlowCommandResponse);
  }
  else if (@this == 1 && @sysvar::IL_CAN2::NODES::N_VCU::MESSAGES::VCUSlowCommandResponse::TIMINGS::EnableCyclic)
  {
    SetBusContext(gILCAN2_BusContext);
    gCAN2DisturbancePeriod = @sysvar::IL_CAN2::NODES::N_VCU::MESSAGES::VCUSlowCommandResponse::TIMINGS::ActiveCyclePeriod;
    ILFaultInjectionSetMsgCycleTime(CHASSIS2CAN::VCU::VCUSlowCommandResponse, gCAN2DisturbancePeriod);
  }
  else if (@this == -1 && @sysvar::IL_CAN2::NODES::N_VCU::MESSAGES::VCUSlowCommandResponse::TIMINGS::EnableCyclic)
  {
    SetBusContext(gILCAN2_BusContext);
    gCAN2DisturbancePeriod = @sysvar::IL_CAN2::NODES::N_VCU::MESSAGES::VCUSlowCommandResponse::TIMINGS::CyclePeriod;
    ILFaultInjectionSetMsgCycleTime(CHASSIS2CAN::VCU::VCUSlowCommandResponse, gCAN2DisturbancePeriod);
  }
}

on sysvar_update sysvar::IL_CAN2::NODES::N_VCU::MESSAGES::VCUSlowCommandResponse::TIMINGS::SendOnce
{
  if (@this == 1)
  {
    SetBusContext(gILCAN2_BusContext);
    ILSetMsgEvent(CHASSIS2CAN::VCU::VCUSlowCommandResponse);
  }
}

on sysvar_update sysvar::NM_CAN2::NODES::N_VCU::OpenNodePanel
{
  OpenNodePanel("CHASSIS2CAN::VCU", 1);
}

on sysvar_update sysvar::NM_CAN2::StateControl::CloseNodePanels
{
  OpenNodePanel("CHASSIS2CAN::VCU", 0);
}

/* #ChannelEnd# |CAN2| #BusEnd# |CHASSIS2CAN| */
//--- end generated part --- Block end <#SysVar_Handler#> do not delete this line! Add application code below this line.

//--- begin generated part --- Block start <#MsgUpdateFcns#> do not delete this line and do not add application code in this code block!
/* #ChannelStart# |CAN2| #BusStart# |CHASSIS2CAN| */
/* #ChannelEnd# |CAN2| #BusEnd# |CHASSIS2CAN| */
//--- end generated part --- Block end <#MsgUpdateFcns#> do not delete this line! Add application code below this line.

